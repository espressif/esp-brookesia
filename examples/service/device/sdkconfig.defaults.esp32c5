## gui/brookesia_gui_lvgl/Kconfig
```kconfig
menu "ESP-Brookesia: GUI LVGL Configurations"
    config BROOKESIA_GUI_LVGL_DEFAULT_CONFIGS
        bool
        select LV_USE_LABEL
        select LV_USE_BUTTON
        select LV_USE_BUTTONMATRIX
        select LV_USE_IMAGE
        select LV_USE_CANVAS
        select LV_USE_CHECKBOX
        select LV_USE_DROPDOWN
        select LV_USE_KEYBOARD
        select LV_USE_LINE
        select LV_USE_SLIDER
        select LV_USE_BAR
        select LV_USE_ARC
        select LV_USE_SPINNER
        select LV_USE_SWITCH
        select LV_USE_TEXTAREA
        select LV_USE_TABLE
        select LV_USE_FLEX
        select LV_USE_GRID
        select LV_USE_IMGFONT
        select LV_USE_FS_STDIO
        select LV_USE_FS_POSIX
        select LV_USE_FLOAT
        select LV_USE_GESTURE_RECOGNITION
        default y

    menu "Display Source Adapter"
        config BROOKESIA_GUI_LVGL_DISPLAY_SOURCE_FRAME_TIMEOUT_MS
            int "Frame timeout (ms)"
            default 6000
            help
                Default timeout used when presenting LVGL frames through the Display service.

        config BROOKESIA_GUI_LVGL_DISPLAY_SOURCE_TASK_CORE_ID
            int "Task core ID"
            range -1 1
            default 0
            help
                Default core ID of the LVGL adapter task. `-1` means the core ID is not specified.

        config BROOKESIA_GUI_LVGL_DISPLAY_SOURCE_TASK_PRIORITY
            int "Task priority"
            default 6
            help
                Default priority of the LVGL adapter task.

        config BROOKESIA_GUI_LVGL_DISPLAY_SOURCE_TICK_PERIOD_MS
            int "Tick period (ms)"
            default 5
            help
                Default LVGL adapter tick period.

        config BROOKESIA_GUI_LVGL_DISPLAY_SOURCE_TASK_MIN_DELAY_MS
            int "Task minimum delay (ms)"
            default 5
            help
                Default minimum delay of the LVGL adapter task loop.

        config BROOKESIA_GUI_LVGL_DISPLAY_SOURCE_TASK_MAX_DELAY_MS
            int "Task maximum delay (ms)"
            default 100
            help
                Default maximum delay of the LVGL adapter task loop.

        config BROOKESIA_GUI_LVGL_DISPLAY_SOURCE_TASK_STACK_SIZE
            int "Task stack size"
            default 40960
            help
                Default stack size of the LVGL adapter task.

        config BROOKESIA_GUI_LVGL_DISPLAY_SOURCE_TASK_STACK_IN_PSRAM
            bool "Task stack in PSRAM"
            depends on SPIRAM
            default y
            help
                Whether the LVGL adapter task stack is allocated from PSRAM by default.

        config BROOKESIA_GUI_LVGL_DISPLAY_SOURCE_BUFFER_HEIGHT
            int "Buffer height"
            default 20
            help
                Default LVGL display draw buffer height.

        config BROOKESIA_GUI_LVGL_DISPLAY_SOURCE_REQUIRE_DOUBLE_BUFFER
            bool "Require double buffer"
            default n
            help
                Whether the LVGL display source requires double buffering by default.
    endmenu

    menuconfig BROOKESIA_GUI_LVGL_ENABLE_DEBUG_LOG
        bool "Enable debug or lower level logs"
        default n

    if BROOKESIA_GUI_LVGL_ENABLE_DEBUG_LOG
        config BROOKESIA_GUI_LVGL_BACKEND_ENABLE_DEBUG_LOG
            bool "Backend"
            default y

        config BROOKESIA_GUI_LVGL_EVENT_ENABLE_DEBUG_LOG
            bool "Event"
            default y

        config BROOKESIA_GUI_LVGL_FACTORY_ENABLE_DEBUG_LOG
            bool "Factory"
            default y

        config BROOKESIA_GUI_LVGL_LAYOUT_ENABLE_DEBUG_LOG
            bool "Layout"
            default y

        config BROOKESIA_GUI_LVGL_PROPS_ENABLE_DEBUG_LOG
            bool "Props"
            default y

        config BROOKESIA_GUI_LVGL_STYLE_ENABLE_DEBUG_LOG
            bool "Style"
            default y
    endif
endmenu
```

## gui/brookesia_gui_lvgl/test_apps/sdkconfig.defaults
```kconfig
CONFIG_ESP_TASK_WDT_EN=n
CONFIG_FREERTOS_HZ=1000
CONFIG_ESP_MAIN_TASK_STACK_SIZE=40960
CONFIG_ESPTOOLPY_FLASHSIZE_16MB=y
CONFIG_PARTITION_TABLE_CUSTOM=y
CONFIG_PARTITION_TABLE_CUSTOM_FILENAME="partitions_16m.csv"
CONFIG_ESP_LVGL_ADAPTER_ENABLE_FREETYPE=y
CONFIG_LV_USE_FREETYPE=y
CONFIG_LV_DRAW_THREAD_STACK_SIZE=32768
CONFIG_LV_FS_STDIO_LETTER=65
CONFIG_LV_FS_POSIX_LETTER=65
```
