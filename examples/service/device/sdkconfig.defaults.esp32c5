## hal/brookesia_hal_adaptor/test_apps/boards/esp32_p4_function_ev/sdkconfig.defaults.board
```kconfig
CONFIG_ESPTOOLPY_FLASHSIZE_16MB=y
CONFIG_PARTITION_TABLE_CUSTOM_FILENAME="partitions_16m.csv"
CONFIG_PARTITION_TABLE_FILENAME="partitions_16m.csv"
CONFIG_ESP_CONSOLE_SECONDARY_USB_SERIAL_JTAG=n
CONFIG_ESP_CONSOLE_SECONDARY_NONE=y
```

## hal/brookesia_hal_adaptor/test_apps/boards/esp32_s3_korvo2_v3/sdkconfig.defaults.board
```kconfig
CONFIG_ESPTOOLPY_FLASHSIZE_16MB=y
CONFIG_PARTITION_TABLE_CUSTOM_FILENAME="partitions_16m.csv"
CONFIG_PARTITION_TABLE_FILENAME="partitions_16m.csv"

CONFIG_SPIRAM=y
CONFIG_SPIRAM_MODE_OCT=y
CONFIG_SPIRAM_SPEED_80M=y
CONFIG_SPIRAM_MALLOC_ALWAYSINTERNAL=0
CONFIG_SPIRAM_XIP_FROM_PSRAM=y
CONFIG_SPIRAM_TRY_ALLOCATE_WIFI_LWIP=y
CONFIG_SPIRAM_MALLOC_RESERVE_INTERNAL=16384
CONFIG_SPIRAM_ALLOW_BSS_SEG_EXTERNAL_MEMORY=y
CONFIG_SPIRAM_ALLOW_NOINIT_SEG_EXTERNAL_MEMORY=y
```
