## examples/service/http/sdkconfig.defaults
```kconfig
CONFIG_FREERTOS_HZ=1000
CONFIG_ESP_MAIN_TASK_STACK_SIZE=10240
CONFIG_ESPTOOLPY_FLASHSIZE_4MB=y
CONFIG_PARTITION_TABLE_CUSTOM=y
# Since service APIs are called in the system event task, we need to increase its stack size to prevent stack overflow
CONFIG_ESP_SYSTEM_EVENT_TASK_STACK_SIZE=3072

CONFIG_ESP_WIFI_STATIC_RX_BUFFER_NUM=6
CONFIG_ESP_WIFI_STATIC_TX_BUFFER_NUM=6
CONFIG_ESP_WIFI_DYNAMIC_RX_MGMT_BUFFER=y
CONFIG_ESP_WIFI_TX_BA_WIN=16
CONFIG_ESP_WIFI_RX_BA_WIN=8
# Keep Wi-Fi RX/TX hot paths in IRAM. With these turned off the driver runs
# from flash and any cache-disable window (NVS commit, OTA, flash read by
# another task, etc.) starves the Wi-Fi receive path, dropping handshake
# packets and stalling TLS connections for 15-25s.
CONFIG_ESP_WIFI_IRAM_OPT=y
CONFIG_ESP_WIFI_RX_IRAM_OPT=y

CONFIG_BROOKESIA_HAL_ADAPTOR_ENABLE_WIFI_DEVICE=y
CONFIG_BROOKESIA_HAL_ADAPTOR_ENABLE_STORAGE_DEVICE=y
CONFIG_BROOKESIA_HAL_ADAPTOR_ENABLE_SYSTEM_DEVICE=y
CONFIG_BROOKESIA_HAL_ADAPTOR_ENABLE_NETWORK_DEVICE=y
CONFIG_BROOKESIA_HAL_ADAPTOR_NETWORK_ENABLE_SNTP_CLIENT_IMPL=y
CONFIG_BROOKESIA_HAL_ADAPTOR_NETWORK_ENABLE_HTTP_CLIENT_IMPL=y
CONFIG_BROOKESIA_HAL_ADAPTOR_STORAGE_ENABLE_FILE_SYSTEM_IMPL=y
CONFIG_BROOKESIA_HAL_ADAPTOR_STORAGE_FILE_SYSTEM_ENABLE_LITTLEFS=y
CONFIG_BROOKESIA_HAL_ADAPTOR_STORAGE_ENABLE_KEY_VALUE_IMPL=y

# Brookesia:HAL:Network SNTP
CONFIG_LWIP_SNTP_MAX_SERVERS=4
CONFIG_LWIP_SNTP_STARTUP_DELAY=n
CONFIG_LWIP_DHCP_GET_NTP_SRV=y
CONFIG_LWIP_DHCP_MAX_NTP_SERVERS=4

# Allow the TLS Skip-verify demo to actually skip server certificate verification.
# Without these flags esp_tls returns ESP_ERR_MBEDTLS_SSL_SETUP_FAILED when no
# CA bundle/cert is provided, even though the request explicitly opted out of
# verification.
CONFIG_ESP_TLS_INSECURE=y
CONFIG_ESP_TLS_SKIP_SERVER_CERT_VERIFY=y
```

## examples/service/nvs/sdkconfig.defaults
```kconfig
CONFIG_FREERTOS_HZ=1000
CONFIG_ESP_MAIN_TASK_STACK_SIZE=6144
CONFIG_ESPTOOLPY_FLASHSIZE_4MB=y
CONFIG_PARTITION_TABLE_CUSTOM=y
```

## examples/service/storage/sdkconfig.defaults
```kconfig
CONFIG_FREERTOS_HZ=1000
CONFIG_ESP_MAIN_TASK_STACK_SIZE=6144
CONFIG_ESPTOOLPY_FLASHSIZE_4MB=y
CONFIG_PARTITION_TABLE_CUSTOM=y
CONFIG_BROOKESIA_HAL_ADAPTOR_ENABLE_STORAGE_DEVICE=y
CONFIG_BROOKESIA_HAL_ADAPTOR_STORAGE_ENABLE_KEY_VALUE_IMPL=y
```

## examples/service/wifi/sdkconfig.defaults
```kconfig
CONFIG_FREERTOS_HZ=1000
CONFIG_ESP_MAIN_TASK_STACK_SIZE=6144
CONFIG_ESPTOOLPY_FLASHSIZE_4MB=y
CONFIG_PARTITION_TABLE_CUSTOM=y

# Since service APIs are called in the system event task, we need to increase its stack size to prevent stack overflow
CONFIG_ESP_SYSTEM_EVENT_TASK_STACK_SIZE=4096
```

## examples/service_console/boards/esp32_p4_function_ev/sdkconfig.defaults.board
```kconfig
CONFIG_ESPTOOLPY_FLASHSIZE_16MB=y
CONFIG_PARTITION_TABLE_CUSTOM_FILENAME="partitions_16m.csv"
CONFIG_PARTITION_TABLE_FILENAME="partitions_16m.csv"
CONFIG_ESP_CONSOLE_SECONDARY_USB_SERIAL_JTAG=n
CONFIG_ESP_CONSOLE_SECONDARY_NONE=y

# SR
CONFIG_SR_WN_WN9_HIESP=y

# Board
CONFIG_EXAMPLE_ENABLE_BOARD_MANAGER=y

# Services
# Service - Wifi
CONFIG_EXAMPLE_SERVICES_ENABLE_WIFI=y
# Service - Audio
CONFIG_EXAMPLE_SERVICES_ENABLE_AUDIO=y
CONFIG_AUDIO_SIMPLE_PLAYER_RESAMPLE_DEST_RATE=y
CONFIG_AUDIO_SIMPLE_PLAYER_RESAMPLE_DEST_RATE=16000
CONFIG_ESP_AUDIO_SIMPLE_PLAYER_CH_CVT_EN=y
CONFIG_ESP_AUDIO_SIMPLE_PLAYER_BIT_CVT_EN=y
CONFIG_AUDIO_SIMPLE_PLAYER_BIT_CVT_DEST_16BIT=y

# Agents
CONFIG_EXAMPLE_ENABLE_AGENTS=y
CONFIG_EXAMPLE_AGENTS_ENABLE_WAKEUP_WORD=y
# Agent - Coze
CONFIG_MBEDTLS_DYNAMIC_BUFFER=n
# Agent - Openai
CONFIG_WS_BUFFER_SIZE=2048
# Agent - XiaoZhi
CONFIG_EXAMPLE_AGENTS_ENABLE_XIAOZHI=y

# Expression
CONFIG_EXAMPLE_EXPRESSIONS_ENABLE_EMOTE=y
CONFIG_MMAP_FILE_NAME_LENGTH=32
```

## examples/service_console/boards/esp_box_3/sdkconfig.defaults.board
```kconfig
CONFIG_ESPTOOLPY_FLASHSIZE_16MB=y
CONFIG_PARTITION_TABLE_CUSTOM_FILENAME="partitions_16m.csv"
CONFIG_PARTITION_TABLE_FILENAME="partitions_16m.csv"

CONFIG_SPIRAM=y
CONFIG_SPIRAM_MODE_OCT=y
CONFIG_SPIRAM_MALLOC_ALWAYSINTERNAL=0
CONFIG_SPIRAM_XIP_FROM_PSRAM=y
CONFIG_SPIRAM_TRY_ALLOCATE_WIFI_LWIP=y
CONFIG_SPIRAM_MALLOC_RESERVE_INTERNAL=16384
CONFIG_SPIRAM_ALLOW_BSS_SEG_EXTERNAL_MEMORY=y
CONFIG_SPIRAM_ALLOW_NOINIT_SEG_EXTERNAL_MEMORY=y

CONFIG_ESP_CONSOLE_USB_SERIAL_JTAG=y

# Board
CONFIG_EXAMPLE_ENABLE_BOARD_MANAGER=y

# Services
# Service - Audio
CONFIG_EXAMPLE_SERVICES_ENABLE_AUDIO=y
CONFIG_AUDIO_SIMPLE_PLAYER_RESAMPLE_DEST_RATE=y
CONFIG_AUDIO_SIMPLE_PLAYER_RESAMPLE_DEST_RATE=16000
CONFIG_ESP_AUDIO_SIMPLE_PLAYER_CH_CVT_EN=y
CONFIG_ESP_AUDIO_SIMPLE_PLAYER_BIT_CVT_EN=y
CONFIG_AUDIO_SIMPLE_PLAYER_BIT_CVT_DEST_32BIT=y

# Agents
# Agent - Coze
CONFIG_ESP_WS_CLIENT_SEPARATE_TX_LOCK=y
# Agent - Openai
CONFIG_WS_BUFFER_SIZE=2048
CONFIG_ESP_WS_CLIENT_SEPARATE_TX_LOCK=y

# Expression
CONFIG_EXAMPLE_EXPRESSIONS_ENABLE_EMOTE=y
CONFIG_MMAP_FILE_NAME_LENGTH=32
```

## examples/service_console/boards/esp_sensair_shuttle/sdkconfig.defaults.board
```kconfig
CONFIG_ESPTOOLPY_FLASHSIZE_16MB=y
CONFIG_PARTITION_TABLE_CUSTOM_FILENAME="partitions_16m.csv"
CONFIG_PARTITION_TABLE_FILENAME="partitions_16m.csv"

CONFIG_ESP_CONSOLE_USB_SERIAL_JTAG=y

CONFIG_SPIRAM=y
CONFIG_SPIRAM_SPEED_80M=y
CONFIG_SPIRAM_MALLOC_ALWAYSINTERNAL=0
CONFIG_SPIRAM_XIP_FROM_PSRAM=y
CONFIG_SPIRAM_TRY_ALLOCATE_WIFI_LWIP=y
CONFIG_SPIRAM_MALLOC_RESERVE_INTERNAL=8192
CONFIG_SPIRAM_ALLOW_BSS_SEG_EXTERNAL_MEMORY=y
CONFIG_SPIRAM_ALLOW_NOINIT_SEG_EXTERNAL_MEMORY=y

# Board
CONFIG_EXAMPLE_ENABLE_BOARD_MANAGER=y

# Services
# Service - Audio
CONFIG_EXAMPLE_SERVICES_ENABLE_AUDIO=y
CONFIG_AUDIO_SIMPLE_PLAYER_RESAMPLE_DEST_RATE=y
CONFIG_AUDIO_SIMPLE_PLAYER_RESAMPLE_DEST_RATE=16000
CONFIG_ESP_AUDIO_SIMPLE_PLAYER_CH_CVT_EN=y
CONFIG_AUDIO_SIMPLE_PLAYER_CH_CVT_DEST=1
CONFIG_ESP_AUDIO_SIMPLE_PLAYER_BIT_CVT_EN=y
CONFIG_AUDIO_SIMPLE_PLAYER_BIT_CVT_DEST_16BIT=y

# Agents
CONFIG_EXAMPLE_ENABLE_AGENTS=y
# Agent - Coze
CONFIG_MBEDTLS_DYNAMIC_BUFFER=n
# Agent - Openai
CONFIG_WS_BUFFER_SIZE=2048
# Agent - XiaoZhi
CONFIG_EXAMPLE_AGENTS_ENABLE_XIAOZHI=y

# Expression
CONFIG_EXAMPLE_EXPRESSIONS_ENABLE_EMOTE=y
CONFIG_MMAP_FILE_NAME_LENGTH=32
```

## examples/service_console/main/Kconfig.projbuild
```kconfig
menu "Example Configuration"
    config EXAMPLE_ENABLE_BOARD_MANAGER
        bool "Enable board manager"
        default n

    config EXAMPLE_BOARD_MANAGER_INIT_CORE_ID
        int "The core ID to initialize the board manager"
        depends on EXAMPLE_ENABLE_BOARD_MANAGER
        range 0 1
        default 1
        help
            The core ID to initialize the board manager.

    menu "Console"
        config CONSOLE_STORE_HISTORY
            bool "Store command history in flash"
            default y
            help
                Linenoise line editing library provides functions to save and load
                command history. If this option is enabled, initializes a FAT filesystem
                and uses it to store command history.

        config CONSOLE_MAX_COMMAND_LINE_LENGTH
            int "Maximum command line length"
            default 1024
            help
                This value marks the maximum length of a single command line. Once it is
                reached, no more characters will be accepted by the console.
    endmenu

    menu "Services"
        config EXAMPLE_SERVICES_ENABLE_NVS
            bool "Enable NVS service"
            select BROOKESIA_SERVICE_NVS_ENABLE_AUTO_REGISTER
            default y

        config EXAMPLE_SERVICES_ENABLE_SNTP
            bool "Enable SNTP service"
            select BROOKESIA_SERVICE_SNTP_ENABLE_AUTO_REGISTER
            default n if IDF_TARGET_ESP32P4
            default y

        config EXAMPLE_SERVICES_ENABLE_WIFI
            bool "Enable WiFi service"
            select BROOKESIA_SERVICE_WIFI_ENABLE_AUTO_REGISTER
            default n if IDF_TARGET_ESP32P4
            default y

        config EXAMPLE_SERVICES_ENABLE_AUDIO
            bool "Enable audio service"
            depends on EXAMPLE_ENABLE_BOARD_MANAGER
            select BROOKESIA_SERVICE_AUDIO_ENABLE_AUTO_REGISTER
            default n
    endmenu

    menuconfig EXAMPLE_ENABLE_AGENTS
        bool "Agents"
        depends on EXAMPLE_ENABLE_BOARD_MANAGER
        select EXAMPLE_SERVICES_ENABLE_WIFI
        select EXAMPLE_SERVICES_ENABLE_SNTP
        select EXAMPLE_SERVICES_ENABLE_AUDIO
        select BROOKESIA_AGENT_MANAGER_ENABLE_AUTO_REGISTER
        default n

    if EXAMPLE_ENABLE_AGENTS
        config EXAMPLE_AGENTS_ENABLE_WAKEUP_WORD
            bool "Enable wakeup word"
            default y

        menuconfig EXAMPLE_AGENTS_ENABLE_COZE
            bool "Enable Coze agent"
            select BROOKESIA_AGENT_COZE_ENABLE_AUTO_REGISTER
            default n

        if EXAMPLE_AGENTS_ENABLE_COZE
            config EXAMPLE_AGENTS_COZE_APP_ID
                string "App ID"
                default "110049xxxxxxx"

            config EXAMPLE_AGENTS_COZE_PUBLIC_KEY
                string "Public key"
                default "lsKjtB67xxxxxxxxxxxxxxxxxxxxxxxxxxxxxxxxxxx"

            config EXAMPLE_AGENTS_COZE_PRIVATE_KEY_FILE_PATH
                string "Private key"
                default "./private_key.pem"

            config EXAMPLE_AGENTS_COZE_CUSTOM_CONSUMER
                string "Custom consumer (Optional)"
                default ""

            menuconfig EXAMPLE_AGENTS_COZE_BOT1_ENABLE
                bool "Bot 1"
                default y

            if EXAMPLE_AGENTS_COZE_BOT1_ENABLE
                config EXAMPLE_AGENTS_COZE_BOT1_NAME
                    string "Bot name"
                    default "Lin Jia Nv Hai"

                config EXAMPLE_AGENTS_COZE_BOT1_ID
                    string "Bot ID"
                    default "7516538xxxxxxxxxxxx"

                config EXAMPLE_AGENTS_COZE_BOT1_DESCRIPTION
                    string "Bot description"
                    default "A warm-voiced female AI character who listens to the user's thoughts and offers comforting responses."

                config EXAMPLE_AGENTS_COZE_BOT1_VOICE_ID
                    string "Bot voice ID"
                    default "7426720361733144585"
            endif

            menuconfig EXAMPLE_AGENTS_COZE_BOT2_ENABLE
                bool "Bot 2"
                default n

            if EXAMPLE_AGENTS_COZE_BOT2_ENABLE
                config EXAMPLE_AGENTS_COZE_BOT2_NAME
                    string "Bot name"
                    default "Wan Qu Da Shu"

                config EXAMPLE_AGENTS_COZE_BOT2_ID
                    string "Bot ID"
                    default "7516538xxxxxxxxxxxx"

                config EXAMPLE_AGENTS_COZE_BOT2_DESCRIPTION
                    string "Bot description"
                    default "A male AI character with a regional accent. He responds quickly and concisely, but does not perform actions on behalf of the user."

                config EXAMPLE_AGENTS_COZE_BOT2_VOICE_ID
                    string "Bot voice ID"
                    default "7426720361732915209"
            endif
        endif

        menuconfig EXAMPLE_AGENTS_ENABLE_OPENAI
            bool "Enable OpenAI agent"
            select BROOKESIA_AGENT_OPENAI_ENABLE_AUTO_REGISTER
            default n

        if EXAMPLE_AGENTS_ENABLE_OPENAI
            config EXAMPLE_AGENTS_OPENAI_API_KEY
                string "API key"
                default "sk-proj-xxx"

            config EXAMPLE_AGENTS_OPENAI_MODEL
                string "Model"
                default "gpt-4o-realtime-preview"
        endif

        menuconfig EXAMPLE_AGENTS_ENABLE_XIAOZHI
            bool "Enable Xiaozhi agent"
            select BROOKESIA_AGENT_XIAOZHI_ENABLE_AUTO_REGISTER
            default n
    endif

    menu "Expressions"
        config EXAMPLE_EXPRESSIONS_ENABLE_EMOTE
            bool "Enable Emote expression"
            select BROOKESIA_EXPRESSION_EMOTE_ENABLE_AUTO_REGISTER
            default n
    endmenu
endmenu
```

## examples/service_console/sdkconfig.defaults
```kconfig
CONFIG_FREERTOS_HZ=1000
CONFIG_ESP_MAIN_TASK_STACK_SIZE=10240
CONFIG_ESP_SYSTEM_EVENT_TASK_STACK_SIZE=3072
CONFIG_ESPTOOLPY_FLASHSIZE_8MB=y

CONFIG_PARTITION_TABLE_CUSTOM=y
CONFIG_PARTITION_TABLE_CUSTOM_FILENAME="partitions_8m.csv"
CONFIG_PARTITION_TABLE_FILENAME="partitions_8m.csv"

CONFIG_CONSOLE_STORE_HISTORY=y
CONFIG_ESP_CONSOLE_SECONDARY_NONE=y

CONFIG_SR_WN_WN9_HILEXIN=y
CONFIG_SR_WN_WN9_NIHAOMIAOBAN_TTS2=y
CONFIG_COMPILER_OPTIMIZATION_PERF=y

CONFIG_ESP_INT_WDT_TIMEOUT_MS=2000
CONFIG_ESP_TASK_WDT_TIMEOUT_S=10

CONFIG_FATFS_LFN_HEAP=y
CONFIG_FATFS_USE_LABEL=y

CONFIG_ESP_TLS_USE_DS_PERIPHERAL=n
CONFIG_ESP_TLS_INSECURE=y
CONFIG_ESP_TLS_SKIP_SERVER_CERT_VERIFY=y

CONFIG_ESP_WIFI_DYNAMIC_RX_MGMT_BUFFER=y
CONFIG_ESP_WIFI_TX_BA_WIN=16
CONFIG_ESP_WIFI_RX_BA_WIN=6
CONFIG_ESP_WIFI_IRAM_OPT=n
CONFIG_ESP_WIFI_RX_IRAM_OPT=n

# For Rainmaker Agent
CONFIG_WS_BUFFER_SIZE=2048
CONFIG_ESP_WS_CLIENT_SEPARATE_TX_LOCK=y

# For Coze Agent
CONFIG_ESP_WS_CLIENT_SEPARATE_TX_LOCK=y

CONFIG_LWIP_TCP_SND_BUF_DEFAULT=65535
CONFIG_LWIP_TCP_RECVMBOX_SIZE=10
CONFIG_LWIP_TCP_ACCEPTMBOX_SIZE=8
CONFIG_LWIP_TCP_OOSEQ_MAX_PBUFS=6
CONFIG_LWIP_SNTP_MAX_SERVERS=4
CONFIG_LWIP_SNTP_STARTUP_DELAY=n
CONFIG_LWIP_DHCP_GET_NTP_SRV=y
CONFIG_LWIP_DHCP_MAX_NTP_SERVERS=4
CONFIG_LWIP_FALLBACK_DNS_SERVER_SUPPORT=y
CONFIG_LWIP_DNS_SETSERVER_WITH_NETIF=y
CONFIG_MBEDTLS_EXTERNAL_MEM_ALLOC=y
CONFIG_MBEDTLS_DYNAMIC_BUFFER=y
CONFIG_MBEDTLS_SSL_KEEP_PEER_CERTIFICATE=n

CONFIG_BOOST_MATH_ENABLED=n
CONFIG_BOOST_SERIALIZATION_ENABLED=n

CONFIG_BROOKESIA_UTILS_THREAD_PROFILER_ENABLE_FREERTOS_CONFIG=y
```

## examples/service_console/sdkconfig.defaults.esp32p4
```kconfig
CONFIG_SPIRAM=y
CONFIG_SPIRAM_MODE_HEX=y
CONFIG_SPIRAM_SPEED_200M=y
CONFIG_SPIRAM_XIP_FROM_PSRAM=y
CONFIG_SPIRAM_MALLOC_ALWAYSINTERNAL=0
CONFIG_SPIRAM_TRY_ALLOCATE_WIFI_LWIP=y
CONFIG_SPIRAM_ALLOW_BSS_SEG_EXTERNAL_MEMORY=y
CONFIG_SPIRAM_ALLOW_NOINIT_SEG_EXTERNAL_MEMORY=y

CONFIG_CACHE_L2_CACHE_256KB=y
CONFIG_CACHE_L2_CACHE_LINE_128B=y

#CONFIG_ESP_CONSOLE_USB_SERIAL_JTAG=y
CONFIG_COMPILER_OPTIMIZATION_PERF=y
CONFIG_IDF_EXPERIMENTAL_FEATURES=y

# When running CI, CONFIG_IDF_CI_BUILD is automatically enabled, which causes CONFIG_ESP32P4_SELECTS_REV_LESS_V3=n
# so we manually enable it here
CONFIG_ESP32P4_SELECTS_REV_LESS_V3=y
```
