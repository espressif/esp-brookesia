## hal/brookesia_hal_adaptor/Kconfig
```kconfig
menu "ESP-Brookesia: Hal Adaptor Configurations"
    menuconfig BROOKESIA_HAL_ADAPTOR_ENABLE_DEBUG_LOG
        bool "Enable debug or lower level logs"
        default n

    if BROOKESIA_HAL_ADAPTOR_ENABLE_DEBUG_LOG
        menu "System"
            config BROOKESIA_HAL_ADAPTOR_SYSTEM_DEVICE_ENABLE_DEBUG_LOG
                bool "Device"
                default n
                help
                    Enable debug or lower level logs for the system device.

            config BROOKESIA_HAL_ADAPTOR_SYSTEM_BOARD_INFO_IMPL_ENABLE_DEBUG_LOG
                bool "Board Info"
                default n
                help
                    Enable debug or lower level logs for the board info implementation.

            config BROOKESIA_HAL_ADAPTOR_SYSTEM_OTA_UPDATER_IMPL_ENABLE_DEBUG_LOG
                bool "OTA Updater"
                default n
                help
                    Enable debug or lower level logs for the OTA updater implementation.
        endmenu

        menu "Network"
            config BROOKESIA_HAL_ADAPTOR_NETWORK_DEVICE_ENABLE_DEBUG_LOG
                bool "Device"
                default n
                help
                    Enable debug or lower level logs for the network device.

            config BROOKESIA_HAL_ADAPTOR_NETWORK_SNTP_CLIENT_IMPL_ENABLE_DEBUG_LOG
                bool "SNTP Client"
                default n
                help
                    Enable debug or lower level logs for the SNTP client implementation.

            config BROOKESIA_HAL_ADAPTOR_NETWORK_HTTP_CLIENT_IMPL_ENABLE_DEBUG_LOG
                bool "HTTP Client"
                default n
                help
                    Enable debug or lower level logs for the HTTP client implementation.
        endmenu

        menu "Audio"
            config BROOKESIA_HAL_ADAPTOR_AUDIO_DEVICE_ENABLE_DEBUG_LOG
                bool "Device"
                default n
                help
                    Enable debug or lower level logs for the audio device.

            config BROOKESIA_HAL_ADAPTOR_AUDIO_CODEC_PLAYER_IMPL_ENABLE_DEBUG_LOG
                bool "Codec Player"
                default n
                help
                    Enable debug or lower level logs for the audio codec player.

            config BROOKESIA_HAL_ADAPTOR_AUDIO_CODEC_RECORDER_IMPL_ENABLE_DEBUG_LOG
                bool "Codec Recorder"
                default n
                help
                    Enable debug or lower level logs for the audio codec recorder.

            config BROOKESIA_HAL_ADAPTOR_AUDIO_PROCESSOR_IMPL_ENABLE_DEBUG_LOG
                bool "Processor"
                default n
                help
                    Enable debug or lower level logs for the audio processor implementation.
        endmenu

        menu "Video"
            config BROOKESIA_HAL_ADAPTOR_VIDEO_DEVICE_ENABLE_DEBUG_LOG
                bool "Device"
                default n
                help
                    Enable debug or lower level logs for the video device.

            config BROOKESIA_HAL_ADAPTOR_VIDEO_ENCODER_IMPL_ENABLE_DEBUG_LOG
                bool "Encoder"
                default n
                help
                    Enable debug or lower level logs for the video encoder implementation.

            config BROOKESIA_HAL_ADAPTOR_VIDEO_DECODER_IMPL_ENABLE_DEBUG_LOG
                bool "Decoder"
                default n
                help
                    Enable debug or lower level logs for the video decoder implementation.
        endmenu

        menu "Display"
            config BROOKESIA_HAL_ADAPTOR_DISPLAY_DEVICE_ENABLE_DEBUG_LOG
                bool "Device"
                default n
                help
                    Enable debug or lower level logs for the display device.

            config BROOKESIA_HAL_ADAPTOR_DISPLAY_LEDC_BACKLIGHT_IMPL_ENABLE_DEBUG_LOG
                bool "LEDC Backlight"
                default n
                help
                    Enable debug or lower level logs for the display LEDC backlight.

            config BROOKESIA_HAL_ADAPTOR_DISPLAY_LCD_PANEL_IMPL_ENABLE_DEBUG_LOG
                bool "LCD Panel"
                default n
                help
                    Enable debug or lower level logs for the display LCD panel.

            config BROOKESIA_HAL_ADAPTOR_DISPLAY_LCD_TOUCH_IMPL_ENABLE_DEBUG_LOG
                bool "LCD Touch"
                default n
                help
                    Enable debug or lower level logs for the display LCD touch.
        endmenu

        menu "Storage"
            config BROOKESIA_HAL_ADAPTOR_STORAGE_DEVICE_ENABLE_DEBUG_LOG
                bool "Device"
                default n
                help
                    Enable debug or lower level logs for the storage device.

            config BROOKESIA_HAL_ADAPTOR_STORAGE_FILE_SYSTEM_ENABLE_DEBUG_LOG
                bool "File System"
                default n
                help
                    Enable debug or lower level logs for the storage file system implementation.

            config BROOKESIA_HAL_ADAPTOR_STORAGE_KEY_VALUE_ENABLE_DEBUG_LOG
                bool "Key-Value"
                default n
                help
                    Enable debug or lower level logs for the storage key-value implementation.
        endmenu

        menu "Wi-Fi"
            config BROOKESIA_HAL_ADAPTOR_WIFI_DEVICE_ENABLE_DEBUG_LOG
                bool "Device"
                default n
                help
                    Enable debug or lower level logs for the Wi-Fi device.

            config BROOKESIA_HAL_ADAPTOR_WIFI_BACKEND_ENABLE_DEBUG_LOG
                bool "ESP-IDF backend"
                default n
                help
                    Enable debug or lower level logs for the Wi-Fi ESP-IDF backend.
        endmenu

        menu "Power"
            config BROOKESIA_HAL_ADAPTOR_POWER_DEVICE_ENABLE_DEBUG_LOG
                bool "Device"
                default n
                help
                    Enable debug or lower level logs for the power device.

            config BROOKESIA_HAL_ADAPTOR_BATTERY_AXP2101_IMPL_ENABLE_DEBUG_LOG
                bool "Battery AXP2101"
                default n
                help
                    Enable debug or lower level logs for the battery AXP2101.

            config BROOKESIA_HAL_ADAPTOR_BATTERY_ADC_IMPL_ENABLE_DEBUG_LOG
                bool "Battery ADC"
                default n
                help
                    Enable debug or lower level logs for the battery ADC.
        endmenu

    endif

    menuconfig BROOKESIA_HAL_ADAPTOR_ENABLE_SYSTEM_DEVICE
        bool "System Device"
        default n
        help
            Enable the system device.

    if BROOKESIA_HAL_ADAPTOR_ENABLE_SYSTEM_DEVICE
        menuconfig BROOKESIA_HAL_ADAPTOR_SYSTEM_ENABLE_BOARD_INFO_IMPL
            bool "Board Info"
            default n
            help
                Enable the board info.

        menuconfig BROOKESIA_HAL_ADAPTOR_SYSTEM_ENABLE_OTA_UPDATER_IMPL
            bool "OTA Updater"
            default n
            help
                Enable the OTA updater implementation.

        if BROOKESIA_HAL_ADAPTOR_SYSTEM_ENABLE_OTA_UPDATER_IMPL
            config BROOKESIA_HAL_ADAPTOR_SYSTEM_OTA_UPDATER_THREAD_STACK_SIZE
                int "OTA updater internal-stack thread stack size"
                default 10240
                help
                    Stack size for OTA updater work that must run outside external RAM.
        endif
    endif

    menuconfig BROOKESIA_HAL_ADAPTOR_ENABLE_NETWORK_DEVICE
        bool "Network Device"
        default n
        help
            Enable the network protocol device.

    if BROOKESIA_HAL_ADAPTOR_ENABLE_NETWORK_DEVICE
        menuconfig BROOKESIA_HAL_ADAPTOR_NETWORK_ENABLE_SNTP_CLIENT_IMPL
            bool "SNTP Client"
            default n
            help
                Enable the SNTP client implementation.

        menuconfig BROOKESIA_HAL_ADAPTOR_NETWORK_ENABLE_HTTP_CLIENT_IMPL
            bool "HTTP Client"
            default n
            help
                Enable the HTTP client implementation.

        if BROOKESIA_HAL_ADAPTOR_NETWORK_ENABLE_HTTP_CLIENT_IMPL
            config BROOKESIA_HAL_ADAPTOR_NETWORK_HTTP_CLIENT_REQUIRE_TLS_VERIFY
                bool "Require TLS verification by default"
                default y
                help
                    Verify HTTPS server certificates when a request uses the default TLS policy.
        endif
    endif

    menuconfig BROOKESIA_HAL_ADAPTOR_ENABLE_AUDIO_DEVICE
        bool "Audio Device"
        default n
        help
            Enable the audio codec device.

    if BROOKESIA_HAL_ADAPTOR_ENABLE_AUDIO_DEVICE
        menuconfig BROOKESIA_HAL_ADAPTOR_AUDIO_ENABLE_CODEC_PLAYER_IMPL
            bool "Codec Player"
            depends on ESP_BOARD_DEV_AUDIO_CODEC_SUPPORT
            default n
            help
                Enable the player.

        menuconfig BROOKESIA_HAL_ADAPTOR_AUDIO_ENABLE_CODEC_RECORDER_IMPL
            bool "Codec Recorder"
            depends on ESP_BOARD_DEV_AUDIO_CODEC_SUPPORT
            default n
            help
                Enable the recorder.

        menuconfig BROOKESIA_HAL_ADAPTOR_AUDIO_ENABLE_PROCESSOR_IMPL
            bool "Audio Processor"
            depends on BROOKESIA_HAL_ADAPTOR_AUDIO_ENABLE_CODEC_PLAYER_IMPL
            depends on BROOKESIA_HAL_ADAPTOR_AUDIO_ENABLE_CODEC_RECORDER_IMPL
            default y
            help
                Enable the high-level audio processor backed by av_processor.

        if BROOKESIA_HAL_ADAPTOR_AUDIO_ENABLE_CODEC_RECORDER_IMPL
            config BROOKESIA_HAL_ADAPTOR_AUDIO_CODEC_RECORDER_BITS
                int "Recorder bits"
                default 16
                help
                    The bits of the audio codec device.

            config BROOKESIA_HAL_ADAPTOR_AUDIO_CODEC_RECORDER_CHANNELS
                int "Recorder channels"
                default 1
                help
                    The channels of the audio codec device.

            config BROOKESIA_HAL_ADAPTOR_AUDIO_CODEC_RECORDER_SAMPLE_RATE
                int "Sample rate"
                default 16000
                help
                    The sample rate of the audio codec device.

            config BROOKESIA_HAL_ADAPTOR_AUDIO_CODEC_RECORDER_MIC_LAYOUT
                string "Mic layout"
                default "M"
                help
                    The mic layout of the audio codec device.

            config BROOKESIA_HAL_ADAPTOR_AUDIO_CODEC_RECORDER_GENERAL_GAIN
                string "General gain"
                default "36.0"
                help
                    The general gain of the audio codec device, in dB.

            config BROOKESIA_HAL_ADAPTOR_AUDIO_CODEC_RECORDER_CHANNEL_GAINS
                string "Channel gains"
                default "{\"0\":0.0,\"1\":0.0}"
                help
                    The channel gains of the audio codec device, in dB.
                    JSON format is supported, the key is the channel index, the value is the gain in dB.
        endif
    endif

    menuconfig BROOKESIA_HAL_ADAPTOR_ENABLE_VIDEO_DEVICE
        bool "Video Device"
        default n
        help
            Enable the video processor device backed by av_processor.

    if BROOKESIA_HAL_ADAPTOR_ENABLE_VIDEO_DEVICE
        config BROOKESIA_HAL_ADAPTOR_VIDEO_KEEP_DEVICE_INITIALIZED_ON_RELEASE
            bool "Keep video device initialized after release"
            default y
            help
                Keep the video device initialized when its HAL reference count drops to zero.
                This avoids repeated camera/esp_video init-deinit cycles for expensive or non-idempotent camera drivers.
                The device is still deinitialized by force cleanup or process exit.

        menuconfig BROOKESIA_HAL_ADAPTOR_VIDEO_ENABLE_CAMERA_IMPL
            bool "Camera"
            default y
            help
                Enable the video camera discovery implementation.

        menuconfig BROOKESIA_HAL_ADAPTOR_VIDEO_ENABLE_ENCODER_IMPL
            bool "Encoder"
            default y
            help
                Enable the video encoder implementation.

        if BROOKESIA_HAL_ADAPTOR_VIDEO_ENABLE_ENCODER_IMPL
            config BROOKESIA_HAL_ADAPTOR_VIDEO_ENCODER_DEFAULT_DEVICE_PATH_PREFIX
                string "Default device path prefix"
                default "/dev/video"
                help
                    The default device path prefix of the encoders.

            config BROOKESIA_HAL_ADAPTOR_VIDEO_ENCODER_DEFAULT_NUM
                int "Default number of encoders"
                default 1
                range 1 3
                help
                    The default number of encoder HAL interfaces to register.
        endif

        menuconfig BROOKESIA_HAL_ADAPTOR_VIDEO_ENABLE_DECODER_IMPL
            bool "Decoder"
            default y
            help
                Enable the video decoder implementation.

        if BROOKESIA_HAL_ADAPTOR_VIDEO_ENABLE_DECODER_IMPL
            config BROOKESIA_HAL_ADAPTOR_VIDEO_DECODER_DEFAULT_NUM
                int "Default number of decoders"
                default 1
                range 1 3
                help
                    The default number of decoder HAL interfaces to register.
        endif
    endif

    menuconfig BROOKESIA_HAL_ADAPTOR_ENABLE_DISPLAY_DEVICE
        bool "Display Device"
        default n
        help
            Enable the display LCD device.

    if BROOKESIA_HAL_ADAPTOR_ENABLE_DISPLAY_DEVICE
        menuconfig BROOKESIA_HAL_ADAPTOR_DISPLAY_ENABLE_LEDC_BACKLIGHT_IMPL
            bool "LEDC Backlight"
            depends on ESP_BOARD_DEV_LEDC_CTRL_SUPPORT
            default n
            help
                Enable the LEDC backlight.

        menuconfig BROOKESIA_HAL_ADAPTOR_DISPLAY_ENABLE_LCD_PANEL_IMPL
            bool "LCD Panel"
            depends on ESP_BOARD_DEV_DISPLAY_LCD_SUPPORT
            default n
            help
                Enable the LCD panel.

        if BROOKESIA_HAL_ADAPTOR_DISPLAY_ENABLE_LCD_PANEL_IMPL
            config BROOKESIA_HAL_ADAPTOR_DISPLAY_LCD_PANEL_H_RES
                int "Horizontal resolution in pixels"
                default 0
                range 0 65535
                help
                    The horizontal resolution of the display LCD panel, in pixels.
                    This value is used to provide the LCD panel resolution information for the CMake stage.

            config BROOKESIA_HAL_ADAPTOR_DISPLAY_LCD_PANEL_V_RES
                int "Vertical resolution in pixels"
                default 0
                range 0 65535
                help
                    The vertical resolution of the display LCD panel, in pixels.
                    This value is used to provide the LCD panel resolution information for the CMake stage.

            config BROOKESIA_HAL_ADAPTOR_DISPLAY_LCD_PANEL_DRAW_X_ALIGN_BYTES
                int "X-axis coordinate alignment bytes"
                default 1
                range 0 16
                help
                    The X-axis coordinate alignment bytes of the display LCD panel.

            config BROOKESIA_HAL_ADAPTOR_DISPLAY_LCD_PANEL_DRAW_Y_ALIGN_BYTES
                int "Y-axis coordinate alignment bytes"
                default 1
                range 0 16
                help
                    The Y-axis coordinate alignment bytes of the display LCD panel.

            config BROOKESIA_HAL_ADAPTOR_DISPLAY_LCD_PANEL_INIT_THREAD_CORE_ID
                int "Init thread core ID"
                default 0
                help
                    The core ID used to run `esp_board_manager_init_device_by_name()` for the LCD panel.
                    `-1` means run the init directly in the current thread.
                    This option only takes effect when the LCD panel bus type is Generic.
        endif

        menuconfig BROOKESIA_HAL_ADAPTOR_DISPLAY_ENABLE_LCD_TOUCH_IMPL
            bool "LCD Touch"
            depends on ESP_BOARD_DEV_LCD_TOUCH_I2C_SUPPORT
            default n
            help
                Enable the LCD touch.
    endif

    menuconfig BROOKESIA_HAL_ADAPTOR_ENABLE_STORAGE_DEVICE
        bool "Storage Device"
        default n
        help
            Enable the storage device.

    if BROOKESIA_HAL_ADAPTOR_ENABLE_STORAGE_DEVICE
        menuconfig BROOKESIA_HAL_ADAPTOR_STORAGE_ENABLE_FILE_SYSTEM_IMPL
            bool "File System"
            default n
            help
                Enable the storage file system.

        if BROOKESIA_HAL_ADAPTOR_STORAGE_ENABLE_FILE_SYSTEM_IMPL
            config BROOKESIA_HAL_ADAPTOR_STORAGE_FILE_SYSTEM_ENABLE_SPIFFS
                bool "SPIFFS"
                depends on ESP_BOARD_DEV_FS_SPIFFS_SUPPORT
                default n
                help
                    Enable the SPIFFS.

            config BROOKESIA_HAL_ADAPTOR_STORAGE_FILE_SYSTEM_ENABLE_LITTLEFS
                bool "LittleFS"
                default n
                help
                    Enable the LittleFS.

            if BROOKESIA_HAL_ADAPTOR_STORAGE_FILE_SYSTEM_ENABLE_LITTLEFS
                config BROOKESIA_HAL_ADAPTOR_STORAGE_FILE_SYSTEM_LITTLEFS_BASE_PATH
                    string "LittleFS base path"
                    default "/littlefs"
                    help
                        Base path used to mount the LittleFS filesystem.

                config BROOKESIA_HAL_ADAPTOR_STORAGE_FILE_SYSTEM_LITTLEFS_PARTITION_LABEL
                    string "LittleFS partition label"
                    default "littlefs_data"
                    help
                        Partition label used to mount the LittleFS filesystem.

                config BROOKESIA_HAL_ADAPTOR_STORAGE_FILE_SYSTEM_LITTLEFS_FORMAT_IF_MOUNT_FAILED
                    bool "Format LittleFS if mount failed"
                    default n
                    help
                        Format the LittleFS partition when mount fails.
            endif

            config BROOKESIA_HAL_ADAPTOR_STORAGE_FILE_SYSTEM_ENABLE_FATFS_FLASH
                bool "Flash FATFS"
                default n
                help
                    Enable the flash FATFS filesystem mounted through wear levelling.

            if BROOKESIA_HAL_ADAPTOR_STORAGE_FILE_SYSTEM_ENABLE_FATFS_FLASH
                config BROOKESIA_HAL_ADAPTOR_STORAGE_FILE_SYSTEM_FATFS_FLASH_BASE_PATH
                    string "Flash FATFS base path"
                    default "/fatfs"
                    help
                        Base path used to mount the flash FATFS filesystem.

                config BROOKESIA_HAL_ADAPTOR_STORAGE_FILE_SYSTEM_FATFS_FLASH_PARTITION_LABEL
                    string "Flash FATFS partition label"
                    default "fatfs_data"
                    help
                        Partition label used to mount the flash FATFS filesystem.

                config BROOKESIA_HAL_ADAPTOR_STORAGE_FILE_SYSTEM_FATFS_FLASH_FORMAT_IF_MOUNT_FAILED
                    bool "Format flash FATFS if mount failed"
                    default n
                    help
                        Format the flash FATFS partition when mount fails.

                config BROOKESIA_HAL_ADAPTOR_STORAGE_FILE_SYSTEM_FATFS_FLASH_MAX_FILES
                    int "Flash FATFS max open files"
                    default 4
                    range 1 16
                    help
                        Maximum number of files that can be open at the same time.
            endif

            config BROOKESIA_HAL_ADAPTOR_STORAGE_FILE_SYSTEM_ENABLE_SDCARD
                bool "SD card (FATFS)"
                depends on ESP_BOARD_DEV_FS_FAT_SUPPORT
                default n
                help
                    Enable the SD card (FATFS).
        endif

        menuconfig BROOKESIA_HAL_ADAPTOR_STORAGE_ENABLE_KEY_VALUE_IMPL
            bool "Key-value storage"
            default n
            help
                Enable the storage key-value implementation backed by ESP-IDF NVS.
    endif

    menuconfig BROOKESIA_HAL_ADAPTOR_ENABLE_POWER_DEVICE
        bool "Power Device"
        default n
        help
            Enable the power device.

    if BROOKESIA_HAL_ADAPTOR_ENABLE_POWER_DEVICE
        menuconfig BROOKESIA_HAL_ADAPTOR_POWER_ENABLE_BATTERY
            bool "Battery"
            default n
            help
                Enable the battery.

        if BROOKESIA_HAL_ADAPTOR_POWER_ENABLE_BATTERY
            choice BROOKESIA_HAL_ADAPTOR_POWER_BATTERY_IMPL_CHOICE
                prompt "Select implementation"
                default BROOKESIA_HAL_ADAPTOR_POWER_BATTERY_IMPL_ADC

                config BROOKESIA_HAL_ADAPTOR_POWER_BATTERY_IMPL_AXP2101
                    bool "AXP2101"
                    help
                        Enable the battery AXP2101.

                config BROOKESIA_HAL_ADAPTOR_POWER_BATTERY_IMPL_ADC
                    bool "ADC"
                    help
                        Enable the battery ADC.
            endchoice

            config BROOKESIA_HAL_ADAPTOR_POWER_BATTERY_LOW_VOLTAGE_MV
                int "Low voltage threshold (mV)"
                default 3500
                range 0 65535
                help
                    Voltage threshold used to report the low battery state.

            config BROOKESIA_HAL_ADAPTOR_POWER_BATTERY_CRITICAL_VOLTAGE_MV
                int "Critical voltage threshold (mV)"
                default 3300
                range 0 65535
                help
                    Voltage threshold used to report the critical battery state.

            if BROOKESIA_HAL_ADAPTOR_POWER_BATTERY_IMPL_ADC
                config BROOKESIA_HAL_ADAPTOR_POWER_BATTERY_ADC_VOLTAGE_SCALE_MUL
                    int "ADC voltage scale multiplier"
                    default 2
                    range 1 65535
                    help
                        Multiplier applied to the calibrated ADC voltage reading.

                config BROOKESIA_HAL_ADAPTOR_POWER_BATTERY_ADC_VOLTAGE_SCALE_DIV
                    int "ADC voltage scale divider"
                    default 1
                    range 1 65535
                    help
                        Divider applied to the calibrated ADC voltage reading.

                config BROOKESIA_HAL_ADAPTOR_POWER_BATTERY_ADC_CHARGE_DETECT_MV
                    int "ADC charge detect voltage threshold (mV)"
                    default 1000
                    range 0 65535
                    help
                        The ADC charge voltage is considered charging when it is at or below this threshold.

                config BROOKESIA_HAL_ADAPTOR_POWER_BATTERY_ADC_SAMPLE_COUNT
                    int "ADC sample count"
                    default 8
                    range 1 1024
                    help
                        Number of ADC raw samples used to calculate the average voltage for each read.

                config BROOKESIA_HAL_ADAPTOR_POWER_BATTERY_ADC_RAW_MAX
                    int "ADC raw maximum value"
                    default 4095
                    range 1 65535
                    help
                        Maximum ADC raw value used by the fallback raw-to-voltage conversion.

                config BROOKESIA_HAL_ADAPTOR_POWER_BATTERY_ADC_REF_VOLTAGE_MV
                    int "ADC fallback reference voltage (mV)"
                    default 3300
                    range 1 65535
                    help
                        Reference voltage used by the fallback raw-to-voltage conversion when calibration is unavailable.

                config BROOKESIA_HAL_ADAPTOR_POWER_BATTERY_ADC_PERCENTAGE_VOLTAGE_MIN_MV
                    int "ADC percentage minimum voltage (mV)"
                    default 3300
                    range 0 65535
                    help
                        Battery voltage mapped to 0 percent when estimating the battery percentage from ADC voltage.

                config BROOKESIA_HAL_ADAPTOR_POWER_BATTERY_ADC_PERCENTAGE_VOLTAGE_MAX_MV
                    int "ADC percentage maximum voltage (mV)"
                    default 4200
                    range 0 65535
                    help
                        Battery voltage mapped to 100 percent when estimating the battery percentage from ADC voltage.
            endif
        endif
    endif

    menuconfig BROOKESIA_HAL_ADAPTOR_ENABLE_WIFI_DEVICE
        bool "Wi-Fi Device"
        default n
        help
            Enable the ESP-IDF Wi-Fi device and its Basic, STA, and SoftAP HAL interfaces.

    if BROOKESIA_HAL_ADAPTOR_ENABLE_WIFI_DEVICE
        menu "SoftAP"
            config BROOKESIA_HAL_ADAPTOR_WIFI_SOFTAP_CHANNEL_MIN
                int "Minimum channel"
                default 1
                range 1 11
                help
                    Minimum channel considered for SoftAP setup.

            config BROOKESIA_HAL_ADAPTOR_WIFI_SOFTAP_CHANNEL_MAX
                int "Maximum channel"
                default 11
                range 1 11
                help
                    Maximum channel considered for SoftAP setup.

            config BROOKESIA_HAL_ADAPTOR_WIFI_SOFTAP_CHANNEL_DEFAULT
                int "Default channel"
                default 1
                range 1 11
                help
                    Default SoftAP channel when no channel is specified and setup cannot scan.

            config BROOKESIA_HAL_ADAPTOR_WIFI_SOFTAP_SETUP_INTERVAL_MS
                int "Setup interval (ms)"
                default 1000
                range 100 10000
                help
                    Interval for the SoftAP setup task.

            config BROOKESIA_HAL_ADAPTOR_WIFI_SOFTAP_SETUP_TIMEOUT_MS
                int "Setup timeout (ms)"
                default 300000
                range 1000 600000
                help
                    Timeout in milliseconds for SoftAP setup.

            config BROOKESIA_HAL_ADAPTOR_WIFI_SOFTAP_EVENT_DELAY_MS
                int "Event delay (ms)"
                default 2000
                range 100 10000
                help
                    Delay in milliseconds before reporting a SoftAP event.

            menu "Provision"
                config BROOKESIA_HAL_ADAPTOR_WIFI_SOFTAP_PROVISION_SCAN_START_INTERVAL_MS
                    int "Provision scan start interval (ms)"
                    default 1000
                    range 100 10000
                    help
                        Interval for starting provision scans.

                config BROOKESIA_HAL_ADAPTOR_WIFI_SOFTAP_PROVISION_SCAN_TIMEOUT_MS
                    int "Provision scan timeout (ms)"
                    default 20000
                    range 1000 60000
                    help
                        Timeout in milliseconds while waiting for provision scan results.

                config BROOKESIA_HAL_ADAPTOR_WIFI_SOFTAP_PROVISION_SUCCESS_CLOSE_DELAY_MS
                    int "Provision close after success delay (ms)"
                    default 3000
                    range 100 10000
                    help
                        Delay in milliseconds before closing provision after a successful STA connection.

                menu "DNS Thread"
                    config BROOKESIA_HAL_ADAPTOR_WIFI_SOFTAP_PROVISION_DNS_THREAD_STACK_SIZE
                        int "Stack size"
                        default 4096
                        help
                            Stack size of the provision DNS thread.

                    config BROOKESIA_HAL_ADAPTOR_WIFI_SOFTAP_PROVISION_DNS_THREAD_PRIORITY
                        int "Priority"
                        default 3
                        help
                            Priority of the provision DNS thread.

                    config BROOKESIA_HAL_ADAPTOR_WIFI_SOFTAP_PROVISION_DNS_THREAD_CORE_ID
                        int "Core ID"
                        default -1
                        range -1 1
                        help
                            Core ID of the provision DNS thread. `-1` means the core ID is not specified.
                endmenu
            endmenu
        endmenu
    endif

endmenu
```
