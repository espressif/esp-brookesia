## examples/system/super/sdkconfig.defaults
```kconfig
CONFIG_FREERTOS_HZ=1000
CONFIG_COMPILER_OPTIMIZATION_SIZE=y
CONFIG_ESP_MAIN_TASK_STACK_SIZE=4096
CONFIG_ESP_INT_WDT_TIMEOUT_MS=2000
CONFIG_ESP_TASK_WDT_TIMEOUT_S=10

CONFIG_ESP_TLS_USE_DS_PERIPHERAL=n
CONFIG_ESP_TLS_INSECURE=y
CONFIG_ESP_TLS_SKIP_SERVER_CERT_VERIFY=y

CONFIG_LWIP_FALLBACK_DNS_SERVER_SUPPORT=y
CONFIG_LWIP_DNS_SETSERVER_WITH_NETIF=y
CONFIG_MBEDTLS_EXTERNAL_MEM_ALLOC=y
CONFIG_MBEDTLS_DYNAMIC_BUFFER=y
CONFIG_MBEDTLS_SSL_KEEP_PEER_CERTIFICATE=n

# LVGL Adapter
CONFIG_ESP_LVGL_ADAPTER_ENABLE_DECODER=y
CONFIG_ESP_LVGL_ADAPTER_ENABLE_FS=y
# LVGL
CONFIG_LV_CONF_MINIMAL=y
CONFIG_LV_TXT_ENC_UTF8=y
CONFIG_LV_USE_CLIB_MALLOC=y
CONFIG_LV_USE_CLIB_STRING=y
CONFIG_LV_USE_CLIB_SPRINTF=y
CONFIG_LV_DEF_REFR_PERIOD=15
CONFIG_LV_DPI_DEF=60
CONFIG_LV_DRAW_LAYER_SIMPLE_BUF_SIZE=48000
CONFIG_LV_DRAW_SW_SHADOW_CACHE_SIZE=4
CONFIG_LV_GRADIENT_MAX_STOPS=4
CONFIG_LV_OBJ_STYLE_CACHE=y
CONFIG_LV_USE_LOG=y
CONFIG_LV_LOG_PRINTF=y
CONFIG_LV_FS_STDIO_LETTER=65
CONFIG_LV_FS_POSIX_LETTER=65
CONFIG_LV_FS_DEFAULT_DRIVER_LETTER=65
CONFIG_LV_USE_LODEPNG=y

#CONFIG_BROOKESIA_GUI_INTERFACE_ENABLE_MEMORY_TRACE=y
#CONFIG_BROOKESIA_SYSTEM_HEAP_TRACE_APP_START=y

# Brookesia:Utils
CONFIG_BROOKESIA_UTILS_THREAD_PROFILER_ENABLE_FREERTOS_CONFIG=y

# Brookesia:Agent
# Coze
CONFIG_MBEDTLS_DYNAMIC_BUFFER=n
# XiaoZhi
CONFIG_XIAOZHI_AUDIO_TASK_ALLOC_DYNAMIC=y
CONFIG_XIAOZHI_STACK_IN_PSRAM=y
CONFIG_XIAOZHI_SYNC_SYSTEM_TIME_FROM_SERVER=n

# H264 (Save RAM and Flash)
CONFIG_ESP_H264_DECODER_IRAM=n
CONFIG_VIDEO_DECODER_SW_H264_SUPPORT=n
CONFIG_VIDEO_ENCODER_SW_H264_SUPPORT=n

# Audio Codec
CONFIG_AUDIO_DECODER_AAC_SUPPORT=n
CONFIG_AUDIO_DECODER_MP3_SUPPORT=y
CONFIG_AUDIO_DECODER_G711_SUPPORT=y
CONFIG_AUDIO_DECODER_AMRNB_SUPPORT=n
CONFIG_AUDIO_DECODER_AMRWB_SUPPORT=n
CONFIG_AUDIO_DECODER_FLAC_SUPPORT=n
CONFIG_AUDIO_DECODER_OPUS_SUPPORT=y
CONFIG_AUDIO_DECODER_VORBIS_SUPPORT=n
CONFIG_AUDIO_DECODER_ADPCM_SUPPORT=n
CONFIG_AUDIO_DECODER_ALAC_SUPPORT=n
CONFIG_AUDIO_DECODER_PCM_SUPPORT=y
CONFIG_AUDIO_DECODER_SBC_SUPPORT=n
CONFIG_AUDIO_DECODER_LC3_SUPPORT=n
CONFIG_AUDIO_DECODER_G722_SUPPORT=n
CONFIG_AUDIO_SIMPLE_DEC_WAV_SUPPORT=y
CONFIG_AUDIO_SIMPLE_DEC_M4A_SUPPORT=n
CONFIG_AUDIO_SIMPLE_DEC_TS_SUPPORT=n
CONFIG_AUDIO_SIMPLE_DEC_OGG_SUPPORT=n
CONFIG_AUDIO_ENCODER_AAC_SUPPORT=n
CONFIG_AUDIO_ENCODER_G711_SUPPORT=y
CONFIG_AUDIO_ENCODER_AMRNB_SUPPORT=n
CONFIG_AUDIO_ENCODER_AMRWB_SUPPORT=n
CONFIG_AUDIO_ENCODER_OPUS_SUPPORT=y
CONFIG_AUDIO_ENCODER_ADPCM_SUPPORT=n
CONFIG_AUDIO_ENCODER_ALAC_SUPPORT=n
CONFIG_AUDIO_ENCODER_PCM_SUPPORT=y
CONFIG_AUDIO_ENCODER_SBC_SUPPORT=n
CONFIG_AUDIO_ENCODER_LC3_SUPPORT=n
CONFIG_AUDIO_ENCODER_G722_SUPPORT=n
```

## examples/system/super/sdkconfig.defaults.esp32s3
```kconfig
CONFIG_COMPILER_OPTIMIZATION_PERF=y
CONFIG_SR_WN_WN9_HIESP=y

# Brookesia:System Super
CONFIG_BROOKESIA_SYSTEM_SUPER_ENABLE_APP_LAUNCH_ANIMATION=n
CONFIG_BROOKESIA_SYSTEM_SUPER_ENABLE_RESOURCE_FONT_COPY=n

## WiFi
#CONFIG_ESP_WIFI_STATIC_RX_BUFFER_NUM=6
#CONFIG_ESP_WIFI_STATIC_TX_BUFFER_NUM=6
#CONFIG_ESP_WIFI_DYNAMIC_RX_MGMT_BUFFER=y
#CONFIG_ESP_WIFI_TX_BA_WIN=16
#CONFIG_ESP_WIFI_RX_BA_WIN=8
#CONFIG_ESP_WIFI_IRAM_OPT=n
#CONFIG_ESP_WIFI_RX_IRAM_OPT=n
#CONFIG_LWIP_IRAM_OPTIMIZATION=n
#CONFIG_LWIP_TCP_RECVMBOX_SIZE=10
#CONFIG_LWIP_TCP_ACCEPTMBOX_SIZE=8
#CONFIG_LWIP_TCP_OOSEQ_MAX_PBUFS=6

# GUI
CONFIG_LV_CACHE_DEF_SIZE=512000
CONFIG_LV_IMAGE_HEADER_CACHE_DEF_CNT=16
CONFIG_LV_FONT_MONTSERRAT_8=y
CONFIG_LV_FONT_MONTSERRAT_12=y
CONFIG_LV_FONT_MONTSERRAT_16=y
CONFIG_LV_FONT_MONTSERRAT_20=y
CONFIG_LV_FONT_MONTSERRAT_24=y
CONFIG_LV_FONT_MONTSERRAT_28=y
CONFIG_LV_FONT_MONTSERRAT_32=y
CONFIG_LV_FONT_MONTSERRAT_36=y
CONFIG_LV_FONT_MONTSERRAT_40=y
CONFIG_LV_FONT_MONTSERRAT_44=y
CONFIG_LV_FONT_MONTSERRAT_48=y
CONFIG_BROOKESIA_GUI_LVGL_DISPLAY_SOURCE_BUFFER_HEIGHT=50
CONFIG_BROOKESIA_GUI_LVGL_DISPLAY_SOURCE_REQUIRE_DOUBLE_BUFFER=y
```

## expression/brookesia_expression_emote/Kconfig
```kconfig
menu "ESP-Brookesia: Expression Emote Configurations"
    config BROOKESIA_EXPRESSION_EMOTE_ENABLE_CONFIGS
        bool
        select LV_FONT_FMT_TXT_LARGE
        default y

    config BROOKESIA_EXPRESSION_EMOTE_ENABLE_AUTO_REGISTER
        bool "Enable automatic plugin registration"
        default y
        help
            Automatically register the expression as a plugin on startup.

    menuconfig BROOKESIA_EXPRESSION_EMOTE_ENABLE_DEBUG_LOG
        bool "Enable debug or lower level logs"
        default n
endmenu
```

## gui/brookesia_gui_interface/Kconfig
```kconfig
menu "ESP-Brookesia: GUI Interface Configurations"
    menuconfig BROOKESIA_GUI_INTERFACE_ENABLE_DEBUG_LOG
        bool "Enable debug or lower level logs"
        default n

    if BROOKESIA_GUI_INTERFACE_ENABLE_DEBUG_LOG
        config BROOKESIA_GUI_INTERFACE_DATA_STORE_ENABLE_DEBUG_LOG
            bool "Data store"
            default y

        config BROOKESIA_GUI_INTERFACE_PARSER_ENABLE_DEBUG_LOG
            bool "Parser"
            default y

        config BROOKESIA_GUI_INTERFACE_RUNTIME_ENABLE_DEBUG_LOG
            bool "Runtime"
            default y

        config BROOKESIA_GUI_INTERFACE_VALIDATOR_ENABLE_DEBUG_LOG
            bool "Validator"
            default y

        config BROOKESIA_GUI_INTERFACE_WIDGET_ENABLE_DEBUG_LOG
            bool "Widget"
            default y
    endif

    config BROOKESIA_GUI_INTERFACE_ENABLE_MEMORY_TRACE
        bool "Enable runtime memory/heap trace logs (profiling)"
        default n
        help
            When enabled, the GUI runtime emits detailed [HeapTrace] logs and
            per-substep PSRAM accounting while loading documents and creating
            views (e.g. gui.load.split, gui.create_view, gui.binding.signals).
            This is a profiling aid only; keep it disabled in production builds
            because the extra snapshots and logging add CPU and log overhead.

    config BROOKESIA_GUI_INTERFACE_ENABLE_PROFILE_LOG
        bool "Enable parser/runtime profile logs"
        default y if BROOKESIA_GUI_INTERFACE_ENABLE_MEMORY_TRACE
        default n
        help
            When enabled, the GUI parser and runtime emit stage-by-stage timing
            logs while loading JSON UI documents and building views. This is
            useful for startup latency diagnosis, but should stay disabled in
            normal builds because log formatting and serial output perturb the
            timings being measured.

    menuconfig BROOKESIA_GUI_INTERFACE_ENABLE_EXAMPLES
        bool "Enable JSON-UI example suite"
        default y
        help
            Master switch for the JSON-UI example plugins. Each example below can
            be toggled individually; disabled examples are not compiled, linked,
            or shown in the example menu.

    if BROOKESIA_GUI_INTERFACE_ENABLE_EXAMPLES
        menu "Document examples"
            config BROOKESIA_GUI_INTERFACE_EXAMPLE_DOCUMENT_ROOT
                bool "document.root"
                default y
            config BROOKESIA_GUI_INTERFACE_EXAMPLE_DOCUMENT_VARIANTS
                bool "document.variants"
                default y
            config BROOKESIA_GUI_INTERFACE_EXAMPLE_DOCUMENT_ENVIRONMENT
                bool "document.environment"
                default y
            config BROOKESIA_GUI_INTERFACE_EXAMPLE_DOCUMENT_CONSTANTS
                bool "document.constants"
                default y
        endmenu

        menu "Assets examples"
            config BROOKESIA_GUI_INTERFACE_EXAMPLE_ASSETS_CONSTANT
                bool "assets.constant"
                default y
            config BROOKESIA_GUI_INTERFACE_EXAMPLE_ASSETS_STYLESET
                bool "assets.styleset"
                default y
            config BROOKESIA_GUI_INTERFACE_EXAMPLE_ASSETS_THEME
                bool "assets.theme"
                default y
            config BROOKESIA_GUI_INTERFACE_EXAMPLE_ASSETS_TEMPLATE
                bool "assets.template"
                default y
        endmenu

        menu "View examples"
            config BROOKESIA_GUI_INTERFACE_EXAMPLE_VIEW_SCREEN
                bool "view.screen"
                default y
            config BROOKESIA_GUI_INTERFACE_EXAMPLE_VIEW_CONTAINER
                bool "view.container"
                default y
            config BROOKESIA_GUI_INTERFACE_EXAMPLE_VIEW_LABEL
                bool "view.label"
                default y
            config BROOKESIA_GUI_INTERFACE_EXAMPLE_VIEW_BUTTON
                bool "view.button"
                default y
            config BROOKESIA_GUI_INTERFACE_EXAMPLE_VIEW_IMAGE
                bool "view.image"
                default y
            config BROOKESIA_GUI_INTERFACE_EXAMPLE_VIEW_TEXT_INPUT
                bool "view.text_input"
                default y
            config BROOKESIA_GUI_INTERFACE_EXAMPLE_VIEW_SLIDER
                bool "view.slider"
                default y
            config BROOKESIA_GUI_INTERFACE_EXAMPLE_VIEW_SWITCH
                bool "view.switch"
                default y
            config BROOKESIA_GUI_INTERFACE_EXAMPLE_VIEW_CHECKBOX
                bool "view.checkbox"
                default y
            config BROOKESIA_GUI_INTERFACE_EXAMPLE_VIEW_DROPDOWN
                bool "view.dropdown"
                default y
            config BROOKESIA_GUI_INTERFACE_EXAMPLE_VIEW_PROGRESS_BAR
                bool "view.progress_bar"
                default y
            config BROOKESIA_GUI_INTERFACE_EXAMPLE_VIEW_SPINNER
                bool "view.spinner"
                default y
            config BROOKESIA_GUI_INTERFACE_EXAMPLE_VIEW_ARC
                bool "view.arc"
                default y
            config BROOKESIA_GUI_INTERFACE_EXAMPLE_VIEW_LINE
                bool "view.line"
                default y
            config BROOKESIA_GUI_INTERFACE_EXAMPLE_VIEW_TABLE
                bool "view.table"
                default y
            config BROOKESIA_GUI_INTERFACE_EXAMPLE_VIEW_KEYBOARD
                bool "view.keyboard"
                default y
            config BROOKESIA_GUI_INTERFACE_EXAMPLE_VIEW_CANVAS
                bool "view.canvas"
                default y
            config BROOKESIA_GUI_INTERFACE_EXAMPLE_VIEW_FRAME_VIEW
                bool "view.frame_view"
                default y
        endmenu

        menu "Styling examples"
            config BROOKESIA_GUI_INTERFACE_EXAMPLE_STYLING_FLEX
                bool "styling.flex"
                default y
            config BROOKESIA_GUI_INTERFACE_EXAMPLE_STYLING_GRID
                bool "styling.grid"
                default y
            config BROOKESIA_GUI_INTERFACE_EXAMPLE_STYLING_PLACEMENT
                bool "styling.placement"
                default y
            config BROOKESIA_GUI_INTERFACE_EXAMPLE_STYLING_STYLE
                bool "styling.style"
                default y
            config BROOKESIA_GUI_INTERFACE_EXAMPLE_STYLING_STATE_STYLES
                bool "styling.state_styles"
                default y
            config BROOKESIA_GUI_INTERFACE_EXAMPLE_STYLING_STYLE_REFS
                bool "styling.style_refs"
                default y
        endmenu

        menu "Interaction examples"
            config BROOKESIA_GUI_INTERFACE_EXAMPLE_INTERACTION_BINDINGS
                bool "interaction.bindings"
                default y
            config BROOKESIA_GUI_INTERFACE_EXAMPLE_INTERACTION_EVENTS
                bool "interaction.events"
                default y
            config BROOKESIA_GUI_INTERFACE_EXAMPLE_INTERACTION_ANIMATIONS
                bool "interaction.animations"
                default y
            config BROOKESIA_GUI_INTERFACE_EXAMPLE_INTERACTION_SCREEN_FLOW
                bool "interaction.screen_flow"
                default y
        endmenu

        menu "Runtime examples"
            config BROOKESIA_GUI_INTERFACE_EXAMPLE_RUNTIME_TEMPLATE
                bool "runtime.template"
                default y
            config BROOKESIA_GUI_INTERFACE_EXAMPLE_RUNTIME_THEME_LANGUAGE
                bool "runtime.theme_language"
                default y
            config BROOKESIA_GUI_INTERFACE_EXAMPLE_RUNTIME_ANIMATION_API
                bool "runtime.animation_api"
                default y
            config BROOKESIA_GUI_INTERFACE_EXAMPLE_RUNTIME_MOUNT_STACK
                bool "runtime.mount_stack"
                default y
        endmenu
    endif
endmenu
```
