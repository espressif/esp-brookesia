## examples/system/gsp_app/main/Kconfig.projbuild
```kconfig
menu "Brookesia system GSP example"

    config BROOKESIA_EXAMPLE_SYSTEM_GSP_APP
        bool
        default y
        select BROOKESIA_SYSTEM_CORE_ENABLE_GSP_BACKEND
        help
            This example can run GSP, so menuconfig includes that choice.

    config BROOKESIA_GSP_WIFI_PROBE
        bool "Run Settings Wi-Fi hardware acceptance probe at startup"
        depends on BROOKESIA_GUI_BACKEND_GSP
        default n
        help
            Exercise real scans, refresh, Wi-Fi toggles, and exit during scans
            through GSP pointer input. Log heap use over 20 measured cycles.
            This temporarily changes Wi-Fi state and restores it on success.
            Leave disabled for normal use.

    config BROOKESIA_LVGL_HW_PROBE
        bool "Run LVGL hardware acceptance probe at startup"
        depends on BROOKESIA_GUI_BACKEND_LVGL
        select LV_USE_OBJ_NAME
        default n
        help
            Exercise the desktop, Settings, brightness, and Wi-Fi through
            injected touch input. Capture screens and log heap use over
            20 measured cycles. Leave disabled for normal use.

endmenu
```

## examples/system/gsp_app/sdkconfig.defaults
```kconfig
CONFIG_BROOKESIA_GUI_BACKEND_GSP=y
CONFIG_BROOKESIA_GSP_COMPRESS_COMPILED_BUNDLES=y
# A JavaScript app fills a whole page in one burst of updates; the default depth of 24 drops some of them.
CONFIG_ESP_GSP_QUEUE_DEPTH=128

# Both backends share playback. Speech processing and video codecs stay disabled.
CONFIG_BROOKESIA_HAL_ADAPTOR_AUDIO_ENABLE_PROCESSOR_IMPL=y
CONFIG_BROOKESIA_HAL_ADAPTOR_AUDIO_ENABLE_PROCESSOR_RECORDING_IMPL=n
CONFIG_BROOKESIA_SERVICE_AUDIO_ENABLE_AUTO_REGISTER=n
CONFIG_AUDIO_AFE_ENABLE=n
CONFIG_AUDIO_HLS_ENABLE=n
CONFIG_VIDEO_PROCESSOR_ENABLE=n
CONFIG_BROOKESIA_APP_SETTINGS_SOUND_TEST_URL="file:///littlefs/settings-tone.wav"
CONFIG_BROOKESIA_HAL_ADAPTOR_VIDEO_ENABLE_ENCODER_IMPL=n
CONFIG_BROOKESIA_HAL_ADAPTOR_VIDEO_ENABLE_DECODER_IMPL=n
CONFIG_ESP_MAIN_TASK_STACK_SIZE=32768
CONFIG_FREERTOS_HZ=1000
CONFIG_ESP_INT_WDT_TIMEOUT_MS=2000
CONFIG_ESP_TASK_WDT_TIMEOUT_S=10
CONFIG_PARTITION_TABLE_CUSTOM=y
CONFIG_PARTITION_TABLE_CUSTOM_FILENAME="partitions_16m.csv"
CONFIG_PARTITION_TABLE_FILENAME="partitions_16m.csv"
CONFIG_ESPTOOLPY_FLASHSIZE_16MB=y
CONFIG_ESP_CONSOLE_USB_SERIAL_JTAG=y
CONFIG_PARTITION_TABLE_OFFSET=0x10000
CONFIG_BROOKESIA_HAL_ADAPTOR_ENABLE_STORAGE_DEVICE=y
CONFIG_BROOKESIA_HAL_ADAPTOR_STORAGE_ENABLE_FILE_SYSTEM_IMPL=y
CONFIG_BROOKESIA_HAL_ADAPTOR_STORAGE_FILE_SYSTEM_ENABLE_LITTLEFS=y
CONFIG_BROOKESIA_HAL_ADAPTOR_STORAGE_FILE_SYSTEM_LITTLEFS_FORMAT_IF_MOUNT_FAILED=y
CONFIG_BROOKESIA_UTILS_LOG_ENABLE_FILE_AND_LINE=n
CONFIG_BROOKESIA_UTILS_LOG_ENABLE_FUNCTION_NAME=n

# Used when LVGL is selected. Ignored while GSP is selected.
# LVGL Adapter
CONFIG_ESP_LVGL_ADAPTER_ENABLE_DECODER=y
CONFIG_ESP_LVGL_ADAPTER_ENABLE_FS=y
# LVGL
CONFIG_LV_CONF_MINIMAL=y
CONFIG_LV_TXT_ENC_UTF8=y
CONFIG_LV_USE_CLIB_MALLOC=y
CONFIG_LV_USE_CLIB_STRING=y
CONFIG_LV_USE_CLIB_SPRINTF=y
CONFIG_LV_DEF_REFR_PERIOD=15
CONFIG_LV_DPI_DEF=60
CONFIG_LV_DRAW_LAYER_SIMPLE_BUF_SIZE=48000
CONFIG_LV_DRAW_SW_SHADOW_CACHE_SIZE=4
CONFIG_LV_GRADIENT_MAX_STOPS=4
CONFIG_LV_OBJ_STYLE_CACHE=y
CONFIG_LV_USE_LOG=y
CONFIG_LV_LOG_PRINTF=y
CONFIG_LV_FS_STDIO_LETTER=65
CONFIG_LV_FS_POSIX_LETTER=65
CONFIG_LV_FS_DEFAULT_DRIVER_LETTER=65
CONFIG_LV_USE_LODEPNG=y

# The Sound test uses a local PCM WAV clip.
CONFIG_AUDIO_DECODER_AAC_SUPPORT=n
CONFIG_AUDIO_DECODER_ADPCM_SUPPORT=n
CONFIG_AUDIO_DECODER_ALAC_SUPPORT=n
CONFIG_AUDIO_DECODER_AMRNB_SUPPORT=n
CONFIG_AUDIO_DECODER_AMRWB_SUPPORT=n
CONFIG_AUDIO_DECODER_FLAC_SUPPORT=n
CONFIG_AUDIO_DECODER_G711_SUPPORT=n
CONFIG_AUDIO_DECODER_G722_SUPPORT=n
CONFIG_AUDIO_DECODER_LC3_SUPPORT=n
CONFIG_AUDIO_DECODER_MP3_SUPPORT=n
CONFIG_AUDIO_DECODER_OPUS_SUPPORT=n
CONFIG_AUDIO_DECODER_PCM_SUPPORT=y
CONFIG_AUDIO_DECODER_SBC_SUPPORT=n
CONFIG_AUDIO_DECODER_VORBIS_SUPPORT=n
CONFIG_AUDIO_ENCODER_AAC_SUPPORT=n
CONFIG_AUDIO_ENCODER_ADPCM_SUPPORT=n
CONFIG_AUDIO_ENCODER_ALAC_SUPPORT=n
CONFIG_AUDIO_ENCODER_AMRNB_SUPPORT=n
CONFIG_AUDIO_ENCODER_AMRWB_SUPPORT=n
CONFIG_AUDIO_ENCODER_G711_SUPPORT=n
CONFIG_AUDIO_ENCODER_G722_SUPPORT=n
CONFIG_AUDIO_ENCODER_LC3_SUPPORT=n
CONFIG_AUDIO_ENCODER_OPUS_SUPPORT=n
CONFIG_AUDIO_ENCODER_PCM_SUPPORT=n
CONFIG_AUDIO_ENCODER_SBC_SUPPORT=n
CONFIG_AUDIO_ES_EXTRACTOR_SUPPORT=n
CONFIG_AUDIO_SIMPLE_DEC_M4A_SUPPORT=n
CONFIG_AUDIO_SIMPLE_DEC_OGG_SUPPORT=n
CONFIG_AUDIO_SIMPLE_DEC_TS_SUPPORT=n
CONFIG_AUDIO_SIMPLE_DEC_WAV_SUPPORT=y
CONFIG_AVI_EXTRACTOR_SUPPORT=n
CONFIG_CAF_EXTRACTOR_SUPPORT=n
CONFIG_ESP_AUDIO_SIMPLE_PLAYER_EMBED_FLASH_EN=n
CONFIG_ESP_AUDIO_SIMPLE_PLAYER_HTTP_EN=n
CONFIG_FLV_EXTRACTOR_SUPPORT=n
CONFIG_MJPEG_EXTRACTOR_SUPPORT=n
CONFIG_MP4_EXTRACTOR_SUPPORT=n
CONFIG_OGG_EXTRACTOR_SUPPORT=n
CONFIG_TS_EXTRACTOR_SUPPORT=n
CONFIG_WAV_EXTRACTOR_SUPPORT=y
```

## examples/system/gsp_app/sdkconfig.defaults.esp32p4
```kconfig
CONFIG_ESP32P4_SELECTS_REV_LESS_V3=n
CONFIG_ESP32P4_REV_MIN_301=y
CONFIG_COMPILER_OPTIMIZATION_PERF=y

# LVGL backend only.
CONFIG_ESP_LVGL_ADAPTER_ENABLE_FREETYPE=y
CONFIG_LV_USE_FREETYPE=y
CONFIG_LV_FREETYPE_USE_LVGL_PORT=y
CONFIG_LV_USE_FS_MEMFS=y
CONFIG_LV_FS_MEMFS_LETTER=77
CONFIG_LV_CACHE_DEF_SIZE=1024000
CONFIG_LV_IMAGE_HEADER_CACHE_DEF_CNT=32
```

## gui/brookesia_gui_gsp/Kconfig
```kconfig
menu "ESP-Brookesia: GUI GSP Configurations"

    config BROOKESIA_GUI_GSP_ENABLE_DEBUG_LOG
        bool "Enable debug log for the GSP GUI adapter"
        default n
        help
            Enable trace and debug logs for GSP session start and stop.

    config BROOKESIA_GSP_COMPRESS_COMPILED_BUNDLES
        bool "Compress embedded Brookesia GSP bundles"
        depends on SPIRAM
        default n
        help
            Keep GSPC's original bundle and generated headers at build time,
            but embed a lossless zlib envelope in the firmware. The active
            bundle is expanded into PSRAM for the lifetime of its GSP session.

endmenu
```
