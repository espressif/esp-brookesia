## examples/system/super/main/Kconfig.projbuild
```kconfig
menu "Super Example Optional Features"

    config EXAMPLE_SUPER_ENABLE_AUDIO
        bool "Audio service, AFE and WakeNet"
        default n
        select BROOKESIA_HAL_ADAPTOR_ENABLE_AUDIO_DEVICE
        select BROOKESIA_HAL_ADAPTOR_AUDIO_ENABLE_CODEC_PLAYER_IMPL
        select BROOKESIA_HAL_ADAPTOR_AUDIO_ENABLE_CODEC_RECORDER_IMPL
        select BROOKESIA_HAL_ADAPTOR_AUDIO_ENABLE_PROCESSOR_IMPL
        help
            Pull brookesia_service_audio and enable the HAL audio device,
            including ESP-SR WakeNet / AFE. Off by default so those stacks
            are not copied into PSRAM XIP.

    config EXAMPLE_SUPER_ENABLE_VIDEO
        bool "Video service and camera"
        default n
        select BROOKESIA_HAL_ADAPTOR_ENABLE_VIDEO_DEVICE
        help
            Pull brookesia_service_video and enable the HAL video/camera
            device. Off by default to keep av_processor and camera code
            out of PSRAM XIP.

    config EXAMPLE_SUPER_ENABLE_NES
        bool "NES emulator"
        default n
        select EXAMPLE_SUPER_ENABLE_AUDIO
        help
            Pull brookesia_emulation_nes. Also enables the audio service.

    config EXAMPLE_SUPER_ENABLE_COZE
        bool "Coze agent"
        default n
        select EXAMPLE_SUPER_ENABLE_AUDIO
        help
            Pull brookesia_agent_coze. Also enables the audio service.

    config EXAMPLE_SUPER_ENABLE_XIAOZHI
        bool "Xiaozhi agent"
        default n
        select EXAMPLE_SUPER_ENABLE_AUDIO
        help
            Pull brookesia_agent_xiaozhi. Also enables the audio service.

    config EXAMPLE_SUPER_ENABLE_JS_RUNTIME
        bool "JavaScript app runtime (QuickJS)"
        default n
        help
            Pull brookesia_runtime_js and quickjs-ng. Off by default
            because the Matter Controller path does not need JS apps.

    config EXAMPLE_SUPER_ENABLE_APP_STORE
        bool "App Store native app"
        default n
        help
            Pull brookesia_app_store. Settings and Matter Controller stay
            available when this is off.

    config EXAMPLE_SUPER_ENABLE_FILES
        bool "Files native app"
        default n
        help
            Pull brookesia_app_files.

endmenu
```

## examples/system/super/sdkconfig.defaults.esp32s31
```kconfig
CONFIG_COMPILER_OPTIMIZATION_SIZE=y
# WakeNet is selected with EXAMPLE_SUPER_ENABLE_AUDIO, not by default.
# CONFIG_SR_WN_WN9_HIESP is not set

# Keep unused Super features and their HAL stacks out of PSRAM XIP.
# These override esp32_s31_korvo1/sdkconfig.defaults.board.
# CONFIG_EXAMPLE_SUPER_ENABLE_AUDIO is not set
# CONFIG_EXAMPLE_SUPER_ENABLE_VIDEO is not set
# CONFIG_EXAMPLE_SUPER_ENABLE_NES is not set
# CONFIG_EXAMPLE_SUPER_ENABLE_COZE is not set
# CONFIG_EXAMPLE_SUPER_ENABLE_XIAOZHI is not set
# CONFIG_EXAMPLE_SUPER_ENABLE_JS_RUNTIME is not set
# CONFIG_EXAMPLE_SUPER_ENABLE_APP_STORE is not set
# CONFIG_EXAMPLE_SUPER_ENABLE_FILES is not set
# CONFIG_BROOKESIA_HAL_ADAPTOR_ENABLE_AUDIO_DEVICE is not set
# CONFIG_BROOKESIA_HAL_ADAPTOR_ENABLE_VIDEO_DEVICE is not set

# ---------------------------------------------------------------------------
# LibC: ESP-SR's prebuilt esp32s31 libraries reference POSIX `stderr`.
# Keep Picolibc and its Newlib-header compatibility layer for ESP-Matter.
# ---------------------------------------------------------------------------
CONFIG_LIBC_PICOLIBC=y
CONFIG_LIBC_PICOLIBC_NEWLIB_COMPATIBILITY=y

# ---------------------------------------------------------------------------
# Brookesia:System Super
# ---------------------------------------------------------------------------
CONFIG_BROOKESIA_SYSTEM_SUPER_ENABLE_APP_LAUNCH_ANIMATION=n

# ---------------------------------------------------------------------------
# FreeRTOS
# ---------------------------------------------------------------------------
CONFIG_FREERTOS_HZ=1000
CONFIG_FREERTOS_TIMER_TASK_STACK_DEPTH=3072
CONFIG_FREERTOS_TASK_CREATE_ALLOW_EXT_MEM=y

# ---------------------------------------------------------------------------
# System tasks
# ---------------------------------------------------------------------------
CONFIG_ESP_MAIN_TASK_STACK_SIZE=4096
CONFIG_ESP_SYSTEM_EVENT_TASK_STACK_SIZE=3072
CONFIG_ESP_IPC_TASK_STACK_SIZE=2048

# ---------------------------------------------------------------------------
# BLE / NimBLE (Matter 配网必需)
# ---------------------------------------------------------------------------
CONFIG_BT_ENABLED=y
CONFIG_BT_NIMBLE_ENABLED=y
CONFIG_BT_NIMBLE_MEM_ALLOC_MODE_EXTERNAL=y
CONFIG_BT_NIMBLE_MAX_CONNECTIONS=3
CONFIG_BT_NIMBLE_MAX_BONDS=3
CONFIG_BT_NIMBLE_MAX_CCCDS=2
CONFIG_BT_NIMBLE_WHITELIST_SIZE=1
CONFIG_BT_NIMBLE_GATT_MAX_PROCS=4
CONFIG_BT_NIMBLE_ENABLE_CONN_REATTEMPT=n
CONFIG_BT_NIMBLE_ROLE_CENTRAL=y
CONFIG_BT_NIMBLE_ROLE_OBSERVER=y
CONFIG_BT_NIMBLE_MSYS_1_BLOCK_COUNT=12
CONFIG_BT_NIMBLE_MSYS_2_BLOCK_COUNT=8
CONFIG_BT_NIMBLE_TRANSPORT_ACL_FROM_LL_COUNT=24
CONFIG_BT_NIMBLE_TRANSPORT_EVT_COUNT=30
CONFIG_BT_NIMBLE_TRANSPORT_EVT_DISCARD_COUNT=8
CONFIG_BT_NIMBLE_SECURITY_ENABLE=y
CONFIG_BT_NIMBLE_50_FEATURE_SUPPORT=y
CONFIG_BT_CTRL_RUN_IN_FLASH_ONLY=y

# ---------------------------------------------------------------------------
# WiFi
# Matter Controller/RainMaker temporarily owns the complete Wi-Fi lifecycle.
# Disable Brookesia Wi-Fi service auto-registration so it does not create the
# default STA netif or initialize/start esp_wifi before RainMaker provisioning.
# ---------------------------------------------------------------------------
CONFIG_BROOKESIA_SERVICE_WIFI_ENABLE_AUTO_REGISTER=n
CONFIG_ESP_WIFI_STATIC_RX_BUFFER_NUM=6
CONFIG_ESP_WIFI_STATIC_TX_BUFFER_NUM=6
CONFIG_ESP_WIFI_DYNAMIC_RX_MGMT_BUFFER=y
CONFIG_ESP_WIFI_TX_BA_WIN=16
CONFIG_ESP_WIFI_RX_BA_WIN=8
CONFIG_ESP_WIFI_IRAM_OPT=n
CONFIG_ESP_WIFI_RX_IRAM_OPT=n
CONFIG_ESP_WIFI_SOFTAP_SUPPORT=y

# ---------------------------------------------------------------------------
# LWIP (IPv6 required for Matter/Thread)
# ---------------------------------------------------------------------------
CONFIG_LWIP_IRAM_OPTIMIZATION=n
CONFIG_LWIP_TCP_RECVMBOX_SIZE=10
CONFIG_LWIP_TCP_ACCEPTMBOX_SIZE=8
CONFIG_LWIP_TCP_OOSEQ_MAX_PBUFS=6
CONFIG_LWIP_IPV6_AUTOCONFIG=y
CONFIG_LWIP_IPV6_NUM_ADDRESSES=6
CONFIG_LWIP_HOOK_IP6_ROUTE_DEFAULT=y
CONFIG_LWIP_HOOK_ND6_GET_GW_DEFAULT=y
CONFIG_LWIP_TCPIP_RECVMBOX_SIZE=16
CONFIG_NUM_UDP_ENDPOINTS=16

# ---------------------------------------------------------------------------
# mbedTLS / TLS
# ---------------------------------------------------------------------------
CONFIG_MBEDTLS_TLS_CLIENT_ONLY=y
CONFIG_MBEDTLS_HKDF_C=y
CONFIG_MBEDTLS_EXTERNAL_MEM_ALLOC=y
CONFIG_MBEDTLS_DYNAMIC_BUFFER=n
CONFIG_MBEDTLS_DYNAMIC_FREE_PEER_CERT=y
CONFIG_MBEDTLS_DYNAMIC_FREE_CONFIG_DATA=y
CONFIG_MBEDTLS_SSL_PROTO_TLS1=n
CONFIG_MBEDTLS_SSL_PROTO_TLS1_1=n
CONFIG_MBEDTLS_AES_USE_INTERRUPT=n
CONFIG_MBEDTLS_MPI_USE_INTERRUPT=n

# ---------------------------------------------------------------------------
# Matter Controller
# ---------------------------------------------------------------------------
CONFIG_ENABLE_CHIP_SHELL=y
CONFIG_ESP_MATTER_CONTROLLER_ENABLE=y
CONFIG_ENABLE_CHIP_CONTROLLER_BUILD=y
CONFIG_ESP_MATTER_ENABLE_MATTER_SERVER=n
CONFIG_ESP_MATTER_COMMISSIONER_ENABLE=n
CONFIG_CUSTOM_OPERATIONAL_CREDS_ISSUER=y
CONFIG_USE_BLE_ONLY_FOR_COMMISSIONING=n
CONFIG_CHIP_FACTORY_NAMESPACE_PARTITION_LABEL="fctry"
CONFIG_ENABLE_ESP32_FACTORY_DATA_PROVIDER=y
CONFIG_ENABLE_ESP32_DEVICE_INSTANCE_INFO_PROVIDER=y
CONFIG_ENABLE_ESP32_DEVICE_INFO_PROVIDER=y
CONFIG_SEC_CERT_DAC_PROVIDER=y
CONFIG_DEVICE_VENDOR_ID=0x131B
CONFIG_DEVICE_PRODUCT_ID=0x2
CONFIG_ESP_MATTER_ATTRIBUTE_BUFFER_LARGEST=2050
CONFIG_MAX_EXCHANGE_CONTEXTS=40
CONFIG_RMAKER_MTCTL_MAX_DEVICE_COUNT=32
CONFIG_CHIP_PROJECT_CONFIG="main/matter_project_config.h"
CONFIG_CHIP_TASK_STACK_SIZE=8192
CONFIG_ESP_MATTER_CONSOLE_TASK_STACK=3072
CONFIG_ESP_MATTER_MEM_ALLOC_MODE_EXTERNAL=y
CONFIG_CHIP_MEM_ALLOC_MODE_EXTERNAL=y
CONFIG_ESP_ALLOW_BSS_SEG_EXTERNAL_MEMORY=y

# ---------------------------------------------------------------------------
# RainMaker
# ---------------------------------------------------------------------------
CONFIG_ESP_RMAKER_USER_ID_CHECK=y
CONFIG_ESP_RMAKER_NO_CLAIM=y
CONFIG_ESP_RMAKER_USE_ESP_SECURE_CERT_MGR=y
CONFIG_ESP_RMAKER_READ_NODE_ID_FROM_CERT_CN=y
CONFIG_ESP_SECURE_CERT_DS_PERIPHERAL=n
CONFIG_RMAKER_MTCTL_MEMORY_ALLOCATION_PREFER_SPIRAM=y
CONFIG_RMAKER_MTCTL_TASK_STACK_SIZE=8192

# ---------------------------------------------------------------------------
# 网络配网
# ---------------------------------------------------------------------------
CONFIG_WIFI_NETWORK_COMMISSIONING_DRIVER=n
CONFIG_THREAD_NETWORK_COMMISSIONING_DRIVER=n
CONFIG_ENABLE_CHIPOBLE=n
CONFIG_USE_BLE_ONLY_FOR_COMMISSIONING=n
CONFIG_CHIP_ENABLE_PAIRING_AUTOSTART=n
CONFIG_USE_MINIMAL_MDNS=n

# ---------------------------------------------------------------------------
# LVGL
# ---------------------------------------------------------------------------
CONFIG_ESP_LVGL_ADAPTER_ENABLE_FREETYPE=y
CONFIG_LV_USE_FREETYPE=y
CONFIG_LV_FREETYPE_USE_LVGL_PORT=y
CONFIG_LV_USE_FS_MEMFS=y
CONFIG_LV_FS_MEMFS_LETTER=77
CONFIG_LV_CACHE_DEF_SIZE=512000
CONFIG_LV_IMAGE_HEADER_CACHE_DEF_CNT=16
CONFIG_LV_USE_QRCODE=y
CONFIG_LV_DRAW_LAYER_SIMPLE_BUF_SIZE=12288
CONFIG_LV_DRAW_THREAD_STACK_SIZE=16384

# ---------------------------------------------------------------------------
# Linker
# ---------------------------------------------------------------------------
CONFIG_LINKER_WITH_LF=y
```

## hal/brookesia_hal_boards/boards/espressif/esp_mosaico_v1_0/components/brookesia_hal_custom/Kconfig
```kconfig
menu "ESP-Brookesia: Mosaico HAL Custom Configurations"
    menuconfig BROOKESIA_HAL_CUSTOM_ENABLE_DEBUG_LOG
        bool "Enable debug or lower level logs"
        default n
endmenu
```

## hal/brookesia_hal_boards/boards/espressif/esp_mosaico_v1_0/sdkconfig.defaults.board
```kconfig
CONFIG_ESPTOOLPY_FLASHMODE_QIO=y
CONFIG_ESPTOOLPY_FLASHSIZE_16MB=y
CONFIG_PARTITION_TABLE_CUSTOM=y
CONFIG_PARTITION_TABLE_CUSTOM_FILENAME="partitions_16m.csv"
CONFIG_PARTITION_TABLE_FILENAME="partitions_16m.csv"
CONFIG_SPIRAM=y
CONFIG_SPIRAM_SPEED_250M=y
CONFIG_SPIRAM_MALLOC_ALWAYSINTERNAL=0
CONFIG_SPIRAM_XIP_FROM_PSRAM=y
CONFIG_SPIRAM_TRY_ALLOCATE_WIFI_LWIP=y

# Mosaico USB CDC console and software-assisted download
CONFIG_ESP_CONSOLE_UART_DEFAULT=y
CONFIG_BSP_USB_CONSOLE=y
CONFIG_BSP_USB_CONSOLE_AUTO_INIT=y
CONFIG_BSP_USB_AUTO_DOWNLOAD=y
CONFIG_TINYUSB_CDC_ENABLED=y
CONFIG_TINYUSB_CDC_COUNT=1
CONFIG_TINYUSB_DESC_PRODUCT_STRING="ESP-Mosaico USB Console"
CONFIG_TINYUSB_DESC_CDC_STRING="ESP-Mosaico CDC"

# Brookesia:Hal:Adaptor
# System
CONFIG_BROOKESIA_HAL_ADAPTOR_ENABLE_SYSTEM_DEVICE=y
CONFIG_BROOKESIA_HAL_ADAPTOR_SYSTEM_ENABLE_BOARD_INFO_IMPL=y
# Network
CONFIG_BROOKESIA_HAL_ADAPTOR_ENABLE_NETWORK_DEVICE=y
CONFIG_BROOKESIA_HAL_ADAPTOR_NETWORK_ENABLE_SNTP_CLIENT_IMPL=y
CONFIG_BROOKESIA_HAL_ADAPTOR_NETWORK_ENABLE_HTTP_CLIENT_IMPL=y
CONFIG_LWIP_SNTP_MAX_SERVERS=4
CONFIG_LWIP_SNTP_STARTUP_DELAY=n
CONFIG_LWIP_DHCP_GET_NTP_SRV=y
CONFIG_LWIP_DHCP_MAX_NTP_SERVERS=4
# Audio
CONFIG_CODEC_ES8311_SUPPORT=y
CONFIG_BROOKESIA_HAL_ADAPTOR_ENABLE_AUDIO_DEVICE=y
CONFIG_BROOKESIA_HAL_ADAPTOR_AUDIO_ENABLE_CODEC_PLAYER_IMPL=y
CONFIG_BROOKESIA_HAL_ADAPTOR_AUDIO_ENABLE_CODEC_RECORDER_IMPL=y
CONFIG_BROOKESIA_HAL_ADAPTOR_AUDIO_CODEC_RECORDER_BITS=16
CONFIG_BROOKESIA_HAL_ADAPTOR_AUDIO_CODEC_RECORDER_CHANNELS=2
CONFIG_BROOKESIA_HAL_ADAPTOR_AUDIO_CODEC_RECORDER_SAMPLE_RATE=16000
CONFIG_BROOKESIA_HAL_ADAPTOR_AUDIO_CODEC_RECORDER_MIC_LAYOUT="MR"
CONFIG_BROOKESIA_HAL_ADAPTOR_AUDIO_CODEC_RECORDER_GENERAL_GAIN="36.0"
CONFIG_BROOKESIA_HAL_ADAPTOR_AUDIO_CODEC_RECORDER_CHANNEL_GAINS="{}"
CONFIG_BROOKESIA_HAL_ADAPTOR_AUDIO_ENABLE_PROCESSOR_IMPL=y
CONFIG_AUDIO_SIMPLE_PLAYER_RESAMPLE_DEST_RATE=16000
CONFIG_ESP_AUDIO_SIMPLE_PLAYER_CH_CVT_EN=y
CONFIG_ESP_AUDIO_SIMPLE_PLAYER_BIT_CVT_EN=y
CONFIG_AUDIO_SIMPLE_PLAYER_BIT_CVT_DEST_16BIT=y
# Display
CONFIG_BROOKESIA_HAL_ADAPTOR_ENABLE_DISPLAY_DEVICE=y
CONFIG_BROOKESIA_HAL_ADAPTOR_DISPLAY_ENABLE_LEDC_BACKLIGHT_IMPL=n
CONFIG_BROOKESIA_HAL_ADAPTOR_DISPLAY_ENABLE_LCD_PANEL_IMPL=y
CONFIG_BROOKESIA_HAL_ADAPTOR_DISPLAY_LCD_PANEL_H_RES=480
CONFIG_BROOKESIA_HAL_ADAPTOR_DISPLAY_LCD_PANEL_V_RES=480
CONFIG_BROOKESIA_HAL_ADAPTOR_DISPLAY_LCD_PANEL_DRAW_X_ALIGN_BYTES=3
CONFIG_BROOKESIA_HAL_ADAPTOR_DISPLAY_LCD_PANEL_DRAW_Y_ALIGN_BYTES=1
CONFIG_BROOKESIA_HAL_ADAPTOR_DISPLAY_ENABLE_LCD_TOUCH_IMPL=y
# Storage
CONFIG_BROOKESIA_HAL_ADAPTOR_ENABLE_STORAGE_DEVICE=y
CONFIG_BROOKESIA_HAL_ADAPTOR_STORAGE_ENABLE_KEY_VALUE_IMPL=y
CONFIG_NVS_ALLOCATE_CACHE_IN_SPIRAM=y
CONFIG_BROOKESIA_HAL_ADAPTOR_STORAGE_ENABLE_FILE_SYSTEM_IMPL=y
CONFIG_BROOKESIA_HAL_ADAPTOR_STORAGE_FILE_SYSTEM_ENABLE_LITTLEFS=y
CONFIG_BROOKESIA_HAL_ADAPTOR_STORAGE_FILE_SYSTEM_ENABLE_FATFS_NAND=y
CONFIG_BROOKESIA_HAL_ADAPTOR_STORAGE_FILE_SYSTEM_FATFS_NAND_BASE_PATH="/nand"
CONFIG_BROOKESIA_HAL_ADAPTOR_STORAGE_FILE_SYSTEM_FATFS_NAND_FORMAT_IF_MOUNT_FAILED=n
CONFIG_BROOKESIA_HAL_ADAPTOR_STORAGE_FILE_SYSTEM_FATFS_NAND_MAX_FILES=4
CONFIG_NAND_FLASH_ENABLE_BDL=y
CONFIG_WL_SECTOR_SIZE_4096=y
CONFIG_FATFS_LFN_HEAP=y
# Power
CONFIG_BROOKESIA_HAL_ADAPTOR_ENABLE_POWER_DEVICE=y
CONFIG_BROOKESIA_HAL_ADAPTOR_POWER_ENABLE_BATTERY=y
CONFIG_BROOKESIA_HAL_ADAPTOR_POWER_BATTERY_IMPL_BQ27220=y
CONFIG_BROOKESIA_HAL_ADAPTOR_POWER_BATTERY_LOW_VOLTAGE_MV=3500
CONFIG_BROOKESIA_HAL_ADAPTOR_POWER_BATTERY_CRITICAL_VOLTAGE_MV=3300
# Wi-Fi
CONFIG_BROOKESIA_HAL_ADAPTOR_ENABLE_WIFI_DEVICE=y
CONFIG_ESP_SYSTEM_EVENT_TASK_STACK_SIZE=3072
```
