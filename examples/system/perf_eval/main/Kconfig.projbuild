## hal/brookesia_hal_boards/boards/espressif/esp_mosaico_v1_2/sdkconfig.defaults.board
```kconfig
CONFIG_ESPTOOLPY_FLASHMODE_QIO=y
CONFIG_ESPTOOLPY_FLASHSIZE_16MB=y
CONFIG_PARTITION_TABLE_CUSTOM=y
CONFIG_PARTITION_TABLE_CUSTOM_FILENAME="partitions_16m.csv"
CONFIG_PARTITION_TABLE_FILENAME="partitions_16m.csv"
CONFIG_SPIRAM=y
CONFIG_SPIRAM_SPEED_250M=y
CONFIG_SPIRAM_MALLOC_ALWAYSINTERNAL=0
CONFIG_SPIRAM_XIP_FROM_PSRAM=y
CONFIG_SPIRAM_TRY_ALLOCATE_WIFI_LWIP=y

# LCD and NAND reserve two AXI RX channels. Keep the third available for DVP
# after HTTPS requests: hardware SHA/AES retain a shared crypto DMA channel.
CONFIG_MBEDTLS_HARDWARE_SHA=n
CONFIG_MBEDTLS_HARDWARE_AES=n

# Mosaico USB CDC console
CONFIG_ESP_CONSOLE_UART_DEFAULT=y
# DVP D2 shares GPIO33 with USB Serial/JTAG. The console uses TinyUSB instead.
CONFIG_ESP_CONSOLE_SECONDARY_NONE=y
CONFIG_BROOKESIA_SERVICE_USB_ENABLE_AUTO_REGISTER=n
CONFIG_BROOKESIA_SYSTEM_CORE_ENABLE_USB_BRIDGE=n
# Console, UART, null, sockets, TinyUSB, LittleFS, NAND and video need VFS slots.
# Leave headroom for additional devices in applications such as System Super.
CONFIG_VFS_MAX_COUNT=12
CONFIG_BSP_USB_CONSOLE=y
CONFIG_BSP_USB_CONSOLE_AUTO_INIT=y
# The V1.2 sample requires BOOT and a power cycle to enter download mode.
CONFIG_BSP_USB_AUTO_DOWNLOAD=n
CONFIG_ESPTOOLPY_BEFORE_NORESET=y
CONFIG_TINYUSB_CDC_ENABLED=y
CONFIG_TINYUSB_CDC_COUNT=1
CONFIG_TINYUSB_DESC_PRODUCT_STRING="ESP-Mosaico USB Console"
CONFIG_TINYUSB_DESC_CDC_STRING="ESP-Mosaico CDC"

# Brookesia:Hal:Adaptor
# System
CONFIG_BROOKESIA_HAL_ADAPTOR_ENABLE_SYSTEM_DEVICE=y
CONFIG_BROOKESIA_HAL_ADAPTOR_SYSTEM_ENABLE_BOARD_INFO_IMPL=y
# Network
CONFIG_BROOKESIA_HAL_ADAPTOR_ENABLE_NETWORK_DEVICE=y
CONFIG_BROOKESIA_HAL_ADAPTOR_NETWORK_ENABLE_SNTP_CLIENT_IMPL=y
CONFIG_BROOKESIA_HAL_ADAPTOR_NETWORK_ENABLE_HTTP_CLIENT_IMPL=y
CONFIG_LWIP_SNTP_MAX_SERVERS=4
CONFIG_LWIP_SNTP_STARTUP_DELAY=n
CONFIG_LWIP_DHCP_GET_NTP_SRV=y
CONFIG_LWIP_DHCP_MAX_NTP_SERVERS=4
# Audio
CONFIG_CODEC_ES8311_SUPPORT=y
CONFIG_BROOKESIA_HAL_ADAPTOR_ENABLE_AUDIO_DEVICE=y
CONFIG_BROOKESIA_HAL_ADAPTOR_AUDIO_ENABLE_CODEC_PLAYER_IMPL=y
CONFIG_BROOKESIA_HAL_ADAPTOR_AUDIO_ENABLE_CODEC_RECORDER_IMPL=y
CONFIG_BROOKESIA_HAL_ADAPTOR_AUDIO_CODEC_RECORDER_BITS=16
CONFIG_BROOKESIA_HAL_ADAPTOR_AUDIO_CODEC_RECORDER_CHANNELS=2
CONFIG_BROOKESIA_HAL_ADAPTOR_AUDIO_CODEC_RECORDER_SAMPLE_RATE=16000
CONFIG_BROOKESIA_HAL_ADAPTOR_AUDIO_CODEC_RECORDER_MIC_LAYOUT="MR"
CONFIG_BROOKESIA_HAL_ADAPTOR_AUDIO_CODEC_RECORDER_GENERAL_GAIN="36.0"
CONFIG_BROOKESIA_HAL_ADAPTOR_AUDIO_CODEC_RECORDER_CHANNEL_GAINS="{}"
CONFIG_BROOKESIA_HAL_ADAPTOR_AUDIO_ENABLE_PROCESSOR_IMPL=y
CONFIG_AUDIO_SIMPLE_PLAYER_RESAMPLE_DEST_RATE=16000
CONFIG_ESP_AUDIO_SIMPLE_PLAYER_CH_CVT_EN=y
CONFIG_ESP_AUDIO_SIMPLE_PLAYER_BIT_CVT_EN=y
CONFIG_AUDIO_SIMPLE_PLAYER_BIT_CVT_DEST_16BIT=y
# Expansion modules
CONFIG_BROOKESIA_HAL_ADAPTOR_ENABLE_EXPANSION_MODULES=y
# Video
CONFIG_BROOKESIA_HAL_ADAPTOR_ENABLE_VIDEO_DEVICE=y
CONFIG_BROOKESIA_HAL_ADAPTOR_VIDEO_KEEP_DEVICE_INITIALIZED_ON_RELEASE=n
CONFIG_BROOKESIA_HAL_ADAPTOR_VIDEO_ENABLE_CAMERA_IMPL=y
CONFIG_BROOKESIA_HAL_ADAPTOR_VIDEO_CAMERA_REQUIRES_EXPANSION_RUNTIME=y
CONFIG_BROOKESIA_HAL_ADAPTOR_VIDEO_ENABLE_ENCODER_IMPL=y
CONFIG_BROOKESIA_HAL_ADAPTOR_VIDEO_ENCODER_DEFAULT_NUM=1
CONFIG_BROOKESIA_HAL_ADAPTOR_VIDEO_ENABLE_DECODER_IMPL=n
# CameraBoard modules ship with either sensor, so both drivers stay enabled and
# esp_video probes them in turn.
CONFIG_CAMERA_OV3640=y
CONFIG_CAMERA_OV3640_AUTO_DETECT_DVP_INTERFACE_SENSOR=y
CONFIG_CAMERA_OV3640_DVP_RGB565_LE_640X480_7FPS=y
CONFIG_CAMERA_OV3640_DVP_DEFAULT_FMT_RGB565_LE_640X480_7FPS=y
CONFIG_CAMERA_SC101IOT=y
CONFIG_CAMERA_SC101IOT_AUTO_DETECT_DVP_INTERFACE_SENSOR=y
CONFIG_CAMERA_SC101IOT_DVP_YUV422_640X480_15FPS=y
CONFIG_CAMERA_SC101IOT_DVP_DEFAULT_FMT_YUV422_640X480_15FPS=y
CONFIG_CAM_CTRL_SPI_ENABLE=n
CONFIG_ESP_VIDEO_ENABLE_DVP_VIDEO_DEVICE=y
CONFIG_ESP_VIDEO_ENABLE_MIPI_CSI_VIDEO_DEVICE=n
CONFIG_ESP_VIDEO_ENABLE_SPI_VIDEO_DEVICE=n
CONFIG_ESP_VIDEO_ENABLE_USB_UVC_VIDEO_DEVICE=n
# Display
CONFIG_BROOKESIA_HAL_ADAPTOR_ENABLE_DISPLAY_DEVICE=y
CONFIG_BROOKESIA_HAL_ADAPTOR_DISPLAY_ENABLE_LEDC_BACKLIGHT_IMPL=n
CONFIG_BROOKESIA_HAL_ADAPTOR_DISPLAY_ENABLE_LCD_PANEL_IMPL=y
CONFIG_BROOKESIA_HAL_ADAPTOR_DISPLAY_LCD_PANEL_H_RES=480
CONFIG_BROOKESIA_HAL_ADAPTOR_DISPLAY_LCD_PANEL_V_RES=480
CONFIG_BROOKESIA_HAL_ADAPTOR_DISPLAY_LCD_PANEL_DRAW_X_ALIGN_BYTES=2
CONFIG_BROOKESIA_HAL_ADAPTOR_DISPLAY_LCD_PANEL_DRAW_Y_ALIGN_BYTES=2
CONFIG_BROOKESIA_GUI_LVGL_DISPLAY_SOURCE_BUFFER_HEIGHT=40
CONFIG_BROOKESIA_HAL_ADAPTOR_DISPLAY_ENABLE_LCD_TOUCH_IMPL=y
# Storage
CONFIG_BROOKESIA_HAL_ADAPTOR_ENABLE_STORAGE_DEVICE=y
CONFIG_BROOKESIA_HAL_ADAPTOR_STORAGE_ENABLE_KEY_VALUE_IMPL=y
CONFIG_NVS_ALLOCATE_CACHE_IN_SPIRAM=y
CONFIG_BROOKESIA_HAL_ADAPTOR_STORAGE_ENABLE_FILE_SYSTEM_IMPL=y
CONFIG_BROOKESIA_HAL_ADAPTOR_STORAGE_FILE_SYSTEM_ENABLE_LITTLEFS=y
CONFIG_BROOKESIA_HAL_ADAPTOR_STORAGE_FILE_SYSTEM_ENABLE_FATFS_NAND=y
CONFIG_BROOKESIA_HAL_ADAPTOR_STORAGE_FILE_SYSTEM_FATFS_NAND_BASE_PATH="/nand"
CONFIG_BROOKESIA_HAL_ADAPTOR_STORAGE_FILE_SYSTEM_FATFS_NAND_FORMAT_IF_MOUNT_FAILED=n
CONFIG_BROOKESIA_HAL_ADAPTOR_STORAGE_FILE_SYSTEM_FATFS_NAND_MAX_FILES=4
CONFIG_NAND_FLASH_ENABLE_BDL=y
CONFIG_WL_SECTOR_SIZE_4096=y
CONFIG_FATFS_LFN_HEAP=y
# Power
CONFIG_BROOKESIA_HAL_ADAPTOR_ENABLE_POWER_DEVICE=y
CONFIG_BROOKESIA_HAL_ADAPTOR_POWER_ENABLE_BATTERY=y
CONFIG_BROOKESIA_HAL_ADAPTOR_POWER_BATTERY_IMPL_BQ27220=y
CONFIG_BROOKESIA_HAL_ADAPTOR_POWER_BATTERY_LOW_VOLTAGE_MV=3500
CONFIG_BROOKESIA_HAL_ADAPTOR_POWER_BATTERY_CRITICAL_VOLTAGE_MV=3300
# Wi-Fi
CONFIG_BROOKESIA_HAL_ADAPTOR_ENABLE_WIFI_DEVICE=y
CONFIG_ESP_SYSTEM_EVENT_TASK_STACK_SIZE=3072
```

## hal/brookesia_hal_boards/components/mosaico/esp_mosaico_usb_console/Kconfig
```kconfig
menu "ESP-Mosaico USB Console"

    config BSP_USB_CONSOLE
        bool "Enable the USB CDC console"
        depends on IDF_TARGET_ESP32S31 && ESP_CONSOLE_UART
        select TINYUSB_CDC_ENABLED
        default y
        help
            Start one TinyUSB CDC ACM interface on the onboard USB 2.0
            High-Speed Type-C port and redirect the application standard
            streams to it. UART0 remains available for early boot output and
            as the fallback when USB initialization fails.

    config BSP_USB_CONSOLE_AUTO_INIT
        bool "Initialize the USB CDC console automatically"
        depends on BSP_USB_CONSOLE
        default y
        help
            Schedule USB CDC initialization before app_main runs. Disable this
            only when the application needs to call
            esp_mosaico_usb_console_init() itself.

    config BSP_USB_AUTO_DOWNLOAD
        bool "Enable software-assisted automatic download"
        depends on BSP_USB_CONSOLE
        default y
        help
            Monitor the CDC DTR/RTS sequence used by esptool and restart the
            ESP32-S31 into its ROM downloader. Manual BOOT download remains the
            recovery path when the running application cannot initialize USB.

endmenu
```

## service/system/brookesia_service_usb/Kconfig
```kconfig
menu "ESP-Brookesia: Service USB Configurations"

    config BROOKESIA_SERVICE_USB_ENABLE_AUTO_REGISTER
        bool "Enable automatic plugin registration"
        default y if USJ_ENABLE_USB_SERIAL_JTAG
        default y if BROOKESIA_SERVICE_USB_TRANSPORT_UART
        default n
        help
            Automatically register the USB service with ServiceManager.

            The service uses the USB Serial/JTAG CDC port or UART port for host
            control session.

    menuconfig BROOKESIA_SERVICE_USB_ENABLE_DEBUG_LOG
        bool "Enable debug or lower level logs"
        default n

    config BROOKESIA_SERVICE_USB_UPLOAD_ROOT
        string "Host upload root"
        default "/littlefs/usb"
        help
            Absolute storage directory used for host file uploads and USB staging files.

    config BROOKESIA_SERVICE_USB_MAX_TRANSFER_SIZE
        int "Maximum transfer size"
        default 8388608
        range 1 67108864
        help
            Maximum number of bytes accepted for one host upload or BPK package.

    config BROOKESIA_SERVICE_USB_FRAME_PAYLOAD_SIZE
        int "Maximum binary frame payload"
        default 16384
        range 64 65536
        help
            Maximum payload size in one binary transfer frame.

    config BROOKESIA_SERVICE_USB_RX_QUEUE_LENGTH
        int "RX queue length"
        default 8
        range 2 64
        help
            Number of USB RX messages buffered before the protocol worker handles them.

    config BROOKESIA_SERVICE_USB_SERIAL_JTAG_RX_BUFFER_SIZE
        int "Serial/JTAG RX buffer size"
        default 32768
        range 128 65536
        help
            RX ring-buffer size used when the service owns the Serial/JTAG
            driver. The console-installed driver keeps its own configuration.
            A large buffer absorbs host bursts while the RX pump task is
            briefly delayed, which matters at USB Serial/JTAG speed.

    config BROOKESIA_SERVICE_USB_SERIAL_JTAG_TX_BUFFER_SIZE
        int "Serial/JTAG TX buffer size"
        default 4096
        range 128 65536
        help
            TX ring-buffer size used when the service owns the Serial/JTAG
            driver. The console-installed driver keeps its own configuration.

    choice BROOKESIA_SERVICE_USB_TRANSPORT
        prompt "Host control transport"
        default BROOKESIA_SERVICE_USB_TRANSPORT_SERIAL_JTAG if SOC_USB_SERIAL_JTAG_SUPPORTED
        default BROOKESIA_SERVICE_USB_TRANSPORT_UART
        help
            Transport used by the host control protocol. USB Serial/JTAG is
            the default on targets that expose it. Select UART for boards
            that only route a USB-to-UART bridge.

        config BROOKESIA_SERVICE_USB_TRANSPORT_SERIAL_JTAG
            bool "USB Serial/JTAG (CDC-ACM)"
            depends on SOC_USB_SERIAL_JTAG_SUPPORTED

        config BROOKESIA_SERVICE_USB_TRANSPORT_UART
            bool "UART (shares the console port)"
    endchoice

    if BROOKESIA_SERVICE_USB_TRANSPORT_UART

        config BROOKESIA_SERVICE_USB_UART_PORT
            int "UART port number"
            default 0
            range 0 1 if (SOC_UART_HP_NUM <= 2)
            range 0 2 if (SOC_UART_HP_NUM <= 3)
            range 0 4 if (SOC_UART_HP_NUM <= 5)
            help
                ESP-IDF uart_port_t. Port 0 is the usual USB-to-UART console
                port on Espressif dev boards. The upper bound follows the
                target's HP UART count; the runtime check against UART_NUM_MAX
                remains as a fallback.

        config BROOKESIA_SERVICE_USB_UART_BAUDRATE
            int "UART baud rate"
            default 921600
            help
                Ignored when the selected port is the console UART; the
                service then uses CONFIG_ESP_CONSOLE_UART_BAUDRATE to keep
                console logs readable at the same rate.

        config BROOKESIA_SERVICE_USB_UART_RX_BUFFER_SIZE
            int "UART RX ring buffer size"
            default 16384
            range 1024 65536
            help
                Must be large enough to absorb one protocol frame if the
                periodic RX pump is delayed. Default matches the default
                frame payload size.

        config BROOKESIA_SERVICE_USB_UART_TX_BUFFER_SIZE
            int "UART TX ring buffer size"
            default 4096
            range 1024 65536

    endif

    config BROOKESIA_SERVICE_USB_COMMAND_TIMEOUT_MS
        int "Service call timeout"
        default 30000
        range 100 600000
        help
            Default timeout for service calls received from the USB host.

endmenu
```
