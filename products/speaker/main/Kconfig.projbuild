## service/media/brookesia_service_audio/Kconfig
```kconfig
menu "ESP-Brookesia: Service Audio Configurations"
    config BROOKESIA_SERVICE_AUDIO_ENABLE_AUTO_REGISTER
        bool "Enable automatic plugin registration"
        default y
        help
            Automatically register the service as a plugin on startup.

    menuconfig BROOKESIA_SERVICE_AUDIO_ENABLE_DEBUG_LOG
        bool "Enable debug or lower level logs"
        default n

    menuconfig BROOKESIA_SERVICE_AUDIO_ENABLE_WORKER
        bool "Enable worker"
        default n

    if BROOKESIA_SERVICE_AUDIO_ENABLE_WORKER
        config BROOKESIA_SERVICE_AUDIO_WORKER_NAME
            string "Name"
            default "SvcAudio"
            help
                The name of the worker thread.

        config BROOKESIA_SERVICE_AUDIO_WORKER_CORE_ID
            int "Core ID"
            default -1
            help
                The core ID of the worker thread. `-1` means the core ID is not specified.

        config BROOKESIA_SERVICE_AUDIO_WORKER_PRIORITY
            int "Priority"
            default 5
            help
                The priority of the worker thread.

        config BROOKESIA_SERVICE_AUDIO_WORKER_STACK_SIZE
            int "Stack size"
            default 8192
            help
                The stack size of the worker thread.

        config BROOKESIA_SERVICE_AUDIO_WORKER_STACK_IN_EXT
            bool "Stack in external memory"
            depends on SPIRAM
            default y
            help
                Whether the stack of the worker thread is in external memory. If enabled, the stack will be allocated in external memory.

        config BROOKESIA_SERVICE_AUDIO_WORKER_POLL_INTERVAL_MS
            int "Poll interval (ms)"
            default 10
            range 1 10
            help
                The interval of the worker poll.
    endif

    menu "Playback Control"
        config BROOKESIA_SERVICE_AUDIO_PLAYBACK_ENABLE_AUTO_LOAD_DATA
            bool "Automatically load persisted playback control data on start"
            default y
            help
                Load persisted playback volume and mute state when AudioPlayback starts.

        config BROOKESIA_SERVICE_AUDIO_PLAYBACK_KV_ERASE_DATA_TIMEOUT_MS
            int "Storage erase timeout (ms)"
            default 500
            range 1 1000
            help
                Timeout in milliseconds used when erasing persisted audio playback state.

        config BROOKESIA_SERVICE_AUDIO_PLAYBACK_VOLUME_DEFAULT
            int "Playback default volume (percent)"
            default 75
            range 0 100
            help
                The default volume of audio playback, in percent.

        config BROOKESIA_SERVICE_AUDIO_PLAYBACK_VOLUME_MIN
            int "Playback minimum hardware volume"
            default 0
            help
                The minimum hardware volume of audio playback.

        config BROOKESIA_SERVICE_AUDIO_PLAYBACK_VOLUME_MAX
            int "Playback maximum hardware volume"
            default 100
            help
                The maximum hardware volume of audio playback.

        config BROOKESIA_SERVICE_AUDIO_PLAYBACK_DEFAULT_MUTE
            bool "Playback default mute"
            default n
            help
                The default mute state of audio playback.
    endmenu
endmenu
```

## service/media/brookesia_service_audio/test_apps/sdkconfig.defaults
```kconfig
CONFIG_ESP_TASK_WDT_EN=n
CONFIG_FREERTOS_HZ=1000
CONFIG_ESP_MAIN_TASK_STACK_SIZE=10240
CONFIG_ESPTOOLPY_FLASHSIZE_16MB=y
CONFIG_PARTITION_TABLE_CUSTOM=y
CONFIG_PARTITION_TABLE_CUSTOM_FILENAME="partitions_16m.csv"
CONFIG_PARTITION_TABLE_FILENAME="partitions_16m.csv"
```

## service/media/brookesia_service_display/Kconfig
```kconfig
menu "ESP-Brookesia: Service Display Configurations"
    config BROOKESIA_SERVICE_DISPLAY_ENABLE_AUTO_REGISTER
        bool "Enable automatic plugin registration"
        default y
        help
            Automatically register the service as a plugin on startup.

    menuconfig BROOKESIA_SERVICE_DISPLAY_ENABLE_DEBUG_LOG
        bool "Enable debug or lower level logs"
        default n

    config BROOKESIA_SERVICE_DISPLAY_DRAW_TIMEOUT_MS
        int "Synchronous draw timeout (ms)"
        default 5000
        range 1 60000
        help
            Timeout used when Display submits a frame through HAL panel draw_bitmap_sync().

    config BROOKESIA_SERVICE_DISPLAY_TOUCH_POLL_INTERVAL_MS
        int "Default touch polling interval (ms)"
        default 20
        range 5 1000
        help
            Default interval used to refresh cached touch points when the HAL touch interface
            does not support interrupt mode.

    menu "Backlight"
        config BROOKESIA_SERVICE_DISPLAY_BACKLIGHT_ENABLE_AUTO_LOAD_DATA
            bool "Automatically load persisted backlight data on start"
            default y
            help
                Load persisted backlight brightness and on/off state when Display starts.

        config BROOKESIA_SERVICE_DISPLAY_BACKLIGHT_KV_ERASE_DATA_TIMEOUT_MS
            int "Storage erase timeout (ms)"
            default 500
            range 1 1000
            help
                Timeout in milliseconds used when erasing persisted display backlight state.

        config BROOKESIA_SERVICE_DISPLAY_BACKLIGHT_BRIGHTNESS_DEFAULT
            int "Backlight default brightness (percent)"
            default 90
            range 0 100
            help
                The default brightness of the display backlight, in percent.

        config BROOKESIA_SERVICE_DISPLAY_BACKLIGHT_BRIGHTNESS_MIN
            int "Backlight minimum hardware brightness"
            default 20
            help
                The minimum hardware brightness of the display backlight.

        config BROOKESIA_SERVICE_DISPLAY_BACKLIGHT_BRIGHTNESS_MAX
            int "Backlight maximum hardware brightness"
            default 100
            help
                The maximum hardware brightness of the display backlight.

        config BROOKESIA_SERVICE_DISPLAY_BACKLIGHT_DEFAULT_ON
            bool "Backlight default on"
            default n
            help
                The default on state of the display backlight.
    endmenu
endmenu
```

## service/media/brookesia_service_picodet/Kconfig
```kconfig
menu "ESP-Brookesia: Service PicoDet Configurations"

    config BROOKESIA_SERVICE_PICODET_ENABLE_DEBUG_LOG
        bool "Enable debug log"
        default n
        help
            Enable verbose debug logging for the PicoDet service.

    config BROOKESIA_SERVICE_PICODET_FILE_IO_THREAD_STACK_SIZE
        int "File IO thread stack size (bytes)"
        default 8192
        help
            Stack size of the short-lived internal-RAM thread used for filesystem access
            (model load, image read). Flash reads disable the flash cache and require a
            cache-safe stack, so this thread is spawned when the calling worker's stack
            lives in PSRAM. Inference itself does not use this thread.

endmenu
```

## service/media/brookesia_service_video/test_apps/sdkconfig.defaults
```kconfig
CONFIG_ESP_TASK_WDT_EN=n
CONFIG_FREERTOS_HZ=1000
CONFIG_ESP_MAIN_TASK_STACK_SIZE=10240
CONFIG_ESPTOOLPY_FLASHSIZE_4MB=y
CONFIG_PARTITION_TABLE_CUSTOM=y
```
