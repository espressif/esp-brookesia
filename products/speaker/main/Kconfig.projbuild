## service/brookesia_service_manager/Kconfig
```kconfig
menu "ESP-Brookesia: Service Manager Configurations"
    config BROOKESIA_SERVICE_MANAGER_BOOST_ENABLED
        bool
        select BOOST_ASIO_ENABLED
        select BOOST_JSON_ENABLED
        default y
        help
            Enable Boost libraries.

    menuconfig BROOKESIA_SERVICE_MANAGER_ENABLE_DEBUG_LOG
        bool "Enable debug or lower level logs"
        default n

    if BROOKESIA_SERVICE_MANAGER_ENABLE_DEBUG_LOG
        config BROOKESIA_SERVICE_MANAGER_RPC_DATA_LINK_ENABLE_DEBUG_LOG
            bool "RPC Data Link"
            default y

        config BROOKESIA_SERVICE_MANAGER_RPC_SERVER_ENABLE_DEBUG_LOG
            bool "RPC Server"
            default y

        config BROOKESIA_SERVICE_MANAGER_RPC_CLIENT_ENABLE_DEBUG_LOG
            bool "RPC Client"
            default y

        config BROOKESIA_SERVICE_MANAGER_EVENT_ENABLE_DEBUG_LOG
            bool "Event"
            default y

        config BROOKESIA_SERVICE_MANAGER_FUNCTION_ENABLE_DEBUG_LOG
            bool "Function"
            default y

        config BROOKESIA_SERVICE_MANAGER_SERVICE_ENABLE_DEBUG_LOG
            bool "Service"
            default y
    endif

    menu "RPC"
        config BROOKESIA_SERVICE_MANAGER_RPC_GLOBAL_MAX_SOCKETS
            int "Global: maximum sockets"
            default LWIP_MAX_SOCKETS if LWIP_MAX_SOCKETS < LWIP_MAX_ACTIVE_TCP
            default LWIP_MAX_ACTIVE_TCP if LWIP_MAX_SOCKETS >= LWIP_MAX_ACTIVE_TCP
            help
                The maximum sockets can be consumed by the RPC.
                The default value is calculated based on the maximum number of sockets and the maximum number of active TCP connections.

        config BROOKESIA_SERVICE_MANAGER_RPC_SERVER_LISTEN_PORT
            int "Server: default listen port"
            default 65500
            help
                The default listen port of the server.

        config BROOKESIA_SERVICE_MANAGER_RPC_SERVER_MAX_CONNECTIONS
            int "Server: default maximum connections"
            default 2
            help
                The default maximum connections of the server.

        config BROOKESIA_SERVICE_MANAGER_RPC_CLIENT_CALL_FUNCTION_TIMEOUT_MS
            int "Client: default call function timeout (ms)"
            default 2000
            help
                The default timeout of the client call function. If the timeout is not specified when calling the function, this value will be used.
    endmenu

    menu "Worker"
        menu "General"
            config BROOKESIA_SERVICE_MANAGER_WORKER_NAME
                string "Name"
                default "SvcMgrWorker"
                help
                    The name of the worker thread.

            config BROOKESIA_SERVICE_MANAGER_WORKER_PRIORITY
                int "Priority"
                default 5
                help
                    The priority of the worker thread.

            config BROOKESIA_SERVICE_MANAGER_WORKER_STACK_SIZE
                int "Stack size"
                default 15360
                help
                    The stack size of the worker thread.

            config BROOKESIA_SERVICE_MANAGER_WORKER_STACK_IN_EXT
                bool "Stack in external memory"
                depends on SPIRAM
                default y
                help
                    Whether the stack of the worker thread is in external memory. If enabled, the stack will be allocated in external memory.

            config BROOKESIA_SERVICE_MANAGER_WORKER_POLL_INTERVAL_MS
                int "Poll interval (ms)"
                default 5
                range 1 10
                help
                    The interval of the worker poll.
        endmenu

        config BROOKESIA_SERVICE_MANAGER_WORKER_0_CORE_ID
            int "Core ID of Worker 0"
            range -1 1
            default 0
            help
                The core ID of Worker 0. `-1` means the core ID is not specified.

        config BROOKESIA_SERVICE_MANAGER_WORKER_1_CORE_ID
            int "Core ID of Worker 1"
            range -1 1
            default 1
            help
                The core ID of Worker 1. `-1` means the core ID is not specified.
    endmenu
endmenu
```

## service/brookesia_service_nvs/Kconfig
```kconfig
menu "ESP-Brookesia: Service NVS Configurations"
    config BROOKESIA_SERVICE_NVS_ENABLE_AUTO_REGISTER
        bool "Enable automatic plugin registration"
        default y
        help
            Automatically register the service as a plugin on startup.

    menuconfig BROOKESIA_SERVICE_NVS_ENABLE_DEBUG_LOG
        bool "Enable debug or lower level logs"
        default n

    menu "Worker"
        depends on BROOKESIA_SERVICE_MANAGER_WORKER_STACK_IN_EXT

        config BROOKESIA_SERVICE_NVS_WORKER_NAME
            string "Name"
            default "SvcNVSWorker"
            help
                The name of the worker thread.

        config BROOKESIA_SERVICE_NVS_WORKER_CORE_ID
            int "Core ID"
            default -1
            help
                The core ID of the worker thread. `-1` means the core ID is not specified.

        config BROOKESIA_SERVICE_NVS_WORKER_PRIORITY
            int "Priority"
            default 5
            help
                The priority of the worker thread.

        config BROOKESIA_SERVICE_NVS_WORKER_STACK_SIZE
            int "Stack size"
            default 5120
            help
                The stack size of the worker thread.

        config BROOKESIA_SERVICE_NVS_WORKER_POLL_INTERVAL_MS
            int "Poll interval (ms)"
            default 10
            range 1 10
            help
                The interval of the worker poll.
    endmenu
endmenu
```

## service/brookesia_service_sntp/Kconfig
```kconfig
menu "ESP-Brookesia: Service SNTP Configurations"
    config BROOKESIA_SERVICE_SNTP_ENABLE_AUTO_REGISTER
        bool "Enable automatic plugin registration"
        default y
        help
            Automatically register the service as a plugin on startup.

    menuconfig BROOKESIA_SERVICE_SNTP_ENABLE_DEBUG_LOG
        bool "Enable debug or lower level logs"
        default n

    menu "Server & Timezone"
        config BROOKESIA_SERVICE_SNTP_DEFAULT_NTP_SERVER
            string "Default NTP server"
            default "pool.ntp.org"
            help
                The default NTP server.

        config BROOKESIA_SERVICE_SNTP_DEFAULT_TIMEZONE
            string "Default timezone"
            default "CST-8"
            help
                The default timezone.
    endmenu

    menu "Timing"
        config BROOKESIA_SERVICE_SNTP_WAIT_FOR_NETWORK_INTERVAL_MS
            int "Wait for network interval (ms)"
            default 1000
            help
                The interval of the wait for network. If the network is not connected, the SNTP will wait for the network to be connected and then start.

        config BROOKESIA_SERVICE_SNTP_SYNC_TIME_INTERVAL_MS
            int "Sync time interval (ms)"
            default 1000
            help
                The interval of the sync time.

        config BROOKESIA_SERVICE_SNTP_SYNC_TIME_TIMEOUT_MS
            int "Sync time timeout (ms)"
            default 30000
            help
                The timeout of the sync time.
                If the sync time is not successful after the timeout, the sync will stop.

        config BROOKESIA_SERVICE_SNTP_SYNC_TIME_RETRY_DELAY_MS
            int "Sync time retry delay (ms)"
            default 1000
            help
                The delay of the sync time retry.
                The retry will continue until the sync time is successful or the timeout is reached.
    endmenu
endmenu
```

## service/brookesia_service_video/Kconfig
```kconfig
menu "ESP-Brookesia: Service Video Configurations"
    menuconfig BROOKESIA_SERVICE_VIDEO_ENABLE_DEBUG_LOG
        bool "Enable debug or lower level logs"
        default n

    if BROOKESIA_SERVICE_VIDEO_ENABLE_DEBUG_LOG
        config BROOKESIA_SERVICE_VIDEO_ENCODER_ENABLE_DEBUG_LOG
            bool "Encoder"
            default y

        config BROOKESIA_SERVICE_VIDEO_DECODER_ENABLE_DEBUG_LOG
            bool "Decoder"
            default y
    endif

    menuconfig BROOKESIA_SERVICE_VIDEO_ENABLE_ENCODER
        bool "Enable encoder"
        default y

    if BROOKESIA_SERVICE_VIDEO_ENABLE_ENCODER
        config BROOKESIA_SERVICE_VIDEO_ENCODER_DEFAULT_DEVICE_PATH_PREFIX
            string "Default device path prefix"
            default "/dev/video"
            help
                The default device path prefix of the encoders. E.g., "/dev/video". The final name of the encoder will be like "/dev/video0", "/dev/video1", "/dev/video2", etc.

        config BROOKESIA_SERVICE_VIDEO_ENCODER_DEFAULT_NUM
            int "Default number of encoders"
            default 1
            range 1 3
            help
                The default number of encoders to register.
    endif

    menuconfig BROOKESIA_SERVICE_VIDEO_ENABLE_DECODER
        bool "Enable decoder"
        default y

    if BROOKESIA_SERVICE_VIDEO_ENABLE_DECODER
        config BROOKESIA_SERVICE_VIDEO_DECODER_DEFAULT_NUM
            int "Default number of decoders"
            default 1
            range 1 3
            help
                The default number of decoders to register.
    endif
endmenu
```
