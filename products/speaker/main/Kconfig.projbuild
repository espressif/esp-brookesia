## products/speaker/main/Kconfig.projbuild
```kconfig
menu "Example Configuration"

    menuconfig EXAMPLE_COZE_AGENT_ENABLE_DEFAULT_CONFIG
        bool "Default coze agent config"
        default n

    if EXAMPLE_COZE_AGENT_ENABLE_DEFAULT_CONFIG

        config EXAMPLE_COZE_AGENT_APP_ID
            string "App ID"
            default "110049xxxxxxx"

        config EXAMPLE_COZE_AGENT_PUBLIC_KEY
            string "Public key"
            default "lsKjtB67xxxxxxxxxxxxxxxxxxxxxxxxxxxxxxxxxxx"

        config EXAMPLE_COZE_AGENT_PRIVATE_KEY_FILE_PATH
            string "Private key"
            default "./private_key.pem"

        config EXAMPLE_COZE_AGENT_CUSTOM_CONSUMER
            string "Custom consumer (Optional)"
            default ""

        menuconfig EXAMPLE_COZE_AGENT_BOT1_ENABLE
            bool "Bot 1"
            default y

        if EXAMPLE_COZE_AGENT_BOT1_ENABLE
            config EXAMPLE_COZE_AGENT_BOT1_NAME
                string "Bot name"
                default "Lin Jia Nv Hai"

            config EXAMPLE_COZE_AGENT_BOT1_ID
                string "Bot ID"
                default "7516538xxxxxxxxxxxx"

            config EXAMPLE_COZE_AGENT_BOT1_DESCRIPTION
                string "Bot description"
                default "A warm-voiced female AI character who listens to the user's thoughts and offers comforting responses."

            config EXAMPLE_COZE_AGENT_BOT1_VOICE_ID
                string "Bot voice ID"
                default "7426720361733144585"
        endif

        menuconfig EXAMPLE_COZE_AGENT_BOT2_ENABLE
            bool "Bot 2"
            default y

        if EXAMPLE_COZE_AGENT_BOT2_ENABLE
            config EXAMPLE_COZE_AGENT_BOT2_NAME
                string "Bot name"
                default "Wan Qu Da Shu"

            config EXAMPLE_COZE_AGENT_BOT2_ID
                string "Bot ID"
                default "7516538xxxxxxxxxxxx"

            config EXAMPLE_COZE_AGENT_BOT2_DESCRIPTION
                string "Bot description"
                default "A male AI character with a regional accent. He responds quickly and concisely, but does not perform actions on behalf of the user."

            config EXAMPLE_COZE_AGENT_BOT2_VOICE_ID
                string "Bot voice ID"
                default "7426720361732915209"
        endif
    endif

endmenu
```

## runtime/brookesia_runtime_elf/Kconfig
```kconfig
menu "ESP-Brookesia: Runtime ELF Configurations"
    config BROOKESIA_RUNTIME_ELF_ENABLE_AUTO_REGISTER
        bool "Enable auto-register as runtime backend service"
        default y

    menuconfig BROOKESIA_RUNTIME_ELF_ENABLE_DEBUG_LOG
        bool "Enable debug or lower level logs"
        default n

    if BROOKESIA_RUNTIME_ELF_ENABLE_DEBUG_LOG
        config BROOKESIA_RUNTIME_ELF_BACKEND_ENABLE_DEBUG_LOG
            bool "Backend"
            default y
    endif
endmenu
```

## runtime/brookesia_runtime_js/Kconfig
```kconfig
menu "ESP-Brookesia: Runtime JavaScript Configurations"
    config BROOKESIA_RUNTIME_JS_ENABLE_AUTO_REGISTER
        bool "Enable auto-register as runtime backend service"
        default y

    menuconfig BROOKESIA_RUNTIME_JS_ENABLE_DEBUG_LOG
        bool "Enable debug or lower level logs"
        default n

    if BROOKESIA_RUNTIME_JS_ENABLE_DEBUG_LOG
        config BROOKESIA_RUNTIME_JS_BACKEND_ENABLE_DEBUG_LOG
            bool "Backend"
            default y
    endif
endmenu
```

## runtime/brookesia_runtime_manager/Kconfig
```kconfig
menu "ESP-Brookesia: Runtime Manager Configurations"
    menuconfig BROOKESIA_RUNTIME_MANAGER_ENABLE_DEBUG_LOG
        bool "Enable debug or lower level logs"
        default n

    if BROOKESIA_RUNTIME_MANAGER_ENABLE_DEBUG_LOG
        config BROOKESIA_RUNTIME_MANAGER_CORE_ENABLE_DEBUG_LOG
            bool "Core"
            default y

        config BROOKESIA_RUNTIME_MANAGER_HOST_BRIDGE_ENABLE_DEBUG_LOG
            bool "Host Bridge"
            default y

        config BROOKESIA_RUNTIME_MANAGER_FUNCTION_BRIDGE_ENABLE_DEBUG_LOG
            bool "Function Bridge"
            default y
    endif
endmenu
```

## runtime/brookesia_runtime_wasm/Kconfig
```kconfig
menu "ESP-Brookesia: Runtime WASM Configurations"
    config BROOKESIA_RUNTIME_WASM_ENABLE_AUTO_REGISTER
        bool "Enable auto-register as runtime backend service"
        default y

    menuconfig BROOKESIA_RUNTIME_WASM_ENABLE_DEBUG_LOG
        bool "Enable debug or lower level logs"
        default n

    config BROOKESIA_RUNTIME_WASM_WAMR_ENABLED
        bool
        default y
        select WAMR_ENABLE_REF_TYPES

    if BROOKESIA_RUNTIME_WASM_ENABLE_DEBUG_LOG
        config BROOKESIA_RUNTIME_WASM_BACKEND_ENABLE_DEBUG_LOG
            bool "Backend"
            default y

        config BROOKESIA_RUNTIME_WASM_HOST_IMPORT_ENABLE_DEBUG_LOG
            bool "Host Import"
            default y
    endif
endmenu
```

## service/agent/brookesia_agent_coze/Kconfig
```kconfig
menu "ESP-Brookesia: Agent Coze Configurations"
    config BROOKESIA_AGENT_COZE_ENABLE_CONFIGS
        bool
        select ESP_WS_CLIENT_SEPARATE_TX_LOCK
        default y

    config BROOKESIA_AGENT_COZE_ENABLE_AUTO_REGISTER
        bool "Enable automatic plugin registration"
        default y
        help
            Automatically register the agent as a plugin on startup.

    config BROOKESIA_AGENT_COZE_ENABLE_DEBUG_LOG
        bool "Enable debug or lower level logs"
        default n

    config BROOKESIA_AGENT_COZE_ENABLE_AUTO_LOAD_DATA
        bool "Automatically load persisted Coze data on activation"
        default y
        help
            Load persisted Coze agent data when the agent activates.
endmenu
```

## service/agent/brookesia_agent_openai/Kconfig
```kconfig
menu "ESP-Brookesia: Agent Openai Configurations"
    config BROOKESIA_AGENT_OPENAI_ENABLE_CONFIGS
        bool
        select MBEDTLS_SSL_PROTO_DTLS
        select ESP_WS_CLIENT_SEPARATE_TX_LOCK
        select MBEDTLS_SSL_DTLS_SRTP
        select MBEDTLS_X509_CREATE_C
        default y

    config BROOKESIA_AGENT_OPENAI_ENABLE_AUTO_REGISTER
        bool "Enable automatic plugin registration"
        default y
        help
            Automatically register the agent as a plugin on startup.

    config BROOKESIA_AGENT_OPENAI_ENABLE_DEBUG_LOG
        bool "Enable debug or lower level logs"
        default n

    config BROOKESIA_AGENT_OPENAI_ENABLE_AUTO_LOAD_DATA
        bool "Automatically load persisted OpenAI data on activation"
        default y
        help
            Load persisted OpenAI agent data when the agent activates.
endmenu
```

## service/brookesia_service_audio/Kconfig
```kconfig
menu "ESP-Brookesia: Service Audio Configurations"
    config BROOKESIA_SERVICE_AUDIO_ENABLE_AUTO_REGISTER
        bool "Enable automatic plugin registration"
        default y
        help
            Automatically register the service as a plugin on startup.

    menuconfig BROOKESIA_SERVICE_AUDIO_ENABLE_DEBUG_LOG
        bool "Enable debug or lower level logs"
        default n

    menuconfig BROOKESIA_SERVICE_AUDIO_ENABLE_WORKER
        bool "Enable worker"
        default n

    if BROOKESIA_SERVICE_AUDIO_ENABLE_WORKER
        config BROOKESIA_SERVICE_AUDIO_WORKER_NAME
            string "Name"
            default "SvcAudioWorker"
            help
                The name of the worker thread.

        config BROOKESIA_SERVICE_AUDIO_WORKER_CORE_ID
            int "Core ID"
            default -1
            help
                The core ID of the worker thread. `-1` means the core ID is not specified.

        config BROOKESIA_SERVICE_AUDIO_WORKER_PRIORITY
            int "Priority"
            default 5
            help
                The priority of the worker thread.

        config BROOKESIA_SERVICE_AUDIO_WORKER_STACK_SIZE
            int "Stack size"
            default 8192
            help
                The stack size of the worker thread.

        config BROOKESIA_SERVICE_AUDIO_WORKER_STACK_IN_EXT
            bool "Stack in external memory"
            depends on SPIRAM
            default y
            help
                Whether the stack of the worker thread is in external memory. If enabled, the stack will be allocated in external memory.

        config BROOKESIA_SERVICE_AUDIO_WORKER_POLL_INTERVAL_MS
            int "Poll interval (ms)"
            default 10
            range 1 10
            help
                The interval of the worker poll.
    endif
endmenu
```

## service/brookesia_service_battery/Kconfig
```kconfig
menu "ESP-Brookesia: Service Battery Configurations"
    config BROOKESIA_SERVICE_BATTERY_ENABLE_AUTO_REGISTER
        bool "Enable automatic plugin registration"
        default y
        help
            Automatically register the service as a plugin on startup.

    menuconfig BROOKESIA_SERVICE_BATTERY_ENABLE_DEBUG_LOG
        bool "Enable debug or lower level logs"
        default n
endmenu
```

## service/brookesia_service_custom/test_apps/sdkconfig.defaults.esp32p4
```kconfig
# When running CI, CONFIG_IDF_CI_BUILD is automatically enabled, which causes CONFIG_ESP32P4_SELECTS_REV_LESS_V3=n
# so we manually enable it here
CONFIG_ESP32P4_SELECTS_REV_LESS_V3=y
```

## service/brookesia_service_device/Kconfig
```kconfig
menu "ESP-Brookesia: Service Device Configurations"
    config BROOKESIA_SERVICE_DEVICE_ENABLE_AUTO_REGISTER
        bool "Enable automatic plugin registration"
        default y
        help
            Automatically register the service as a plugin on startup.

    menuconfig BROOKESIA_SERVICE_DEVICE_ENABLE_DEBUG_LOG
        bool "Enable debug or lower level logs"
        default n

    menu "Worker"
        config BROOKESIA_SERVICE_DEVICE_WORKER_NAME
            string "Name"
            default "SvcDeviceWorker"
            help
                The name of the worker thread.

        config BROOKESIA_SERVICE_DEVICE_WORKER_PRIORITY
            int "Priority"
            default 5
            help
                The priority of the worker thread.

        config BROOKESIA_SERVICE_DEVICE_WORKER_STACK_SIZE
            int "Stack size"
            default 6144
            help
                The stack size of the worker thread.

        config BROOKESIA_SERVICE_DEVICE_WORKER_POLL_INTERVAL_MS
            int "Poll interval (ms)"
            default 10
            range 1 100
            help
                The interval of the worker poll.
    endmenu

    menu "Parameters"
        config BROOKESIA_SERVICE_DEVICE_NVS_SAVE_DATA_TIMEOUT_MS
            int "NVS save timeout (ms)"
            default 500
            range 1 1000
            help
                Timeout in milliseconds used when saving persisted device state.

        config BROOKESIA_SERVICE_DEVICE_NVS_ERASE_DATA_TIMEOUT_MS
            int "NVS erase timeout (ms)"
            default 500
            range 1 1000
            help
                Timeout in milliseconds used when erasing persisted device state.
    endmenu

    menu "Power Battery"
        config BROOKESIA_SERVICE_DEVICE_POWER_BATTERY_POLL_INTERVAL_MS
            int "Battery poll interval (ms)"
            default 1000
            range 100 60000
            help
                Poll interval used to refresh battery state and battery charge configuration snapshots.
    endmenu

    menu "Audio"
        config BROOKESIA_SERVICE_DEVICE_AUDIO_PLAYER_VOLUME_DEFAULT
            int "Player default volume (percent)"
            default 75
            range 0 100
            help
                The default volume of the audio player, in percent.

        config BROOKESIA_SERVICE_DEVICE_AUDIO_PLAYER_VOLUME_MIN
            int "Player minimum hardware volume"
            default 0
            help
                The minimum hardware volume of the audio player

        config BROOKESIA_SERVICE_DEVICE_AUDIO_PLAYER_VOLUME_MAX
            int "Player maximum hardware volume"
            default 100
            help
                The maximum hardware volume of the audio player

        config BROOKESIA_SERVICE_DEVICE_AUDIO_PLAYER_DEFAULT_MUTE
            bool "Player default mute"
            default y
            help
                The default mute state of the audio player, true to mute, false to unmute
    endmenu

    menu "Display"
        config BROOKESIA_SERVICE_DEVICE_DISPLAY_BACKLIGHT_BRIGHTNESS_DEFAULT
            int "Backlight default brightness (percent)"
            default 90
            range 0 100
            help
                The default brightness of the display backlight, in percent

        config BROOKESIA_SERVICE_DEVICE_DISPLAY_BACKLIGHT_BRIGHTNESS_MIN
            int "Backlight minimum hardware brightness"
            default 20
            help
                The minimum hardware brightness of the display backlight

        config BROOKESIA_SERVICE_DEVICE_DISPLAY_BACKLIGHT_BRIGHTNESS_MAX
            int "Backlight maximum hardware brightness"
            default 100
            help
                The maximum hardware brightness of the display backlight

        config BROOKESIA_SERVICE_DEVICE_DISPLAY_BACKLIGHT_DEFAULT_ON
            bool "Backlight default on"
            default n
            help
                The default on state of the display backlight, true to on, false to off.
    endmenu
endmenu
```
