## service/brookesia_service_wifi/Kconfig
```kconfig
menu "ESP-Brookesia: Service WiFi Configurations"
    config BROOKESIA_SERVICE_WIFI_ENABLE_AUTO_REGISTER
        bool "Enable automatic plugin registration"
        default y
        help
            Automatically register the service as a plugin on startup.

    menuconfig BROOKESIA_SERVICE_WIFI_ENABLE_DEBUG_LOG
        bool "Enable debug or lower level logs"
        default n

    if BROOKESIA_SERVICE_WIFI_ENABLE_DEBUG_LOG
        config BROOKESIA_SERVICE_WIFI_SERVICE_ENABLE_DEBUG_LOG
            bool "Service"
            default y

        config BROOKESIA_SERVICE_WIFI_HAL_ENABLE_DEBUG_LOG
            bool "Hal"
            default y

        config BROOKESIA_SERVICE_WIFI_STATE_MACHINE_ENABLE_DEBUG_LOG
            bool "State Machine"
            default y
    endif

    menuconfig BROOKESIA_SERVICE_WIFI_ENABLE_WORKER
        bool "Enable worker"
        default n

    if BROOKESIA_SERVICE_WIFI_ENABLE_WORKER
        menu "General"
            config BROOKESIA_SERVICE_WIFI_WORKER_NAME
                string "Name"
                default "SvcWifiWorker"
                help
                    The name of the worker thread.

            config BROOKESIA_SERVICE_WIFI_WORKER_PRIORITY
                int "Priority"
                default 5
                help
                    The priority of the worker thread.

            config BROOKESIA_SERVICE_WIFI_WORKER_STACK_SIZE
                int "Stack size"
                default 8192
                help
                    The stack size of the worker thread.

            config BROOKESIA_SERVICE_WIFI_WORKER_STACK_IN_EXT
                bool "Stack in external memory"
                depends on SPIRAM
                default y
                help
                    Whether the stack of the worker thread is in external memory. If enabled, the stack will be allocated in external memory.

            config BROOKESIA_SERVICE_WIFI_WORKER_POLL_INTERVAL_MS
                int "Poll interval (ms)"
                default 10
                range 1 10
                help
                    The interval of the worker poll.
        endmenu

        config BROOKESIA_SERVICE_WIFI_WORKER_0_CORE_ID
            int "Core ID of Worker 0"
            default 0
            help
                The core ID of Worker 0. `-1` means the core ID is not specified.

        config BROOKESIA_SERVICE_WIFI_WORKER_1_CORE_ID
            int "Core ID of Worker 1"
            default 1
            help
                The core ID of Worker 1. `-1` means the core ID is not specified.
    endif

    menu "Parameters"
        menu "Hal"
            menu "General"
                config BROOKESIA_SERVICE_WIFI_HAL_WAIT_EVENT_INITED_TIMEOUT_MS
                    int "Wait event inited timeout (ms)"
                    default 8000 if ESP_HOSTED_ENABLED
                    default 2000
                    range 100 30000
                    help
                        Timeout in milliseconds to wait for WiFi inited event.

                config BROOKESIA_SERVICE_WIFI_HAL_WAIT_EVENT_DEINITED_TIMEOUT_MS
                    int "Wait event deinited timeout (ms)"
                    default 2000
                    range 100 30000
                    help
                        Timeout in milliseconds to wait for WiFi deinited event.

                config BROOKESIA_SERVICE_WIFI_HAL_WAIT_EVENT_STARTED_TIMEOUT_MS
                    int "Wait event started timeout (ms)"
                    default 2000
                    range 100 30000
                    help
                        Timeout in milliseconds to wait for WiFi started event.

                config BROOKESIA_SERVICE_WIFI_HAL_WAIT_EVENT_STOPPED_TIMEOUT_MS
                    int "Wait event stopped timeout (ms)"
                    default 2000
                    range 100 30000
                    help
                        Timeout in milliseconds to wait for WiFi stopped event.
            endmenu

            menu "Station"
                config BROOKESIA_SERVICE_WIFI_HAL_WAIT_EVENT_CONNECTED_TIMEOUT_MS
                    int "Wait event connected timeout (ms)"
                    default 15000
                    range 1000 30000
                    help
                        Timeout in milliseconds to wait for WiFi connected event.

                config BROOKESIA_SERVICE_WIFI_HAL_WAIT_EVENT_DISCONNECTED_TIMEOUT_MS
                    int "Wait event disconnected timeout (ms)"
                    default 2000
                    range 100 30000
                    help
                        Timeout in milliseconds to wait for WiFi disconnected event.

                config BROOKESIA_SERVICE_WIFI_HAL_CONNECT_RETRIES_MAX
                    int "Connect retries max"
                    default 3
                    range 1 10
                    help
                        Maximum number of connect retries.

                config BROOKESIA_SERVICE_WIFI_HAL_AUTO_CONNECT_DELAY_MS
                    int "Auto connect delay (ms)"
                    default 2000
                    range 100 10000
                    help
                        Delay in milliseconds to wait for auto connect when WiFi is started.
            endmenu

            menu "SoftAP"
                config BROOKESIA_SERVICE_WIFI_SOFTAP_CHANNEL_MIN
                    int "Minimum channel"
                    default 1
                    range 1 11
                    help
                        Minimum channel of SoftAP to setup.

                config BROOKESIA_SERVICE_WIFI_SOFTAP_CHANNEL_MAX
                    int "Maximum channel"
                    default 11
                    range 1 11
                    help
                        Maximum channel of SoftAP to setup.

                config BROOKESIA_SERVICE_WIFI_SOFTAP_CHANNEL_DEFAULT
                    int "Default channel"
                    default 1
                    range 1 11
                    help
                        Default channel of SoftAP to use when no channel is specified and setup failed.

                config BROOKESIA_SERVICE_WIFI_SOFTAP_SETUP_INTERVAL_MS
                    int "Setup interval (ms)"
                    default 1000
                    range 100 10000
                    help
                        Interval of SoftAP setup task.

                config BROOKESIA_SERVICE_WIFI_SOFTAP_SETUP_TIMEOUT_MS
                    int "Setup timeout (ms)"
                    default 300000
                    range 1000 600000
                    help
                        Timeout in milliseconds to wait for SoftAP setup task.

                config BROOKESIA_SERVICE_WIFI_SOFTAP_EVENT_DELAY_MS
                    int "Event delay (ms)"
                    default 2000
                    range 100 10000
                    help
                        Delay in milliseconds to wait for SoftAP event to be published.

                menu "Provision"
                    config BROOKESIA_SERVICE_WIFI_SOFTAP_PROVISION_SCAN_START_INTERVAL_MS
                        int "Provision scan start interval (ms)"
                        default 1000
                        range 100 10000
                        help
                            Interval of SoftAP provision scan start task.

                    config BROOKESIA_SERVICE_WIFI_SOFTAP_PROVISION_SCAN_TIMEOUT_MS
                        int "Provision scan timeout (ms)"
                        default 20000
                        range 1000 60000
                        help
                            Timeout in milliseconds to wait for SoftAP provision scan task.

                    config BROOKESIA_SERVICE_WIFI_SOFTAP_PROVISION_SUCCESS_CLOSE_DELAY_MS
                        int "Provision close after success delay (ms)"
                        default 3000
                        range 100 10000
                        help
                            Delay in milliseconds to wait for SoftAP provision connect success.

                    menu "DNS Thread"
                        config BROOKESIA_SERVICE_WIFI_SOFTAP_PROVISION_DNS_THREAD_STACK_SIZE
                            int "Stack size"
                            default 4096
                            help
                                Stack size of the provision DNS thread.

                        config BROOKESIA_SERVICE_WIFI_SOFTAP_PROVISION_DNS_THREAD_PRIORITY
                            int "Priority"
                            default 3
                            help
                                Priority of the provision DNS thread.

                        config BROOKESIA_SERVICE_WIFI_SOFTAP_PROVISION_DNS_THREAD_CORE_ID
                            int "Core ID"
                            default -1
                            range -1 1
                            help
                                Core ID of the provision DNS thread. `-1` means the core ID is not specified.
                    endmenu
                endmenu
            endmenu
        endmenu

        menu "State Machine"
            config BROOKESIA_SERVICE_WIFI_STATE_MACHINE_UPDATE_INTERVAL_MS
                int "General state update interval (ms)"
                default 50
                range 10 1000
                help
                    The interval of the general state update.

            config BROOKESIA_SERVICE_WIFI_STATE_MACHINE_WAIT_FINISHED_TIMEOUT_MS
                int "Wait state machine finished timeout (ms)"
                default 5000
                range 1000 30000
                help
                    Timeout in milliseconds to wait for state machine finished.
        endmenu

        menu "Service"
            config BROOKESIA_SERVICE_WIFI_SERVICE_WAIT_DEINIT_FINISHED_TIMEOUT_MS
                int "Wait deinit finished timeout (ms)"
                default 5000
                range 1000 30000
                help
                    Timeout in milliseconds to wait for service deinit finished.

            config BROOKESIA_SERVICE_WIFI_SERVICE_GENERAL_ACTION_QUEUE_DISPATCH_INTERVAL_MS
                int "General action queue dispatch interval (ms)"
                default 100
                range 10 1000
                help
                    Interval in milliseconds to dispatch general action queue.

            config BROOKESIA_SERVICE_WIFI_SERVICE_NVS_SAVE_DATA_TIMEOUT_MS
                int "NVS save data timeout (ms)"
                default 100
                range 10 1000
                help
                    Timeout in milliseconds to wait for NVS save data.

            config BROOKESIA_SERVICE_WIFI_SERVICE_NVS_ERASE_DATA_TIMEOUT_MS
                int "NVS erase data timeout (ms)"
                default 100
                range 10 1000
                help
                    Timeout in milliseconds to wait for NVS erase data.
        endmenu
    endmenu
endmenu
```
