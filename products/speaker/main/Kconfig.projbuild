## service/emulation/brookesia_emulation_nes/Kconfig
```kconfig
menu "ESP-Brookesia: Emulation NES Configurations"
    config BROOKESIA_EMULATION_NES_ENABLE_AUTO_REGISTER
        bool "Enable automatic plugin registration"
        default y
        help
            Automatically register the NES service as a plugin on startup.

    menuconfig BROOKESIA_EMULATION_NES_ENABLE_DEBUG_LOG
        bool "Enable debug or lower level logs"
        default n

    config BROOKESIA_EMULATION_NES_FRAME_INTERVAL_MS
        int "NES frame scheduler tick interval (ms)"
        default 2
        range 1 100
        help
            Tick interval used by the service-owned NES frame task. The emulator frame
            cadence is controlled by FRAME_PERIOD_MS.

    config BROOKESIA_EMULATION_NES_FRAME_PERIOD_MS
        int "NES emulation frame period (ms)"
        default 16
        range 1 100
        help
            Target emulation frame period. Use 16 ms for a 60 Hz NTSC-style loop.

    config BROOKESIA_EMULATION_NES_BASE_FRAME_SKIP
        int "Base skipped video frames after each drawn frame"
        default 0
        range 0 10
        help
            Minimum number of no-draw emulation frames after each drawn frame.
            Keep this at 0 when comparing same-resolution video performance.

    config BROOKESIA_EMULATION_NES_AUTO_FRAME_SKIP_MAX
        int "Maximum automatic skipped video frames"
        default 2
        range 0 10
        help
            Upper bound for automatic frame skip adjustment. CPU, APU and input
            still advance while video conversion/present is skipped.

    config BROOKESIA_EMULATION_NES_MAX_CONSECUTIVE_FRAME_SKIP
        int "Maximum consecutive skipped video frames"
        default 2
        range 0 10
        help
            Maximum number of consecutive no-draw emulation frames used to recover
            when the frame loop falls behind. Audio and CPU emulation still advance.

    menuconfig BROOKESIA_EMULATION_NES_ENABLE_WORKER
        bool "Enable dedicated workers"
        default n

    if BROOKESIA_EMULATION_NES_ENABLE_WORKER
        menu "Worker"
            menu "General"
                config BROOKESIA_EMULATION_NES_WORKER_NAME
                    string "Name"
                    default "SvcNES"
                    help
                        Prefix used by the NES service worker threads.

                config BROOKESIA_EMULATION_NES_WORKER_PRIORITY
                    int "Priority"
                    default 7
                    range 1 25
                    help
                        The priority of the worker thread.

                config BROOKESIA_EMULATION_NES_WORKER_STACK_SIZE
                    int "Stack size"
                    default 12288
                    range 4096 65536
                    help
                        The stack size of the worker thread.

                config BROOKESIA_EMULATION_NES_WORKER_STACK_IN_EXT
                    bool "Stack in external memory"
                    depends on SPIRAM
                    default y
                    help
                        Whether the stack of the worker thread is in external memory. If enabled, the stack will be allocated in external memory.

                config BROOKESIA_EMULATION_NES_WORKER_POLL_INTERVAL_MS
                    int "Poll interval (ms)"
                    default 4
                    range 1 100
                    help
                        Poll interval used by the NES service task scheduler workers.
            endmenu

            config BROOKESIA_EMULATION_NES_WORKER_0_CORE_ID
                int "Core ID of Worker 0"
                default 0
                range -1 8
                help
                    Core affinity for Worker 0, which runs the frame task. Use -1 for no affinity.

            config BROOKESIA_EMULATION_NES_WORKER_1_CORE_ID
                int "Core ID of Worker 1"
                default 1
                range -1 8
                help
                    Core affinity for Worker 1, which runs the audio feed task. Use -1 for no affinity.
        endmenu
    endif

    config BROOKESIA_EMULATION_NES_AUDIO_QUEUE_MAX_FRAMES
        int "NES audio queue frame count"
        default 32
        range 1 64
        help
            Number of PCM chunks kept in the NES audio ring buffer.

    config BROOKESIA_EMULATION_NES_AUDIO_FEED_MAX_CHUNKS_PER_TICK
        int "Maximum audio chunks fed per scheduler tick"
        default 2
        range 1 16
        help
            Caps how much audio work one audio task invocation may perform.

    config BROOKESIA_EMULATION_NES_AUDIO_FEED_BUDGET_MS
        int "Audio feed time budget per scheduler tick (ms)"
        default 2
        range 0 100
        help
            Time budget for one audio feed task. Use 0 to disable the time budget.

    config BROOKESIA_EMULATION_NES_AUDIO_SAMPLE_RATE
        int "NES audio sample rate"
        default 22050
        range 8000 48000
        help
            Sample rate passed to nofrendo and AudioDecoder. Lower rates reduce CPU
            and audio feed bandwidth.

    config BROOKESIA_EMULATION_NES_AUDIO_STEREO
        bool "Enable NES stereo audio"
        default n
        help
            Stereo improves audio quality but doubles PCM bandwidth.

    config BROOKESIA_EMULATION_NES_LOG_BUFFER_MEMORY
        bool "Log NES buffer memory regions"
        default n
        help
            Log low-frequency NES buffer allocation diagnostics.

    config BROOKESIA_EMULATION_NES_PERF_LOG_INTERVAL_MS
        int "NES performance log interval (ms)"
        default 5000
        range 0 60000
        help
            Interval for low-frequency frame/audio performance logs. Use 0 to disable.

    config BROOKESIA_EMULATION_NES_DRAW_TIMEOUT_MS
        int "Display draw timeout (ms)"
        default 5000
        range 1 60000
        help
            Timeout used when presenting a NES frame through Display service.

    config BROOKESIA_EMULATION_NES_ENABLE_NOFRENDO
        bool "Enable nofrendo backend"
        default y
        help
            Enable the imported nofrendo backend when its platform port is available.
endmenu
```

## service/expression/brookesia_expression_emote/Kconfig
```kconfig
menu "ESP-Brookesia: Expression Emote Configurations"
    config BROOKESIA_EXPRESSION_EMOTE_ENABLE_CONFIGS
        bool
        select LV_FONT_FMT_TXT_LARGE
        default y

    config BROOKESIA_EXPRESSION_EMOTE_ENABLE_AUTO_REGISTER
        bool "Enable automatic plugin registration"
        default y
        help
            Automatically register the expression as a plugin on startup.

    menuconfig BROOKESIA_EXPRESSION_EMOTE_ENABLE_DEBUG_LOG
        bool "Enable debug or lower level logs"
        default n

    menuconfig BROOKESIA_EXPRESSION_EMOTE_ENABLE_WORKER
        bool "Enable worker"
        default y if SPIRAM && BROOKESIA_SERVICE_MANAGER_WORKER_STACK_IN_EXT
        default n

    if BROOKESIA_EXPRESSION_EMOTE_ENABLE_WORKER
        config BROOKESIA_EXPRESSION_EMOTE_WORKER_NAME
            string "Name"
            default "EmoteWorker"
            help
                The name of the worker thread.

        config BROOKESIA_EXPRESSION_EMOTE_WORKER_CORE_ID
            int "Core ID"
            default -1
            help
                The core ID of the worker thread. `-1` means the core ID is not specified.

        config BROOKESIA_EXPRESSION_EMOTE_WORKER_PRIORITY
            int "Priority"
            default 5
            help
                The priority of the worker thread.

        config BROOKESIA_EXPRESSION_EMOTE_WORKER_STACK_SIZE
            int "Stack size"
            default 6144
            help
                The stack size of the worker thread.

        config BROOKESIA_EXPRESSION_EMOTE_WORKER_POLL_INTERVAL_MS
            int "Poll interval (ms)"
            default 10
            range 1 10
            help
                The interval of the worker poll.
    endif
endmenu
```

## service/framework/brookesia_service_manager/Kconfig
```kconfig
menu "ESP-Brookesia: Service Manager Configurations"
    config BROOKESIA_SERVICE_MANAGER_BOOST_ENABLED
        bool
        select BOOST_THREAD_ENABLED
        select BOOST_JSON_ENABLED
        default y
        help
            Enable Boost libraries.

    menuconfig BROOKESIA_SERVICE_MANAGER_ENABLE_DEBUG_LOG
        bool "Enable debug or lower level logs"
        default n

    if BROOKESIA_SERVICE_MANAGER_ENABLE_DEBUG_LOG
        config BROOKESIA_SERVICE_MANAGER_EVENT_ENABLE_DEBUG_LOG
            bool "Event"
            default y

        config BROOKESIA_SERVICE_MANAGER_FUNCTION_ENABLE_DEBUG_LOG
            bool "Function"
            default y

        config BROOKESIA_SERVICE_MANAGER_SERVICE_ENABLE_DEBUG_LOG
            bool "Service"
            default y
    endif

    config BROOKESIA_SERVICE_MANAGER_DEFAULT_CALL_FUNCTION_TIMEOUT_MS
        int "Default call function timeout (ms)"
        default 1000
        help
            The default timeout of the call function. If the timeout is not specified when calling the function, this value will be used.
            When debug log level is enabled, a large number of logs may cause call function timeouts. In this case, this value can be increased to avoid timeouts.

    menu "Main Scheduler"
        menu "General"
            config BROOKESIA_SERVICE_MANAGER_WORKER_NAME
                string "Name"
                default "SvcMgrMain"
                help
                    The name of the worker thread.

            config BROOKESIA_SERVICE_MANAGER_WORKER_PRIORITY
                int "Priority"
                default 5
                help
                    The priority of the worker thread.

            config BROOKESIA_SERVICE_MANAGER_WORKER_STACK_SIZE
                int "Stack size"
                default 15360
                help
                    The stack size of the worker thread.

            config BROOKESIA_SERVICE_MANAGER_WORKER_STACK_IN_EXT
                bool "Stack in external memory"
                depends on SPIRAM
                default y
                help
                    Whether the stack of the worker thread is in external memory. If enabled, the stack will be allocated in external memory.

            config BROOKESIA_SERVICE_MANAGER_WORKER_POLL_INTERVAL_MS
                int "Poll interval (ms)"
                default 5
                range 1 10
                help
                    The interval of the worker poll.
        endmenu

        config BROOKESIA_SERVICE_MANAGER_WORKER_NUM
            int "Number of workers"
            default 3
            range 1 4
            help
                The number of workers.

        config BROOKESIA_SERVICE_MANAGER_WORKER_0_CORE_ID
            int "Core ID of Worker 0"
            range -1 1
            default 0
            help
                The core ID of Worker 0. `-1` means the core ID is not specified.

        if BROOKESIA_SERVICE_MANAGER_WORKER_NUM >= 2
            config BROOKESIA_SERVICE_MANAGER_WORKER_1_CORE_ID
                int "Core ID of Worker 1"
                range -1 1
                default 1
                help
                    The core ID of Worker 1. `-1` means the core ID is not specified.
        endif

        if BROOKESIA_SERVICE_MANAGER_WORKER_NUM >= 3
            config BROOKESIA_SERVICE_MANAGER_WORKER_2_CORE_ID
                int "Core ID of Worker 2"
                range -1 1
                default -1
                help
                    The core ID of Worker 2. `-1` means the core ID is not specified.
        endif

        if BROOKESIA_SERVICE_MANAGER_WORKER_NUM >= 4
            config BROOKESIA_SERVICE_MANAGER_WORKER_3_CORE_ID
                int "Core ID of Worker 3"
                range -1 1
                default -1
                help
                    The core ID of Worker 3. `-1` means the core ID is not specified.
        endif
    endmenu

    menuconfig BROOKESIA_SERVICE_MANAGER_SECONDARY_SCHEDULER_ENABLE
        bool "Secondary Scheduler"
        default y if BROOKESIA_SERVICE_MANAGER_WORKER_STACK_IN_EXT
        default n
        help
            Enable a second manager-owned task scheduler for services that
            need shared worker threads with internal SRAM stacks.

    if BROOKESIA_SERVICE_MANAGER_SECONDARY_SCHEDULER_ENABLE
        menu "General"
            config BROOKESIA_SERVICE_MANAGER_SECONDARY_SCHEDULER_WORKER_NAME
                string "Name"
                default "SvcMgrSec"
                help
                    The base name of the secondary scheduler worker thread.

            config BROOKESIA_SERVICE_MANAGER_SECONDARY_SCHEDULER_WORKER_PRIORITY
                int "Priority"
                default 5
                help
                    The priority of the secondary scheduler worker thread.

            config BROOKESIA_SERVICE_MANAGER_SECONDARY_SCHEDULER_WORKER_STACK_SIZE
                int "Stack size"
                default 7168
                help
                    The stack size of the secondary scheduler worker thread.
                    The stack is always allocated from internal SRAM.

            config BROOKESIA_SERVICE_MANAGER_SECONDARY_SCHEDULER_WORKER_POLL_INTERVAL_MS
                int "Poll interval (ms)"
                default 5
                range 1 10
                help
                    The interval of the secondary scheduler worker poll.
        endmenu

        config BROOKESIA_SERVICE_MANAGER_SECONDARY_SCHEDULER_WORKER_NUM
            int "Number of workers"
            default 2
            range 1 4
            help
                The number of secondary scheduler workers.

        config BROOKESIA_SERVICE_MANAGER_SECONDARY_SCHEDULER_WORKER_0_CORE_ID
            int "Core ID of Worker 0"
            range -1 1
            default 0
            help
                The core ID of Worker 0. `-1` means the core ID is not specified.

        if BROOKESIA_SERVICE_MANAGER_SECONDARY_SCHEDULER_WORKER_NUM >= 2
            config BROOKESIA_SERVICE_MANAGER_SECONDARY_SCHEDULER_WORKER_1_CORE_ID
                int "Core ID of Worker 1"
                range -1 1
                default 1
                help
                    The core ID of Worker 1. `-1` means the core ID is not specified.
        endif

        if BROOKESIA_SERVICE_MANAGER_SECONDARY_SCHEDULER_WORKER_NUM >= 3
            config BROOKESIA_SERVICE_MANAGER_SECONDARY_SCHEDULER_WORKER_2_CORE_ID
                int "Core ID of Worker 2"
                range -1 1
                default -1
                help
                    The core ID of Worker 2. `-1` means the core ID is not specified.
        endif

        if BROOKESIA_SERVICE_MANAGER_SECONDARY_SCHEDULER_WORKER_NUM >= 4
            config BROOKESIA_SERVICE_MANAGER_SECONDARY_SCHEDULER_WORKER_3_CORE_ID
                int "Core ID of Worker 3"
                range -1 1
                default -1
                help
                    The core ID of Worker 3. `-1` means the core ID is not specified.
        endif
    endif
endmenu
```
