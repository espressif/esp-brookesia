## service/network/brookesia_service_http/Kconfig
```kconfig
menu "ESP-Brookesia: Service HTTP Configurations"
    config BROOKESIA_SERVICE_HTTP_ENABLE_AUTO_REGISTER
        bool "Enable automatic plugin registration"
        default y
        help
            Automatically register the service as a plugin on startup.

    menuconfig BROOKESIA_SERVICE_HTTP_ENABLE_DEBUG_LOG
        bool "Enable debug or lower level logs"
        default n

    if BROOKESIA_SERVICE_HTTP_ENABLE_DEBUG_LOG
        config BROOKESIA_SERVICE_HTTP_SERVICE_ENABLE_DEBUG_LOG
            bool "Service"
            default y

        config BROOKESIA_SERVICE_HTTP_STATE_MACHINE_ENABLE_DEBUG_LOG
            bool "State Machine"
            default y
    endif

    menuconfig BROOKESIA_SERVICE_HTTP_ENABLE_WORKER
        bool "Enable worker"
        default y

    if BROOKESIA_SERVICE_HTTP_ENABLE_WORKER
        menu "General"
            config BROOKESIA_SERVICE_HTTP_WORKER_NAME
                string "Name"
                default "SvcHttpWorker"
                help
                    The base name of the worker thread. Each worker thread is
                    suffixed with its index (e.g. SvcHttpWorker0, SvcHttpWorker1).

            config BROOKESIA_SERVICE_HTTP_WORKER_PRIORITY
                int "Priority"
                default 5
                help
                    The priority of the worker thread.

            config BROOKESIA_SERVICE_HTTP_WORKER_STACK_SIZE
                int "Stack size"
                default 12288
                help
                    The stack size of the worker thread.

            config BROOKESIA_SERVICE_HTTP_WORKER_STACK_IN_EXT
                bool "Stack in external memory"
                depends on SPIRAM
                default y
                help
                    Whether the stack of the worker thread is in external memory.

            config BROOKESIA_SERVICE_HTTP_WORKER_POLL_INTERVAL_MS
                int "Poll interval (ms)"
                default 10
                range 1 100
                help
                    The interval of the worker poll.
        endmenu

        config BROOKESIA_SERVICE_HTTP_WORKER_NUM
            int "Number of workers"
            default 2
            range 1 3
            help
                The number of workers. The default is 2 so that long-running
                requests (e.g. large file downloads that block a worker on
                join()) do not starve periodic tasks such as the progress
                emitter.

        config BROOKESIA_SERVICE_HTTP_WORKER_0_CORE_ID
            int "Core ID of Worker 0"
            range -1 1
            default -1
            help
                The core ID of Worker 0. `-1` means the core ID is not specified.

        if BROOKESIA_SERVICE_HTTP_WORKER_NUM >= 2
            config BROOKESIA_SERVICE_HTTP_WORKER_1_CORE_ID
                int "Core ID of Worker 1"
                range -1 1
                default -1
                help
                    The core ID of Worker 1. `-1` means the core ID is not specified.
        endif

        if BROOKESIA_SERVICE_HTTP_WORKER_NUM >= 3
            config BROOKESIA_SERVICE_HTTP_WORKER_2_CORE_ID
                int "Core ID of Worker 2"
                range -1 1
                default -1
                help
                    The core ID of Worker 2. `-1` means the core ID is not specified.
        endif

        if BROOKESIA_SERVICE_HTTP_WORKER_NUM >= 4
            config BROOKESIA_SERVICE_HTTP_WORKER_3_CORE_ID
                int "Core ID of Worker 3"
                range -1 1
                default -1
                help
                    The core ID of Worker 3. `-1` means the core ID is not specified.
        endif
    endif

    menu "Policy"
        config BROOKESIA_SERVICE_HTTP_ENABLE_HTTP
            bool "Enable HTTP"
            default y

        config BROOKESIA_SERVICE_HTTP_ENABLE_HTTPS
            bool "Enable HTTPS"
            default y

        config BROOKESIA_SERVICE_HTTP_REQUIRE_TLS_VERIFY
            bool "Require TLS verification by default"
            default y

        config BROOKESIA_SERVICE_HTTP_REQUIRE_TIME_SYNC
            bool "Require SNTP time synchronization before starting"
            default y if BROOKESIA_SERVICE_HTTP_ENABLE_HTTPS
            default n
            help
                Start the SNTP service and wait until system time is synchronized before
                the HTTP service reports Started. This is useful for HTTPS certificate
                validation.

        config BROOKESIA_SERVICE_HTTP_TIME_SYNC_POLL_MS
            int "Time synchronization poll interval (ms)"
            default 1000
            range 100 60000
            depends on BROOKESIA_SERVICE_HTTP_REQUIRE_TIME_SYNC
            help
                Poll interval used by the HTTP service TimeSyncing state.
    endmenu

    menu "Resource Limits"
        config BROOKESIA_SERVICE_HTTP_MAX_CONCURRENT_REQUESTS
            int "Maximum concurrent requests"
            default 2
            range 1 8

        config BROOKESIA_SERVICE_HTTP_MAX_MEMORY_BODY_SIZE
            int "Maximum memory response body size"
            default 32768
            range 1024 1048576

        config BROOKESIA_SERVICE_HTTP_MAX_DOWNLOAD_FILE_SIZE
            int "Maximum file download size"
            default 4194304
            range 1024 16777216

        config BROOKESIA_SERVICE_HTTP_DEFAULT_TIMEOUT_MS
            int "Default request timeout (ms)"
            default 10000
            range 1000 120000

        config BROOKESIA_SERVICE_HTTP_DEFAULT_RETRY_COUNT
            int "Default retry count"
            default 0
            range 0 5

        config BROOKESIA_SERVICE_HTTP_BUFFER_SIZE
            int "Transfer buffer size"
            default 1024
            range 256 8192

        config BROOKESIA_SERVICE_HTTP_FILE_IO_THREAD_STACK_SIZE
            int "File I/O thread stack size"
            default 8192
            range 4096 32768
            help
                Stack size used by the temporary internal-stack thread when
                downloading an HTTP response directly to a file.
    endmenu
endmenu
```

## service/network/brookesia_service_sntp/test_apps/sdkconfig.defaults
```kconfig
CONFIG_ESP_TASK_WDT_EN=n
CONFIG_FREERTOS_HZ=1000
CONFIG_ESP_MAIN_TASK_STACK_SIZE=10240
CONFIG_ESP_SYSTEM_EVENT_TASK_STACK_SIZE=3072
CONFIG_ESPTOOLPY_FLASHSIZE_4MB=y
CONFIG_PARTITION_TABLE_CUSTOM=y

CONFIG_BROOKESIA_HAL_ADAPTOR_ENABLE_STORAGE_DEVICE=y
CONFIG_BROOKESIA_HAL_ADAPTOR_STORAGE_ENABLE_KEY_VALUE_IMPL=y
CONFIG_BROOKESIA_HAL_ADAPTOR_ENABLE_WIFI_DEVICE=y
CONFIG_BROOKESIA_HAL_ADAPTOR_ENABLE_NETWORK_DEVICE=y
CONFIG_BROOKESIA_HAL_ADAPTOR_NETWORK_ENABLE_SNTP_CLIENT_IMPL=y

CONFIG_LWIP_SNTP_MAX_SERVERS=4
CONFIG_LWIP_SNTP_STARTUP_DELAY=n
CONFIG_LWIP_DHCP_GET_NTP_SRV=y
CONFIG_LWIP_DHCP_MAX_NTP_SERVERS=4
```

## service/network/brookesia_service_wifi/test_apps/sdkconfig.defaults
```kconfig
CONFIG_ESP_TASK_WDT_EN=n
CONFIG_FREERTOS_HZ=1000
CONFIG_ESP_MAIN_TASK_STACK_SIZE=20480
CONFIG_ESP_SYSTEM_EVENT_TASK_STACK_SIZE=3072
CONFIG_ESPTOOLPY_FLASHSIZE_4MB=y
CONFIG_PARTITION_TABLE_CUSTOM=y

CONFIG_ESP_WIFI_STATIC_RX_BUFFER_NUM=6
CONFIG_ESP_WIFI_STATIC_TX_BUFFER_NUM=6
CONFIG_ESP_WIFI_DYNAMIC_RX_MGMT_BUFFER=y
CONFIG_ESP_WIFI_TX_BA_WIN=16
CONFIG_ESP_WIFI_RX_BA_WIN=8
CONFIG_ESP_WIFI_IRAM_OPT=n
CONFIG_ESP_WIFI_RX_IRAM_OPT=n

CONFIG_BROOKESIA_HAL_ADAPTOR_ENABLE_WIFI_DEVICE=y
CONFIG_BROOKESIA_HAL_ADAPTOR_ENABLE_STORAGE_DEVICE=y
CONFIG_BROOKESIA_HAL_ADAPTOR_STORAGE_ENABLE_KEY_VALUE_IMPL=y
```

## service/system/brookesia_service_device/Kconfig
```kconfig
menu "ESP-Brookesia: Service Device Configurations"
    config BROOKESIA_SERVICE_DEVICE_ENABLE_AUTO_REGISTER
        bool "Enable automatic plugin registration"
        default y
        help
            Automatically register the service as a plugin on startup.

    menuconfig BROOKESIA_SERVICE_DEVICE_ENABLE_DEBUG_LOG
        bool "Enable debug or lower level logs"
        default n

    menuconfig BROOKESIA_SERVICE_DEVICE_ENABLE_WORKER
        bool "Enable worker"
        default n

    if BROOKESIA_SERVICE_DEVICE_ENABLE_WORKER
        config BROOKESIA_SERVICE_DEVICE_WORKER_NAME
            string "Name"
            default "SvcDevice"
            help
                The name of the worker thread.

        config BROOKESIA_SERVICE_DEVICE_WORKER_CORE_ID
            int "Core ID"
            default -1
            help
                The core ID of the worker thread. `-1` means the core ID is not specified.

        config BROOKESIA_SERVICE_DEVICE_WORKER_PRIORITY
            int "Priority"
            default 5
            help
                The priority of the worker thread.

        config BROOKESIA_SERVICE_DEVICE_WORKER_STACK_SIZE
            int "Stack size"
            default 6144
            help
                The stack size of the worker thread.

        config BROOKESIA_SERVICE_DEVICE_WORKER_POLL_INTERVAL_MS
            int "Poll interval (ms)"
            default 10
            range 1 100
            help
                The interval of the worker poll.
    endif

    menu "Power Battery"
        config BROOKESIA_SERVICE_DEVICE_POWER_BATTERY_POLL_INTERVAL_MS
            int "Battery poll interval (ms)"
            default 1000
            range 100 60000
            help
                Poll interval used to refresh battery state and battery charge configuration snapshots.
    endmenu

endmenu
```

## service/system/brookesia_service_storage/Kconfig
```kconfig
menu "ESP-Brookesia: Service Storage Configurations"
    config BROOKESIA_SERVICE_STORAGE_ENABLE_AUTO_REGISTER
        bool "Enable automatic plugin registration"
        default y
        help
            Automatically register the service as a plugin on startup.

    menuconfig BROOKESIA_SERVICE_STORAGE_ENABLE_DEBUG_LOG
        bool "Enable debug or lower level logs"
        default n

    menu "Worker"
        depends on BROOKESIA_SERVICE_MANAGER_WORKER_STACK_IN_EXT
        depends on !BROOKESIA_SERVICE_MANAGER_SECONDARY_SCHEDULER_ENABLE

        menu "General"
            config BROOKESIA_SERVICE_STORAGE_WORKER_NAME
                string "Name"
                default "SvcStorage"
                help
                    The base name of the worker thread. Each worker thread is
                    suffixed with its index (e.g. SvcStorage0, SvcStorage1).

            config BROOKESIA_SERVICE_STORAGE_WORKER_PRIORITY
                int "Priority"
                default 10
                help
                    The priority of the worker thread.

            config BROOKESIA_SERVICE_STORAGE_WORKER_STACK_SIZE
                int "Stack size"
                default 7168
                help
                    The stack size of the worker thread.

            config BROOKESIA_SERVICE_STORAGE_WORKER_POLL_INTERVAL_MS
                int "Poll interval (ms)"
                default 10
                range 1 10
                help
                    The interval of the worker poll.
        endmenu

        config BROOKESIA_SERVICE_STORAGE_WORKER_NUM
            int "Number of workers"
            default 1 if CONFIG_SPIRAM_XIP_FROM_PSRAM
            default 2 if !CONFIG_SPIRAM_XIP_FROM_PSRAM
            range 1 2
            help
                The number of workers.

        config BROOKESIA_SERVICE_STORAGE_WORKER_0_CORE_ID
            int "Core ID of Worker 0"
            range -1 1
            default 0
            help
                The core ID of Worker 0. `-1` means the core ID is not specified.

        if BROOKESIA_SERVICE_STORAGE_WORKER_NUM >= 2
            config BROOKESIA_SERVICE_STORAGE_WORKER_1_CORE_ID
                int "Core ID of Worker 1"
                range -1 1
                default 1
                help
                    The core ID of Worker 1. `-1` means the core ID is not specified.
        endif
    endmenu
endmenu
```

## service/system/brookesia_service_storage/test_apps/sdkconfig.defaults
```kconfig
CONFIG_ESP_TASK_WDT_EN=n
CONFIG_FREERTOS_HZ=1000
CONFIG_ESP_MAIN_TASK_STACK_SIZE=10240
CONFIG_ESPTOOLPY_FLASHSIZE_4MB=y
CONFIG_PARTITION_TABLE_CUSTOM=y
CONFIG_BROOKESIA_HAL_ADAPTOR_ENABLE_STORAGE_DEVICE=y
CONFIG_BROOKESIA_HAL_ADAPTOR_STORAGE_ENABLE_FILE_SYSTEM_IMPL=y
CONFIG_BROOKESIA_HAL_ADAPTOR_STORAGE_FILE_SYSTEM_ENABLE_LITTLEFS=y
CONFIG_BROOKESIA_HAL_ADAPTOR_STORAGE_FILE_SYSTEM_LITTLEFS_FORMAT_IF_MOUNT_FAILED=y
CONFIG_BROOKESIA_HAL_ADAPTOR_STORAGE_ENABLE_KEY_VALUE_IMPL=y
```

## src/gui/Kconfig
```kconfig
menu "LVGL"
    menuconfig ESP_BROOKESIA_CONF_LVGL_ENABLE_DEBUG_LOG
        bool "Enable debug log output"
        depends on ESP_UTILS_CONF_LOG_LEVEL_DEBUG
        default y

    if ESP_BROOKESIA_CONF_LVGL_ENABLE_DEBUG_LOG
        config ESP_BROOKESIA_CONF_LVGL_ANIMATION_ENABLE_DEBUG_LOG
            bool "Animation"
            default y

        config ESP_BROOKESIA_CONF_LVGL_CANVAS_ENABLE_DEBUG_LOG
            bool "Canvas"
            default y

        config ESP_BROOKESIA_CONF_LVGL_CONTAINER_ENABLE_DEBUG_LOG
            bool "Container"
            default y

        config ESP_BROOKESIA_CONF_LVGL_DISPLAY_ENABLE_DEBUG_LOG
            bool "Display"
            default y

        config ESP_BROOKESIA_CONF_LVGL_OBJECT_ENABLE_DEBUG_LOG
            bool "Object"
            default y

        config ESP_BROOKESIA_CONF_LVGL_SCREEN_ENABLE_DEBUG_LOG
            bool "Screen"
            default y

        config ESP_BROOKESIA_CONF_LVGL_TIMER_ENABLE_DEBUG_LOG
            bool "Timer"
            default y
    endif # ESP_BROOKESIA_CONF_LVGL_ENABLE_DEBUG_LOG
endmenu

menu "Squareline Helpers"
    config ESP_BROOKESIA_CONF_GUI_SQUARELINE_ENABLE_UI_COMP
        bool "Use UI component from inside"
        default y

    config ESP_BROOKESIA_CONF_GUI_SQUARELINE_ENABLE_UI_HELPERS
        bool "Use UI helpers from inside"
        default y
endmenu
```
