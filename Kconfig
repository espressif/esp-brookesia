## Kconfig
```kconfig
menu "ESP Brookesia Configurations"
    config ESP_BROOKESIA_CONF_FILE_SKIP
        bool "Enable to skip `esp_brookesia_conf.h`"
        default y
        help
            If want to use `esp_brookesia_conf.h` to configure the library, uncheck this option. Otherwise, the configurations in sdkconfig will be used.

    menuconfig ESP_BROOKESIA_CONF_ENABLE_GUI
        bool "GUI"
        depends on ESP_BROOKESIA_CONF_FILE_SKIP
        default y

    if ESP_BROOKESIA_CONF_ENABLE_GUI
        rsource "src/gui/Kconfig"
    endif

    menuconfig ESP_BROOKESIA_CONF_ENABLE_SYSTEMS
        bool "Systems"
        depends on ESP_BROOKESIA_CONF_FILE_SKIP
        default y

    if ESP_BROOKESIA_CONF_ENABLE_SYSTEMS
        rsource "src/systems/Kconfig"
    endif
endmenu
```

## agent/brookesia_agent_coze/Kconfig
```kconfig
menu "ESP-Brookesia: Agent Coze Configurations"
    config BROOKESIA_AGENT_COZE_ENABLE_CONFIGS
        bool
        select ESP_WS_CLIENT_SEPARATE_TX_LOCK
        default y

    config BROOKESIA_AGENT_COZE_ENABLE_AUTO_REGISTER
        bool "Enable automatic plugin registration"
        default y
        help
            Automatically register the agent as a plugin on startup.

    config BROOKESIA_AGENT_COZE_ENABLE_DEBUG_LOG
        bool "Enable debug or lower level logs"
        default n
endmenu
```

## agent/brookesia_agent_manager/Kconfig
```kconfig
menu "ESP-Brookesia: Agent Manager Configurations"
    config BROOKESIA_AGENT_MANAGER_ENABLE_AUTO_REGISTER
        bool "Enable automatic plugin registration"
        default y
        help
            Automatically register the manager as a plugin on startup.

    menuconfig BROOKESIA_AGENT_MANAGER_ENABLE_DEBUG_LOG
        bool "Enable debug or lower level logs"
        default n

    if BROOKESIA_AGENT_MANAGER_ENABLE_DEBUG_LOG
        config BROOKESIA_AGENT_MANAGER_BASE_ENABLE_DEBUG_LOG
            bool "Base"
            default y

        config BROOKESIA_AGENT_MANAGER_MANAGER_ENABLE_DEBUG_LOG
            bool "Manager"
            default y

        config BROOKESIA_AGENT_MANAGER_STATE_MACHINE_ENABLE_DEBUG_LOG
            bool "State Machine"
            default y
    endif

    config BROOKESIA_AGENT_MANAGER_ENABLE_AFE_EVENT_PROCESSING
        bool "Enable AFE event processing"
        default y
        help
            Enable AFE event processing.
            If enabled, the following AFE events will be processed by the agent manager:
            - WakeStart: Trigger the wake up action.
            - WakeEnd: Trigger the sleep action.

    menuconfig BROOKESIA_AGENT_MANAGER_ENABLE_WORKER
        bool "Enable worker"
        default n

    if BROOKESIA_AGENT_MANAGER_ENABLE_WORKER
        config BROOKESIA_AGENT_MANAGER_WORKER_NAME
            string "Name"
            default "AgentMgrWorker"
            help
                The name of the worker thread.

        config BROOKESIA_AGENT_MANAGER_WORKER_CORE_ID
            int "Core ID"
            default -1
            help
                The core ID of the worker thread. `-1` means the core ID is not specified.

        config BROOKESIA_AGENT_MANAGER_WORKER_PRIORITY
            int "Priority"
            default 5
            help
                The priority of the worker thread.

        config BROOKESIA_AGENT_MANAGER_WORKER_STACK_SIZE
            int "Stack size"
            default 8192
            help
                The stack size of the worker thread.

        config BROOKESIA_AGENT_MANAGER_WORKER_STACK_IN_EXT
            bool "Stack in external memory"
            depends on SPIRAM
            default y
            help
                Whether the stack of the worker thread is in external memory. If enabled, the stack will be allocated in external memory.

        config BROOKESIA_AGENT_MANAGER_WORKER_POLL_INTERVAL_MS
            int "Poll interval (ms)"
            default 10
            range 1 10
            help
                The interval of the worker poll.
    endif
endmenu
```

## agent/brookesia_agent_openai/Kconfig
```kconfig
menu "ESP-Brookesia: Agent Openai Configurations"
    config BROOKESIA_AGENT_OPENAI_ENABLE_CONFIGS
        bool
        select MBEDTLS_SSL_PROTO_DTLS
        select ESP_WS_CLIENT_SEPARATE_TX_LOCK
        default y

    config BROOKESIA_AGENT_OPENAI_ENABLE_AUTO_REGISTER
        bool "Enable automatic plugin registration"
        default y
        help
            Automatically register the agent as a plugin on startup.

    config BROOKESIA_AGENT_OPENAI_ENABLE_DEBUG_LOG
        bool "Enable debug or lower level logs"
        default n
endmenu
```

## agent/brookesia_agent_xiaozhi/Kconfig
```kconfig
menu "ESP-Brookesia: Agent Xiaozhi Configurations"
    config BROOKESIA_AGENT_XIAOZHI_ENABLE_AUTO_REGISTER
        bool "Enable automatic plugin registration"
        default y
        help
            Automatically register the agent as a plugin on startup.

    config BROOKESIA_AGENT_XIAOZHI_ENABLE_DEBUG_LOG
        bool "Enable debug or lower level logs"
        default n

    config BROOKESIA_AGENT_XIAOZHI_GET_HTTP_INFO_INTERVAL_MS
        int "Check activation interval in milliseconds"
        default 15000
        help
            The interval to check activation status from the server.

    config BROOKESIA_AGENT_XIAOZHI_WAKE_WORD
        string "Wake word"
        default ""
        help
            The wake word to trigger the agent. If empty, the agent will try to get the wake word.

    menu "Image Explain"
        config BROOKESIA_AGENT_XIAOZHI_IMAGE_EXPLAIN_URL
            string "URL"
            default "http://api.xiaozhi.me/vision/explain"
            help
                The URL to explain the image.

        config BROOKESIA_AGENT_XIAOZHI_IMAGE_EXPLAIN_TOKEN
            string "Token"
            default "test-token"
            help
                The token to authenticate the request.

        config BROOKESIA_AGENT_XIAOZHI_IMAGE_EXPLAIN_RESPONSE_BUFFER_SIZE
            int "Response buffer size"
            default 4096
            help
                The size of the response buffer for the image explain.
    endmenu

    orsource "xiaozhi/Kconfig"

endmenu
```

## agent/brookesia_agent_xiaozhi/esp_xiaozhi/Kconfig.projbuild
```kconfig
menu "Xiaozhi Assistant"
    config XIAOZHI_OTA_URL
        string "Default OTA URL"
        default "https://api.tenclass.net/xiaozhi/ota/"
        help
            The application will access this URL to check for new firmwares and server address.
endmenu
```

## app/brookesia_app_files/Kconfig
```kconfig
menu "ESP-Brookesia: Files App Configurations"
    config BROOKESIA_APP_FILES_ENABLE_PRELOAD_DOM
        bool "Preload Files GUI DOM"
        default y
        help
            Preload and retain the Files app GUI DOM when the app is installed.
            This moves JSON UI parse/load cost out of the user-visible launch path
            at the cost of extra resident PSRAM.
endmenu
```

## app/brookesia_app_settings/Kconfig
```kconfig
menu "ESP-Brookesia: Settings App Configurations"
    config BROOKESIA_APP_SETTINGS_WIFI_MAX_VISIBLE_APS
        int "Wi-Fi AP list page size"
        range 1 30
        default 5
        help
            Number of saved or scanned Wi-Fi access point rows shown per page in Settings.
            Scan results are kept as a full list and paged in the UI.

    config BROOKESIA_APP_SETTINGS_ENABLE_PRELOAD_DOM
        bool "Preload Settings GUI DOM"
        default y
        help
            Preload and retain the Settings app GUI DOM when the app is installed.
            This moves JSON UI parse/load cost out of the user-visible launch path
            at the cost of extra resident PSRAM.

    config BROOKESIA_APP_SETTINGS_ENABLE_MEMORY_TRACE
        bool "Enable Settings memory/heap trace logs (profiling)"
        default n
        help
            When enabled, the Settings app emits [HeapTrace] logs while populating the
            Wi-Fi network lists (e.g. settings.sync_wifi slot accounting). Profiling aid
            only; keep disabled in production builds.

    config BROOKESIA_APP_SETTINGS_ENABLE_PROFILE_LOG
        bool "Enable Settings app profile logs"
        default y if BROOKESIA_APP_SETTINGS_ENABLE_MEMORY_TRACE
        default n
        help
            When enabled, the Settings app emits stage-by-stage startup timing logs.
            Keep disabled in production builds because serial logging perturbs launch
            latency and adds noise to normal operation.

    menu "Debug page parameter ranges"
        config BROOKESIA_APP_SETTINGS_DEBUG_MEMORY_SAMPLE_INTERVAL_MIN_MS
            int "Memory sample interval minimum (ms)"
            range 1 60000
            default 500

        config BROOKESIA_APP_SETTINGS_DEBUG_MEMORY_SAMPLE_INTERVAL_DEFAULT_MS
            int "Memory sample interval default (ms)"
            range 1 60000
            default 1000

        config BROOKESIA_APP_SETTINGS_DEBUG_MEMORY_SAMPLE_INTERVAL_MAX_MS
            int "Memory sample interval maximum (ms)"
            range 1 60000
            default 10000

        config BROOKESIA_APP_SETTINGS_DEBUG_MEMORY_INTERNAL_FREE_PERCENT_THRESHOLD_MIN
            int "SRAM free threshold minimum (%)"
            range 1 99
            default 1

        config BROOKESIA_APP_SETTINGS_DEBUG_MEMORY_INTERNAL_FREE_PERCENT_THRESHOLD_DEFAULT
            int "SRAM free threshold default (%)"
            range 1 99
            default 10

        config BROOKESIA_APP_SETTINGS_DEBUG_MEMORY_INTERNAL_FREE_PERCENT_THRESHOLD_MAX
            int "SRAM free threshold maximum (%)"
            range 1 99
            default 80

        config BROOKESIA_APP_SETTINGS_DEBUG_MEMORY_INTERNAL_LARGEST_FREE_BLOCK_THRESHOLD_MIN_KB
            int "SRAM largest free block threshold minimum (KB)"
            range 1 1048576
            default 1

        config BROOKESIA_APP_SETTINGS_DEBUG_MEMORY_INTERNAL_LARGEST_FREE_BLOCK_THRESHOLD_DEFAULT_KB
            int "SRAM largest free block threshold default (KB)"
            range 1 1048576
            default 10

        config BROOKESIA_APP_SETTINGS_DEBUG_MEMORY_INTERNAL_LARGEST_FREE_BLOCK_THRESHOLD_MAX_KB
            int "SRAM largest free block threshold maximum (KB)"
            range 1 1048576
            default 512

        config BROOKESIA_APP_SETTINGS_DEBUG_MEMORY_EXTERNAL_FREE_PERCENT_THRESHOLD_MIN
            int "PSRAM free threshold minimum (%)"
            range 1 99
            default 1

        config BROOKESIA_APP_SETTINGS_DEBUG_MEMORY_EXTERNAL_FREE_PERCENT_THRESHOLD_DEFAULT
            int "PSRAM free threshold default (%)"
            range 1 99
            default 20

        config BROOKESIA_APP_SETTINGS_DEBUG_MEMORY_EXTERNAL_FREE_PERCENT_THRESHOLD_MAX
            int "PSRAM free threshold maximum (%)"
            range 1 99
            default 80

        config BROOKESIA_APP_SETTINGS_DEBUG_MEMORY_EXTERNAL_LARGEST_FREE_BLOCK_THRESHOLD_MIN_KB
            int "PSRAM largest free block threshold minimum (KB)"
            range 1 1048576
            default 1

        config BROOKESIA_APP_SETTINGS_DEBUG_MEMORY_EXTERNAL_LARGEST_FREE_BLOCK_THRESHOLD_DEFAULT_KB
            int "PSRAM largest free block threshold default (KB)"
            range 1 1048576
            default 500

        config BROOKESIA_APP_SETTINGS_DEBUG_MEMORY_EXTERNAL_LARGEST_FREE_BLOCK_THRESHOLD_MAX_KB
            int "PSRAM largest free block threshold maximum (KB)"
            range 1 1048576
            default 4096

        config BROOKESIA_APP_SETTINGS_DEBUG_THREAD_PROFILING_INTERVAL_MIN_MS
            int "Thread profiling interval minimum (ms)"
            range 1 60000
            default 1000

        config BROOKESIA_APP_SETTINGS_DEBUG_THREAD_PROFILING_INTERVAL_DEFAULT_MS
            int "Thread profiling interval default (ms)"
            range 1 60000
            default 5000

        config BROOKESIA_APP_SETTINGS_DEBUG_THREAD_PROFILING_INTERVAL_MAX_MS
            int "Thread profiling interval maximum (ms)"
            range 1 60000
            default 20000

        config BROOKESIA_APP_SETTINGS_DEBUG_THREAD_SAMPLING_DURATION_MIN_MS
            int "Thread sampling duration minimum (ms)"
            range 1 60000
            default 100

        config BROOKESIA_APP_SETTINGS_DEBUG_THREAD_SAMPLING_DURATION_DEFAULT_MS
            int "Thread sampling duration default (ms)"
            range 1 60000
            default 1000

        config BROOKESIA_APP_SETTINGS_DEBUG_THREAD_SAMPLING_DURATION_MAX_MS
            int "Thread sampling duration maximum (ms)"
            range 1 60000
            default 5000

        config BROOKESIA_APP_SETTINGS_DEBUG_THREAD_IDLE_CPU_PERCENT_THRESHOLD_MIN
            int "Thread idle CPU threshold minimum (%)"
            range 1 99
            default 1

        config BROOKESIA_APP_SETTINGS_DEBUG_THREAD_IDLE_CPU_PERCENT_THRESHOLD_DEFAULT
            int "Thread idle CPU threshold default (%)"
            range 1 99
            default 1

        config BROOKESIA_APP_SETTINGS_DEBUG_THREAD_IDLE_CPU_PERCENT_THRESHOLD_MAX
            int "Thread idle CPU threshold maximum (%)"
            range 1 99
            default 50

        config BROOKESIA_APP_SETTINGS_DEBUG_THREAD_STACK_HIGH_WATER_MARK_THRESHOLD_MIN_BYTES
            int "Thread stack high water mark threshold minimum (bytes)"
            range 1 1048576
            default 64

        config BROOKESIA_APP_SETTINGS_DEBUG_THREAD_STACK_HIGH_WATER_MARK_THRESHOLD_DEFAULT_BYTES
            int "Thread stack high water mark threshold default (bytes)"
            range 1 1048576
            default 128

        config BROOKESIA_APP_SETTINGS_DEBUG_THREAD_STACK_HIGH_WATER_MARK_THRESHOLD_MAX_BYTES
            int "Thread stack high water mark threshold maximum (bytes)"
            range 1 1048576
            default 8192
    endmenu
endmenu
```

## app/brookesia_app_store/Kconfig
```kconfig
menu "ESP-Brookesia: App Store Configurations"
    config BROOKESIA_APP_STORE_SERVER_ROOT_URL
        string "App Store server root URL"
        default "https://brookesia-app-store.espressif.com/api/v1"
        help
            Root URL of the App Store API. The App Store reads index.json from this directory and
            fetches per-app metadata from apps/<package_name>/versions/<version>/metadata.json.

    config BROOKESIA_APP_STORE_INDEX_URL
        string "App Store legacy index URL override"
        default ""
        help
            Optional legacy override for the App Store index JSON. For a local development server, use a URL such as:
            http://<host-ip>:65535/app_store/index.json

            Leave empty to use BROOKESIA_APP_STORE_SERVER_ROOT_URL/index.json.

    config BROOKESIA_APP_STORE_LIST_PAGE_SIZE
        int "App Store list page size"
        range 1 30
        default 5
        help
            Number of app rows shown per page in Store, Installed, and Local tabs.
endmenu
```

## core/brookesia_core/Kconfig
```kconfig
menu "ESP Brookesia - Core Configurations"
    menuconfig ESP_BROOKESIA_ENABLE_AI_FRAMEWORK
        bool "AI Framework"
        default y

    if ESP_BROOKESIA_ENABLE_AI_FRAMEWORK
        rsource "ai_framework/Kconfig"
    endif

    menuconfig ESP_BROOKESIA_ENABLE_GUI
        bool "GUI"
        default y

    if ESP_BROOKESIA_ENABLE_GUI
        rsource "gui/Kconfig"
    endif

    menuconfig ESP_BROOKESIA_ENABLE_SERVICES
        bool "Services"
        default y

    if ESP_BROOKESIA_ENABLE_SERVICES
        rsource "services/Kconfig"
    endif

    menuconfig ESP_BROOKESIA_ENABLE_SYSTEMS
        bool "Systems"
        default y

    if ESP_BROOKESIA_ENABLE_SYSTEMS
        rsource "systems/Kconfig"
    endif
endmenu
```
