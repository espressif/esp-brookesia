## examples/service/console/sdkconfig.defaults
```kconfig
CONFIG_FREERTOS_HZ=1000
CONFIG_ESP_MAIN_TASK_STACK_SIZE=4096
CONFIG_ESP_INT_WDT_TIMEOUT_MS=2000
CONFIG_ESP_TASK_WDT_TIMEOUT_S=10

CONFIG_ESP_TLS_USE_DS_PERIPHERAL=n
CONFIG_ESP_TLS_INSECURE=y
CONFIG_ESP_TLS_SKIP_SERVER_CERT_VERIFY=y

CONFIG_ESP_WIFI_STATIC_RX_BUFFER_NUM=6
CONFIG_ESP_WIFI_STATIC_TX_BUFFER_NUM=6
CONFIG_ESP_WIFI_DYNAMIC_RX_MGMT_BUFFER=y
CONFIG_ESP_WIFI_TX_BA_WIN=16
CONFIG_ESP_WIFI_RX_BA_WIN=8
CONFIG_ESP_WIFI_IRAM_OPT=n
CONFIG_ESP_WIFI_RX_IRAM_OPT=n

CONFIG_LWIP_IRAM_OPTIMIZATION=n
CONFIG_LWIP_TCP_RECVMBOX_SIZE=10
CONFIG_LWIP_TCP_ACCEPTMBOX_SIZE=8
CONFIG_LWIP_TCP_OOSEQ_MAX_PBUFS=6
CONFIG_LWIP_FALLBACK_DNS_SERVER_SUPPORT=y
CONFIG_LWIP_DNS_SETSERVER_WITH_NETIF=y
CONFIG_MBEDTLS_EXTERNAL_MEM_ALLOC=y
CONFIG_MBEDTLS_DYNAMIC_BUFFER=y
CONFIG_MBEDTLS_SSL_KEEP_PEER_CERTIFICATE=n

# Console
CONFIG_ESP_CONSOLE_SECONDARY_NONE=y

# Brookesia:Utils
CONFIG_BROOKESIA_UTILS_THREAD_PROFILER_ENABLE_FREERTOS_CONFIG=y

# Brookesia:Service:SNTP
CONFIG_LWIP_SNTP_MAX_SERVERS=4
CONFIG_LWIP_SNTP_STARTUP_DELAY=n
CONFIG_LWIP_DHCP_GET_NTP_SRV=y
CONFIG_LWIP_DHCP_MAX_NTP_SERVERS=4

# Brookesia:Agent
# Coze
CONFIG_MBEDTLS_DYNAMIC_BUFFER=n
# Openai
CONFIG_WS_BUFFER_SIZE=2048
# XiaoZhi
CONFIG_XIAOZHI_AUDIO_TASK_ALLOC_DYNAMIC=y
CONFIG_XIAOZHI_STACK_IN_PSRAM=y
CONFIG_XIAOZHI_SYNC_SYSTEM_TIME_FROM_SERVER=n

# Brookesia:Expression:Emote
CONFIG_EXAMPLE_EXPRESSIONS_ENABLE_EMOTE=y
CONFIG_MMAP_FILE_NAME_LENGTH=32

CONFIG_BROOKESIA_UTILS_LOG_IMPL_TYPE_STDLIB=y
CONFIG_BROOKESIA_UTILS_LOG_LEVEL_TRACE=y
CONFIG_BROOKESIA_SERVICE_AUDIO_ENABLE_DEBUG_LOG=y
```
