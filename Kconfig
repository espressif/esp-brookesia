## core/brookesia_core/ai_framework/Kconfig
```kconfig
menuconfig ESP_BROOKESIA_AI_FRAMEWORK_ENABLE_AGENT
    bool "Agent"
    default y

if ESP_BROOKESIA_AI_FRAMEWORK_ENABLE_AGENT
    config ESP_BROOKESIA_AGENT_ENABLE_DEBUG_LOG
        bool "Enable debug log output"
        depends on ESP_UTILS_CONF_LOG_LEVEL_DEBUG
        default y
endif # ESP_BROOKESIA_AI_FRAMEWORK_ENABLE_AGENT

menuconfig ESP_BROOKESIA_AI_FRAMEWORK_ENABLE_EXPRESSION
    bool "Expression"
    default y

if ESP_BROOKESIA_AI_FRAMEWORK_ENABLE_EXPRESSION
    config ESP_BROOKESIA_EXPRESSION_ENABLE_DEBUG_LOG
        bool "Enable debug log output"
        depends on ESP_UTILS_CONF_LOG_LEVEL_DEBUG
        default y
endif # ESP_BROOKESIA_AI_FRAMEWORK_ENABLE_EXPRESSION
```

## core/brookesia_core/gui/Kconfig
```kconfig
menuconfig ESP_BROOKESIA_GUI_ENABLE_ANIM_PLAYER
    bool "Animation Player"
    default y

if ESP_BROOKESIA_GUI_ENABLE_ANIM_PLAYER
    config ESP_BROOKESIA_ANIM_PLAYER_ENABLE_DEBUG_LOG
        bool "Enable debug log output"
        depends on ESP_UTILS_CONF_LOG_LEVEL_DEBUG
        default y
endif # ESP_BROOKESIA_GUI_ENABLE_ANIM_PLAYER

menu "LVGL"
    menuconfig ESP_BROOKESIA_LVGL_ENABLE_DEBUG_LOG
        bool "Enable debug log output"
        depends on ESP_UTILS_CONF_LOG_LEVEL_DEBUG
        default y

    if ESP_BROOKESIA_LVGL_ENABLE_DEBUG_LOG
        config ESP_BROOKESIA_LVGL_ANIMATION_ENABLE_DEBUG_LOG
            bool "Animation"
            depends on ESP_UTILS_CONF_LOG_LEVEL_DEBUG
            default y

        config ESP_BROOKESIA_LVGL_CANVAS_ENABLE_DEBUG_LOG
            bool "Canvas"
            depends on ESP_UTILS_CONF_LOG_LEVEL_DEBUG
            default y

        config ESP_BROOKESIA_LVGL_CONTAINER_ENABLE_DEBUG_LOG
            bool "Container"
            depends on ESP_UTILS_CONF_LOG_LEVEL_DEBUG
            default y

        config ESP_BROOKESIA_LVGL_DISPLAY_ENABLE_DEBUG_LOG
            bool "Display"
            depends on ESP_UTILS_CONF_LOG_LEVEL_DEBUG
            default y

        config ESP_BROOKESIA_LVGL_HELPER_ENABLE_DEBUG_LOG
            bool "Helper"
            depends on ESP_UTILS_CONF_LOG_LEVEL_DEBUG
            default y

        config ESP_BROOKESIA_LVGL_LOCK_ENABLE_DEBUG_LOG
            bool "Lock"
            depends on ESP_UTILS_CONF_LOG_LEVEL_DEBUG
            default y

        config ESP_BROOKESIA_LVGL_OBJECT_ENABLE_DEBUG_LOG
            bool "Object"
            depends on ESP_UTILS_CONF_LOG_LEVEL_DEBUG
            default y

        config ESP_BROOKESIA_LVGL_SCREEN_ENABLE_DEBUG_LOG
            bool "Screen"
            depends on ESP_UTILS_CONF_LOG_LEVEL_DEBUG
            default y

        config ESP_BROOKESIA_LVGL_TIMER_ENABLE_DEBUG_LOG
            bool "Timer"
            depends on ESP_UTILS_CONF_LOG_LEVEL_DEBUG
            default y
    endif
endmenu

menuconfig ESP_BROOKESIA_GUI_ENABLE_SQUARELINE
    bool "Squareline Helpers"
    default y

if ESP_BROOKESIA_GUI_ENABLE_SQUARELINE
    config ESP_BROOKESIA_SQUARELINE_ENABLE_UI_COMP
        bool "Use UI component from inside"
        default y

    config ESP_BROOKESIA_SQUARELINE_ENABLE_UI_HELPERS
        bool "Use UI helpers from inside"
        default y
endif

menu "Style"
    config ESP_BROOKESIA_STYLE_ENABLE_DEBUG_LOG
        bool "Enable debug log output"
        depends on ESP_UTILS_CONF_LOG_LEVEL_DEBUG
        default y
endmenu
```

## core/brookesia_core/services/Kconfig
```kconfig
menuconfig ESP_BROOKESIA_SERVICES_ENABLE_STORAGE_NVS
    bool "Storage NVS Services"
    default y

if ESP_BROOKESIA_SERVICES_ENABLE_STORAGE_NVS
    config ESP_BROOKESIA_STORAGE_NVS_ENABLE_DEBUG_LOG
        bool "Enable debug log output"
        depends on ESP_UTILS_CONF_LOG_LEVEL_DEBUG
        default y
endif # ESP_BROOKESIA_SERVICES_ENABLE_STORAGE_NVS
```

## core/brookesia_core/systems/Kconfig
```kconfig
menu "Base"
    menuconfig ESP_BROOKESIA_BASE_ENABLE_DEBUG_LOG
        bool "Enable debug log output"
        depends on ESP_UTILS_CONF_LOG_LEVEL_DEBUG
        default y

    if ESP_BROOKESIA_BASE_ENABLE_DEBUG_LOG
        config ESP_BROOKESIA_BASE_APP_ENABLE_DEBUG_LOG
            bool "App"
            default y

        config ESP_BROOKESIA_BASE_DISPLAY_ENABLE_DEBUG_LOG
            bool "Display"
            default y

        config ESP_BROOKESIA_BASE_EVENT_ENABLE_DEBUG_LOG
            bool "Event"
            default y

        config ESP_BROOKESIA_BASE_MANAGER_ENABLE_DEBUG_LOG
            bool "Manager"
            default y

        config ESP_BROOKESIA_BASE_CORE_ENABLE_DEBUG_LOG
            bool "Core"
            default y
    endif
endmenu

menuconfig ESP_BROOKESIA_SYSTEMS_ENABLE_PHONE
    bool "Phone"
    default y

if ESP_BROOKESIA_SYSTEMS_ENABLE_PHONE
    menuconfig ESP_BROOKESIA_PHONE_ENABLE_DEBUG_LOG
        bool "Enable debug log output"
        depends on ESP_UTILS_CONF_LOG_LEVEL_DEBUG
        default y

    if ESP_BROOKESIA_PHONE_ENABLE_DEBUG_LOG
        config ESP_BROOKESIA_PHONE_APP_ENABLE_DEBUG_LOG
            bool "App"
            default y

        config ESP_BROOKESIA_PHONE_HONE_ENABLE_DEBUG_LOG
            bool "Display"
            default y

        config ESP_BROOKESIA_PHONE_MANAGER_ENABLE_DEBUG_LOG
            bool "Manager"
            default y

        config ESP_BROOKESIA_PHONE_PHONE_ENABLE_DEBUG_LOG
            bool "Phone"
            default y

        config ESP_BROOKESIA_PHONE_APP_LAUNCHER_ENABLE_DEBUG_LOG
            bool "App launcher"
            default y

        config ESP_BROOKESIA_PHONE_GESTURE_ENABLE_DEBUG_LOG
            bool "Gesture"
            default y

        config ESP_BROOKESIA_PHONE_NAVIGATION_BAR_ENABLE_DEBUG_LOG
            bool "Navigation bar"
            default y

        config ESP_BROOKESIA_PHONE_RECENTS_SCREEN_ENABLE_DEBUG_LOG
            bool "Recents screen"
            default y

        config ESP_BROOKESIA_PHONE_STATUS_BAR_ENABLE_DEBUG_LOG
            bool "Status bar"
            default y
    endif
endif # ESP_BROOKESIA_SYSTEMS_ENABLE_PHONE

menuconfig ESP_BROOKESIA_SYSTEMS_ENABLE_SPEAKER
    bool "Speaker"
    default y

if ESP_BROOKESIA_SYSTEMS_ENABLE_SPEAKER
    menuconfig ESP_BROOKESIA_SPEAKER_ENABLE_DEBUG_LOG
        bool "Enable debug log output"
        depends on ESP_UTILS_CONF_LOG_LEVEL_DEBUG
        default y

    if ESP_BROOKESIA_SPEAKER_ENABLE_DEBUG_LOG
        config ESP_BROOKESIA_SPEAKER_AI_BUDDY_ENABLE_DEBUG_LOG
            bool "AI buddy"
            default y

        config ESP_BROOKESIA_SPEAKER_APP_ENABLE_DEBUG_LOG
            bool "App"
            default y

        config ESP_BROOKESIA_SPEAKER_DISPLAY_ENABLE_DEBUG_LOG
            bool "Display"
            default y

        config ESP_BROOKESIA_SPEAKER_MANAGER_ENABLE_DEBUG_LOG
            bool "Manager"
            default y

        config ESP_BROOKESIA_SPEAKER_SPEAKER_ENABLE_DEBUG_LOG
            bool "Speaker"
            default y

        config ESP_BROOKESIA_SPEAKER_APP_LAUNCHER_ENABLE_DEBUG_LOG
            bool "App launcher"
            default y

        config ESP_BROOKESIA_SPEAKER_GESTURE_ENABLE_DEBUG_LOG
            bool "Gesture"
            default y

        config ESP_BROOKESIA_SPEAKER_KEYBOARD_ENABLE_DEBUG_LOG
            bool "Keyboard"
            default y

        config ESP_BROOKESIA_SPEAKER_QUICK_SETTINGS_ENABLE_DEBUG_LOG
            bool "Quick settings"
            default y
    endif

    config ESP_BROOKESIA_SPEAKER_FS_MOUNT_POINT
        string "File system mount point"
        default "/sdcard"
endif # ESP_BROOKESIA_SYSTEMS_ENABLE_SPEAKER
```

## core/brookesia_core/test_apps/main/Kconfig.projbuild
```kconfig
menu "Test Configuration"
    config TEST_LVGL_RESOLUTION_WIDTH
        int "Width"
        default 1024
        range 240 1920

    config TEST_LVGL_RESOLUTION_HEIGHT
        int "Height"
        default 600
        range 240 1920
endmenu
```

## core/brookesia_core/test_apps/sdkconfig.defaults
```kconfig
CONFIG_ESPTOOLPY_FLASHSIZE_4MB=y
CONFIG_PARTITION_TABLE_CUSTOM=y
CONFIG_ESP_TASK_WDT_EN=n
CONFIG_FREERTOS_HZ=1000
CONFIG_FREERTOS_TIMER_TASK_STACK_DEPTH=4096
CONFIG_ESP_BROOKESIA_ENABLE_AI_FRAMEWORK=n
CONFIG_ESP_BROOKESIA_GUI_ENABLE_ANIM_PLAYER=n
CONFIG_ESP_BROOKESIA_ENABLE_SERVICES=n
CONFIG_ESP_BROOKESIA_SYSTEMS_ENABLE_SPEAKER=n
CONFIG_BOOST_MATH_ENABLED=n
CONFIG_BOOST_SERIALIZATION_ENABLED=n
CONFIG_LV_USE_CLIB_MALLOC=y
CONFIG_LV_USE_CLIB_STRING=y
CONFIG_LV_USE_CLIB_SPRINTF=y
CONFIG_LV_USE_LOG=y
CONFIG_LV_LOG_PRINTF=y
CONFIG_LV_FONT_MONTSERRAT_8=y
CONFIG_LV_FONT_MONTSERRAT_10=y
CONFIG_LV_FONT_MONTSERRAT_12=y
CONFIG_LV_FONT_MONTSERRAT_16=y
CONFIG_LV_FONT_MONTSERRAT_18=y
CONFIG_LV_FONT_MONTSERRAT_20=y
CONFIG_LV_FONT_MONTSERRAT_22=y
CONFIG_LV_FONT_MONTSERRAT_24=y
CONFIG_LV_FONT_MONTSERRAT_26=y
CONFIG_LV_FONT_MONTSERRAT_28=y
CONFIG_LV_FONT_MONTSERRAT_30=y
CONFIG_LV_FONT_MONTSERRAT_32=y
CONFIG_LV_FONT_MONTSERRAT_34=y
CONFIG_LV_FONT_MONTSERRAT_36=y
CONFIG_LV_FONT_MONTSERRAT_38=y
CONFIG_LV_FONT_MONTSERRAT_40=y
CONFIG_LV_FONT_MONTSERRAT_42=y
CONFIG_LV_FONT_MONTSERRAT_44=y
CONFIG_LV_FONT_FMT_TXT_LARGE=y
CONFIG_LV_USE_FONT_COMPRESSED=y
CONFIG_LV_USE_SNAPSHOT=y
CONFIG_LV_BUILD_EXAMPLES=n
```

## core/brookesia_core/test_apps/sdkconfig.defaults.esp32p4
```kconfig
CONFIG_SPIRAM=y
CONFIG_SPIRAM_SPEED_200M=y
CONFIG_SPIRAM_XIP_FROM_PSRAM=y
CONFIG_CACHE_L2_CACHE_256KB=y
CONFIG_CACHE_L2_CACHE_LINE_128B=y
```

## examples/agent/chatbot/sdkconfig.defaults
```kconfig
CONFIG_FREERTOS_HZ=1000
CONFIG_ESP_MAIN_TASK_STACK_SIZE=4096
CONFIG_ESP_INT_WDT_TIMEOUT_MS=2000
CONFIG_ESP_TASK_WDT_TIMEOUT_S=10
CONFIG_COMPILER_OPTIMIZATION_PERF=y

CONFIG_ESP_TLS_USE_DS_PERIPHERAL=n
CONFIG_ESP_TLS_INSECURE=y
CONFIG_ESP_TLS_SKIP_SERVER_CERT_VERIFY=y

CONFIG_LWIP_FALLBACK_DNS_SERVER_SUPPORT=y
CONFIG_LWIP_DNS_SETSERVER_WITH_NETIF=y
CONFIG_MBEDTLS_EXTERNAL_MEM_ALLOC=y
CONFIG_MBEDTLS_DYNAMIC_BUFFER=y
CONFIG_MBEDTLS_SSL_KEEP_PEER_CERTIFICATE=n

# LVGL
CONFIG_LV_USE_CLIB_MALLOC=y
CONFIG_LV_USE_CLIB_STRING=y
CONFIG_LV_USE_CLIB_SPRINTF=y
CONFIG_LV_DEF_REFR_PERIOD=15
CONFIG_LV_DPI_DEF=60
CONFIG_LV_DRAW_LAYER_SIMPLE_BUF_SIZE=48000
CONFIG_LV_DRAW_SW_SHADOW_CACHE_SIZE=4
CONFIG_LV_GRADIENT_MAX_STOPS=4
CONFIG_LV_OBJ_STYLE_CACHE=y
CONFIG_LV_USE_SYSMON=y
CONFIG_LV_FONT_MONTSERRAT_30=y
CONFIG_LV_TXT_ENC_UTF8=y
CONFIG_LV_DRAW_THREAD_PRIO=4
CONFIG_LV_CACHE_DEF_SIZE=1024000
CONFIG_LV_IMAGE_HEADER_CACHE_DEF_CNT=32
CONFIG_LV_USE_LOG=y
CONFIG_LV_LOG_PRINTF=y
CONFIG_LV_FS_STDIO_LETTER=65
CONFIG_LV_FS_POSIX_LETTER=65
CONFIG_LV_FS_DEFAULT_DRIVER_LETTER=65
CONFIG_LV_USE_LODEPNG=y

# Brookesia:Hal
CONFIG_BROOKESIA_HAL_ADAPTOR_DISPLAY_LCD_PANEL_INIT_THREAD_CORE_ID=1

# Brookesia:Utils
CONFIG_BROOKESIA_UTILS_THREAD_PROFILER_ENABLE_FREERTOS_CONFIG=y

# Brookesia:Agent
# Coze
CONFIG_BROOKESIA_AGENT_COZE_ENABLE_AUTO_REGISTER=n
CONFIG_MBEDTLS_DYNAMIC_BUFFER=n
# Openai
CONFIG_WS_BUFFER_SIZE=2048
CONFIG_BROOKESIA_AGENT_OPENAI_ENABLE_AUTO_REGISTER=n
# XiaoZhi
CONFIG_XIAOZHI_AUDIO_TASK_ALLOC_DYNAMIC=y
CONFIG_XIAOZHI_STACK_IN_PSRAM=y
CONFIG_XIAOZHI_SYNC_SYSTEM_TIME_FROM_SERVER=n
CONFIG_BROOKESIA_AGENT_XIAOZHI_ENABLE_AUTO_REGISTER=n

# Brookesia:Expression:Emote
CONFIG_EXAMPLE_EXPRESSIONS_ENABLE_EMOTE=y
CONFIG_MMAP_FILE_NAME_LENGTH=32

# H264 (Save RAM and Flash)
CONFIG_ESP_H264_DECODER_IRAM=n
CONFIG_VIDEO_DECODER_SW_H264_SUPPORT=n
CONFIG_VIDEO_ENCODER_SW_H264_SUPPORT=n

# Audio Codec
CONFIG_AUDIO_DECODER_AAC_SUPPORT=n
CONFIG_AUDIO_DECODER_MP3_SUPPORT=y
CONFIG_AUDIO_DECODER_G711_SUPPORT=y
CONFIG_AUDIO_DECODER_AMRNB_SUPPORT=n
CONFIG_AUDIO_DECODER_AMRWB_SUPPORT=n
CONFIG_AUDIO_DECODER_FLAC_SUPPORT=n
CONFIG_AUDIO_DECODER_OPUS_SUPPORT=y
CONFIG_AUDIO_DECODER_VORBIS_SUPPORT=n
CONFIG_AUDIO_DECODER_ADPCM_SUPPORT=n
CONFIG_AUDIO_DECODER_ALAC_SUPPORT=n
CONFIG_AUDIO_DECODER_PCM_SUPPORT=y
CONFIG_AUDIO_DECODER_SBC_SUPPORT=n
CONFIG_AUDIO_DECODER_LC3_SUPPORT=n
CONFIG_AUDIO_DECODER_G722_SUPPORT=n
CONFIG_AUDIO_SIMPLE_DEC_WAV_SUPPORT=n
CONFIG_AUDIO_SIMPLE_DEC_M4A_SUPPORT=n
CONFIG_AUDIO_SIMPLE_DEC_TS_SUPPORT=n
CONFIG_AUDIO_SIMPLE_DEC_OGG_SUPPORT=n
CONFIG_AUDIO_ENCODER_AAC_SUPPORT=n
CONFIG_AUDIO_ENCODER_G711_SUPPORT=y
CONFIG_AUDIO_ENCODER_AMRNB_SUPPORT=n
CONFIG_AUDIO_ENCODER_AMRWB_SUPPORT=n
CONFIG_AUDIO_ENCODER_OPUS_SUPPORT=y
CONFIG_AUDIO_ENCODER_ADPCM_SUPPORT=n
CONFIG_AUDIO_ENCODER_ALAC_SUPPORT=n
CONFIG_AUDIO_ENCODER_PCM_SUPPORT=y
CONFIG_AUDIO_ENCODER_SBC_SUPPORT=n
CONFIG_AUDIO_ENCODER_LC3_SUPPORT=n
CONFIG_AUDIO_ENCODER_G722_SUPPORT=n
```

## examples/agent/chatbot/sdkconfig.defaults.esp32s3
```kconfig
CONFIG_SR_WN_WN9_HIESP=y

# WiFi
CONFIG_ESP_WIFI_STATIC_RX_BUFFER_NUM=6
CONFIG_ESP_WIFI_STATIC_TX_BUFFER_NUM=6
CONFIG_ESP_WIFI_DYNAMIC_RX_MGMT_BUFFER=y
CONFIG_ESP_WIFI_TX_BA_WIN=16
CONFIG_ESP_WIFI_RX_BA_WIN=8
CONFIG_ESP_WIFI_IRAM_OPT=n
CONFIG_ESP_WIFI_RX_IRAM_OPT=n
CONFIG_LWIP_IRAM_OPTIMIZATION=n
CONFIG_LWIP_TCP_RECVMBOX_SIZE=10
CONFIG_LWIP_TCP_ACCEPTMBOX_SIZE=8
CONFIG_LWIP_TCP_OOSEQ_MAX_PBUFS=6
```

## examples/esp_idf/esp_brookesia_phone_p4_function_ev_board/sdkconfig.defaults
```kconfig
CONFIG_IDF_TARGET="esp32p4"
CONFIG_ESPTOOLPY_FLASHMODE_QIO=y
CONFIG_ESPTOOLPY_FLASHSIZE_16MB=y
CONFIG_PARTITION_TABLE_CUSTOM=y
CONFIG_COMPILER_OPTIMIZATION_PERF=y
CONFIG_SPIRAM=y
CONFIG_SPIRAM_SPEED_200M=y
CONFIG_SPIRAM_XIP_FROM_PSRAM=y
CONFIG_CACHE_L2_CACHE_256KB=y
CONFIG_CACHE_L2_CACHE_LINE_128B=y
CONFIG_FREERTOS_HZ=1000
CONFIG_FREERTOS_VTASKLIST_INCLUDE_COREID=y
CONFIG_FREERTOS_GENERATE_RUN_TIME_STATS=y
CONFIG_ESP_BROOKESIA_MEMORY_USE_CUSTOM=y
CONFIG_LV_COLOR_SCREEN_TRANSP=y
CONFIG_LV_MEM_CUSTOM=y
CONFIG_LV_MEMCPY_MEMSET_STD=y
CONFIG_LV_DISP_DEF_REFR_PERIOD=25
CONFIG_LV_USE_LOG=y
CONFIG_LV_LOG_PRINTF=y
CONFIG_LV_USE_PERF_MONITOR=y
CONFIG_LV_ATTRIBUTE_FAST_MEM_USE_IRAM=y
CONFIG_LV_FONT_MONTSERRAT_8=y
CONFIG_LV_FONT_MONTSERRAT_10=y
CONFIG_LV_FONT_MONTSERRAT_12=y
CONFIG_LV_FONT_MONTSERRAT_16=y
CONFIG_LV_FONT_MONTSERRAT_18=y
CONFIG_LV_FONT_MONTSERRAT_20=y
CONFIG_LV_FONT_MONTSERRAT_22=y
CONFIG_LV_FONT_MONTSERRAT_24=y
CONFIG_LV_FONT_MONTSERRAT_26=y
CONFIG_LV_FONT_MONTSERRAT_28=y
CONFIG_LV_FONT_MONTSERRAT_30=y
CONFIG_LV_FONT_MONTSERRAT_32=y
CONFIG_LV_FONT_MONTSERRAT_34=y
CONFIG_LV_FONT_MONTSERRAT_36=y
CONFIG_LV_FONT_MONTSERRAT_38=y
CONFIG_LV_FONT_MONTSERRAT_40=y
CONFIG_LV_FONT_MONTSERRAT_42=y
CONFIG_LV_FONT_MONTSERRAT_44=y
CONFIG_LV_FONT_FMT_TXT_LARGE=y
CONFIG_LV_USE_FONT_COMPRESSED=y
CONFIG_LV_USE_DEMO_BENCHMARK=y
CONFIG_IDF_EXPERIMENTAL_FEATURES=y
```

## examples/esp_idf/esp_brookesia_phone_s3_lcd_ev_board/sdkconfig.defaults
```kconfig
CONFIG_IDF_TARGET="esp32s3"
CONFIG_ESPTOOLPY_FLASHMODE_QIO=y
CONFIG_ESPTOOLPY_FLASHSIZE_16MB=y
CONFIG_PARTITION_TABLE_CUSTOM=y
CONFIG_COMPILER_OPTIMIZATION_PERF=y
CONFIG_SPIRAM=y
CONFIG_SPIRAM_MODE_OCT=y
CONFIG_SPIRAM_FETCH_INSTRUCTIONS=y
CONFIG_SPIRAM_RODATA=y
CONFIG_SPIRAM_SPEED_80M=y
CONFIG_ESP_DEFAULT_CPU_FREQ_MHZ_240=y
CONFIG_ESP_CONSOLE_UART_CUSTOM=y
CONFIG_ESP_CONSOLE_UART_BAUDRATE=2000000
CONFIG_FREERTOS_HZ=1000
CONFIG_ESP_BROOKESIA_MEMORY_USE_CUSTOM=y
CONFIG_BSP_LCD_RGB_BUFFER_NUMS=2
CONFIG_BSP_DISPLAY_LVGL_TASK_STACK_SIZE_KB=6
CONFIG_BSP_DISPLAY_LVGL_AVOID_TEAR=y
CONFIG_BSP_DISPLAY_LVGL_DIRECT_MODE=y
CONFIG_LV_COLOR_SCREEN_TRANSP=y
CONFIG_LV_MEM_CUSTOM=y
CONFIG_LV_MEMCPY_MEMSET_STD=y
CONFIG_LV_USE_PERF_MONITOR=y
CONFIG_LV_ATTRIBUTE_FAST_MEM_USE_IRAM=y
CONFIG_LV_FONT_MONTSERRAT_8=y
CONFIG_LV_FONT_MONTSERRAT_10=y
CONFIG_LV_FONT_MONTSERRAT_12=y
CONFIG_LV_FONT_MONTSERRAT_16=y
CONFIG_LV_FONT_MONTSERRAT_18=y
CONFIG_LV_FONT_MONTSERRAT_20=y
CONFIG_LV_FONT_MONTSERRAT_22=y
CONFIG_LV_FONT_MONTSERRAT_24=y
CONFIG_LV_FONT_MONTSERRAT_26=y
CONFIG_LV_FONT_MONTSERRAT_28=y
CONFIG_LV_FONT_MONTSERRAT_30=y
CONFIG_LV_FONT_MONTSERRAT_32=y
CONFIG_LV_FONT_MONTSERRAT_34=y
CONFIG_LV_FONT_MONTSERRAT_36=y
CONFIG_LV_FONT_MONTSERRAT_38=y
CONFIG_LV_FONT_MONTSERRAT_40=y
CONFIG_LV_FONT_MONTSERRAT_42=y
CONFIG_LV_FONT_MONTSERRAT_44=y
CONFIG_LV_FONT_FMT_TXT_LARGE=y
CONFIG_LV_USE_FONT_COMPRESSED=y
CONFIG_LV_USE_DEMO_BENCHMARK=y
```
