## hal/brookesia_hal_linux/Kconfig
```kconfig
menu "ESP-Brookesia: HAL Linux Configurations"
    menuconfig BROOKESIA_HAL_LINUX_ENABLE_DEBUG_LOG
        bool "Enable debug or lower level logs"
        default n

    if BROOKESIA_HAL_LINUX_ENABLE_DEBUG_LOG
        config BROOKESIA_HAL_LINUX_SYSTEM_DEVICE_ENABLE_DEBUG_LOG
            bool "System device"
            default n
            help
                Enable debug or lower level logs for the Linux system device.

        config BROOKESIA_HAL_LINUX_NETWORK_DEVICE_ENABLE_DEBUG_LOG
            bool "Network device"
            default n
            help
                Enable debug or lower level logs for the Linux network device.

        config BROOKESIA_HAL_LINUX_NETWORK_SNTP_CLIENT_IMPL_ENABLE_DEBUG_LOG
            bool "SNTP client"
            default n
            help
                Enable debug or lower level logs for the Linux SNTP client interface.

        config BROOKESIA_HAL_LINUX_NETWORK_HTTP_CLIENT_IMPL_ENABLE_DEBUG_LOG
            bool "HTTP client"
            default n
            help
                Enable debug or lower level logs for the Linux HTTP client interface.

        config BROOKESIA_HAL_LINUX_SYSTEM_OTA_UPDATER_IMPL_ENABLE_DEBUG_LOG
            bool "OTA updater"
            default n
            help
                Enable debug or lower level logs for the Linux OTA updater interface.

        config BROOKESIA_HAL_LINUX_AUDIO_DEVICE_ENABLE_DEBUG_LOG
            bool "Audio device"
            default n
            help
                Enable debug or lower level logs for the Linux audio device.

        config BROOKESIA_HAL_LINUX_VIDEO_DEVICE_ENABLE_DEBUG_LOG
            bool "Video device"
            default n
            help
                Enable debug or lower level logs for the Linux video device.

        config BROOKESIA_HAL_LINUX_DISPLAY_DEVICE_ENABLE_DEBUG_LOG
            bool "Display device"
            default n
            help
                Enable debug or lower level logs for the Linux display device.

        config BROOKESIA_HAL_LINUX_POWER_DEVICE_ENABLE_DEBUG_LOG
            bool "Power device"
            default n
            help
                Enable debug or lower level logs for the Linux power device.

        config BROOKESIA_HAL_LINUX_WIFI_DEVICE_ENABLE_DEBUG_LOG
            bool "Wi-Fi device"
            default n
            help
                Enable debug or lower level logs for the Linux Wi-Fi device.

        config BROOKESIA_HAL_LINUX_STORAGE_DEVICE_ENABLE_DEBUG_LOG
            bool "Storage device"
            default n
            help
                Enable debug or lower level logs for the Linux storage device.
    endif

    config BROOKESIA_HAL_LINUX_ENABLE_SYSTEM_DEVICE
        bool "System Device"
        default y
        help
            Enable the Linux system device and its HAL interfaces.

    if BROOKESIA_HAL_LINUX_ENABLE_SYSTEM_DEVICE
        config BROOKESIA_HAL_LINUX_SYSTEM_ENABLE_OTA_UPDATER_IMPL
            bool "OTA Updater"
            default y
            help
                Enable the Linux OTA updater HAL interface.
    endif

    config BROOKESIA_HAL_LINUX_ENABLE_NETWORK_DEVICE
        bool "Network Device"
        default y
        help
            Enable the Linux network device and its protocol HAL interfaces.

    if BROOKESIA_HAL_LINUX_ENABLE_NETWORK_DEVICE
        config BROOKESIA_HAL_LINUX_NETWORK_ENABLE_SNTP_CLIENT_IMPL
            bool "SNTP Client"
            default y
            help
                Enable the Linux SNTP client HAL interface.

        config BROOKESIA_HAL_LINUX_NETWORK_ENABLE_HTTP_CLIENT_IMPL
            bool "HTTP Client"
            default y
            help
                Enable the Linux HTTP client HAL interface.

        config BROOKESIA_HAL_LINUX_NETWORK_HTTP_CLIENT_REQUIRE_TLS_VERIFY
            bool "Require TLS verification by default"
            default y
            help
                Verify HTTPS server certificates when a request uses the default TLS policy.

        config BROOKESIA_HAL_LINUX_NETWORK_HTTP_CLIENT_READ_THROTTLE_BYTES_PER_SEC
            int "HTTP client read throttle bytes per second"
            default 102400
            range 0 2147483647
            help
                Limit the Linux HTTP client response body delivery speed to simulate ESP-class download
                throughput. Set to 0 to disable throttling.
    endif

    choice BROOKESIA_HAL_LINUX_MEDIA_BACKEND
        prompt "Media backend"
        default BROOKESIA_HAL_LINUX_MEDIA_BACKEND_AUTO
        help
            Select the Linux media backend used by audio and video processor interfaces.

        config BROOKESIA_HAL_LINUX_MEDIA_BACKEND_AUTO
            bool "Auto"

        config BROOKESIA_HAL_LINUX_MEDIA_BACKEND_STUB
            bool "Stub"

        config BROOKESIA_HAL_LINUX_MEDIA_BACKEND_FFMPEG_PORTAUDIO
            bool "FFmpeg + PortAudio"
    endchoice

    choice BROOKESIA_HAL_LINUX_WIFI_BACKEND
        prompt "Wi-Fi backend"
        default BROOKESIA_HAL_LINUX_WIFI_BACKEND_AUTO
        help
            Select the Linux Wi-Fi backend.

        config BROOKESIA_HAL_LINUX_WIFI_BACKEND_AUTO
            bool "Auto"

        config BROOKESIA_HAL_LINUX_WIFI_BACKEND_STUB
            bool "Stub"

        config BROOKESIA_HAL_LINUX_WIFI_BACKEND_NETWORKMANAGER
            bool "NetworkManager"
    endchoice

    choice BROOKESIA_HAL_LINUX_DISPLAY_BACKEND
        prompt "Display backend"
        default BROOKESIA_HAL_LINUX_DISPLAY_BACKEND_AUTO
        help
            Select the Linux display and touch backend.

        config BROOKESIA_HAL_LINUX_DISPLAY_BACKEND_AUTO
            bool "Auto"

        config BROOKESIA_HAL_LINUX_DISPLAY_BACKEND_STUB
            bool "Stub"

        config BROOKESIA_HAL_LINUX_DISPLAY_BACKEND_SDL2
            bool "SDL2"
    endchoice

    choice BROOKESIA_HAL_LINUX_POWER_BACKEND
        prompt "Power backend"
        default BROOKESIA_HAL_LINUX_POWER_BACKEND_AUTO
        help
            Select the Linux power backend.

        config BROOKESIA_HAL_LINUX_POWER_BACKEND_AUTO
            bool "Auto"

        config BROOKESIA_HAL_LINUX_POWER_BACKEND_STUB
            bool "Stub"

        config BROOKESIA_HAL_LINUX_POWER_BACKEND_UPOWER
            bool "UPower"
    endchoice

    config BROOKESIA_HAL_LINUX_ENABLE_AUDIO_DEVICE
        bool "Audio Device"
        default y
        help
            Enable the Linux audio device and its player, recorder, and media processor HAL interfaces.

    config BROOKESIA_HAL_LINUX_ENABLE_VIDEO_DEVICE
        bool "Video Device"
        default y
        help
            Enable the Linux video device and its encoder and decoder HAL interfaces.

    config BROOKESIA_HAL_LINUX_ENABLE_DISPLAY_DEVICE
        bool "Display Device"
        default y
        help
            Enable the Linux display device and its panel, touch, and backlight HAL interfaces.

    config BROOKESIA_HAL_LINUX_ENABLE_POWER_DEVICE
        bool "Power Device"
        default y
        help
            Enable the Linux power device and its battery HAL interface.

    config BROOKESIA_HAL_LINUX_ENABLE_WIFI_DEVICE
        bool "Wi-Fi Device"
        default y
        help
            Enable the Linux Wi-Fi device and its Basic, Station, and SoftAP HAL interfaces.

    config BROOKESIA_HAL_LINUX_ENABLE_STORAGE_DEVICE
        bool "Storage Device"
        default y
        help
            Enable the Linux storage device and its key-value and file-system HAL interfaces.
endmenu
```

## products/phone/common_components/phone_common_net/Kconfig
```kconfig
config RAINMAKER_APP_SUPPORT
    bool "Enable RainMaker app and boot Wi-Fi (for RainMaker workflow)"
    default n
    help
        When enabled:
          - Builds and registers the ESP RainMaker Brookesia app plugin.
          - Exposes "Phone clock" and "Phone Auto Wi-Fi" options: on boot the device
            can connect to your Wi-Fi as a station so HTTP/DNS (e.g. RainMaker login)
            work without extra provisioning.
        When disabled, the RainMaker app and the boot-time auto Wi-Fi block are
        omitted from the firmware.

menu "Phone clock"
    depends on RAINMAKER_APP_SUPPORT

    config PHONE_TIMEZONE
        string "Default timezone (POSIX TZ)"
        default "CST-8"
        help
            POSIX TZ string used with setenv/tzset for localtime() and status bar clock,
            e.g. CST-8 for China (UTC+8). Applied at startup when RainMaker support is on;
            also used after SNTP sync in the auto Wi-Fi flow.

endmenu

menu "Phone Auto Wi-Fi"
    depends on RAINMAKER_APP_SUPPORT

    comment "Use the same SSID and password as your Wi-Fi router (or AP). On boot the device connects as STA so RainMaker can reach the network without manual connection."

    config PHONE_AUTO_WIFI_ENABLE
        bool "Connect to Wi-Fi automatically on boot"
        default y
        help
            If enabled, Wi-Fi stack starts during boot and the device tries to join the
            SSID below. Disable if you only want the RainMaker UI without auto-connect.

    config PHONE_AUTO_WIFI_SSID
        string "Wi-Fi SSID (your router/AP name)"
        default "myssid"
        depends on PHONE_AUTO_WIFI_ENABLE
        help
            2.4 GHz SSID of the network the board should join (must match your router
            or AP). Leave empty to skip auto Wi-Fi even if enabled.

    config PHONE_AUTO_WIFI_PASSWORD
        string "Wi-Fi password (WPA/WPA2 PSK)"
        default "mypassword"
        depends on PHONE_AUTO_WIFI_ENABLE
        help
            WPA/WPA2 pre-shared key for the SSID above. Use the same password as on
            your router; open networks are not described here.

    config PHONE_AUTO_WIFI_MAX_RETRY
        int "Max reconnect attempts after disconnect"
        range 0 20
        default 5
        depends on PHONE_AUTO_WIFI_ENABLE
        help
            After a disconnect, at most this many extra connection attempts before
            giving up (until next boot).

    config PHONE_SNTP_SERVER
        string "SNTP / NTP server hostname"
        default "pool.ntp.org"
        depends on PHONE_AUTO_WIFI_ENABLE
        help
            Hostname used for SNTP time sync after Wi-Fi gets an IP (e.g. pool.ntp.org).

endmenu
```

## products/speaker/common_components/espressif__esp_lvgl_port/Kconfig
```kconfig
menu "ESP LVGL PORT"

    config LVGL_PORT_ENABLE_PPA
        depends on SOC_PPA_SUPPORTED
        bool "Enable PPA for screen rotation"
        default n
        help
            Enables using PPA for screen rotation.

endmenu
```

## products/speaker/common_components/espressif__gmf_ai_audio/examples/aec_rec/sdkconfig.defaults.esp32
```kconfig
CONFIG_IDF_CMAKE=y
CONFIG_IDF_TARGET_ARCH_XTENSA=y
CONFIG_IDF_TARGET="esp32"
CONFIG_IDF_TARGET_ESP32=y
CONFIG_IDF_FIRMWARE_CHIP_ID=0x0000

#
# SDK tool configuration
#
CONFIG_SDK_TOOLPREFIX="xtensa-esp32-elf-"
# CONFIG_SDK_TOOLCHAIN_SUPPORTS_TIME_WIDE_64_BITS is not set
# end of SDK tool configuration

#
# ESP System Settings
#
# CONFIG_ESP_DEFAULT_CPU_FREQ_MHZ_80 is not set
# CONFIG_ESP_DEFAULT_CPU_FREQ_MHZ_160 is not set
CONFIG_ESP_DEFAULT_CPU_FREQ_MHZ_240=y
CONFIG_ESP_DEFAULT_CPU_FREQ_MHZ=240

CONFIG_AUDIO_BOARD="LYRAT_MINI_V1"
```

## products/speaker/common_components/espressif__gmf_ai_audio/examples/aec_rec/sdkconfig.defaults.esp32s3
```kconfig
CONFIG_IDF_CMAKE=y
CONFIG_IDF_TARGET_ARCH_XTENSA=y
CONFIG_IDF_TARGET="esp32s3"
CONFIG_IDF_TARGET_ESP32S3=y
CONFIG_IDF_FIRMWARE_CHIP_ID=0x0009

CONFIG_SDK_TOOLPREFIX="xtensa-esp32s3-elf-"
# CONFIG_SDK_TOOLCHAIN_SUPPORTS_TIME_WIDE_64_BITS is not set
# end of SDK tool configuration

CONFIG_COMPILER_OPTIMIZATION_PERF=y

CONFIG_SPIRAM_MODE_OCT=y

CONFIG_ESP32S3_DEFAULT_CPU_FREQ_240=y
CONFIG_ESP32S3_INSTRUCTION_CACHE_32KB=y
CONFIG_ESP32S3_DATA_CACHE_LINE_64B=y

CONFIG_AUDIO_BOARD="S3_Korvo_V2"
```

## products/speaker/common_components/espressif__gmf_ai_audio/examples/wwe/sdkconfig.defaults
```kconfig
#
# Serial flasher config
#
CONFIG_ESPTOOLPY_FLASH_MODE_AUTO_DETECT=y
CONFIG_ESPTOOLPY_FLASHMODE_DIO=y
CONFIG_ESPTOOLPY_FLASH_SAMPLE_MODE_STR=y
CONFIG_ESPTOOLPY_FLASHMODE="dio"
CONFIG_ESPTOOLPY_FLASHFREQ_80M=y
CONFIG_ESPTOOLPY_FLASHFREQ_80M_DEFAULT=y
CONFIG_ESPTOOLPY_FLASHFREQ="80m"
CONFIG_ESPTOOLPY_FLASHSIZE_8MB=y
CONFIG_ESPTOOLPY_FLASHSIZE="8MB"

#
# Compiler options
#
CONFIG_COMPILER_OPTIMIZATION_PERF=y
# end of Compiler options

#
# ESP PSRAM
#
CONFIG_SPIRAM=y
CONFIG_SPIRAM_TYPE_AUTO=y
CONFIG_SPIRAM_ALLOW_STACK_EXTERNAL_MEMORY=y
CONFIG_SPIRAM_SPEED_80M=y
CONFIG_SPIRAM_SPEED=80

#
# Audio Codec Device Configuration
#
# CONFIG_CODEC_I2C_BACKWARD_COMPATIBLE is not set
# end of Audio Codec Device Configuration

CONFIG_FATFS_LFN_HEAP=y

CONFIG_FREERTOS_HZ=1000
CONFIG_FREERTOS_USE_TRACE_FACILITY=y
CONFIG_FREERTOS_USE_STATS_FORMATTING_FUNCTIONS=y
# CONFIG_FREERTOS_USE_LIST_DATA_INTEGRITY_CHECK_BYTES is not set
CONFIG_FREERTOS_VTASKLIST_INCLUDE_COREID=y
CONFIG_FREERTOS_GENERATE_RUN_TIME_STATS=y
```

## products/speaker/common_components/espressif__gmf_ai_audio/examples/wwe/sdkconfig.defaults.esp32
```kconfig
CONFIG_IDF_CMAKE=y
CONFIG_IDF_TARGET_ARCH_XTENSA=y
CONFIG_IDF_TARGET="esp32"
CONFIG_IDF_TARGET_ESP32=y
CONFIG_IDF_FIRMWARE_CHIP_ID=0x0000

#
# SDK tool configuration
#
CONFIG_SDK_TOOLPREFIX="xtensa-esp32-elf-"
# CONFIG_SDK_TOOLCHAIN_SUPPORTS_TIME_WIDE_64_BITS is not set
# end of SDK tool configuration

#
# Partition Table
#
CONFIG_PARTITION_TABLE_CUSTOM=y
CONFIG_PARTITION_TABLE_CUSTOM_FILENAME="partitions_esp32.csv"
CONFIG_PARTITION_TABLE_FILENAME="partitions_esp32.csv"
CONFIG_PARTITION_TABLE_OFFSET=0x8000
CONFIG_PARTITION_TABLE_MD5=y
# end of Partition Table

#
# ESP Speech Recognition
#
CONFIG_AFE_INTERFACE_V1=y
CONFIG_SR_NSN_WEBRTC=y
CONFIG_SR_VADN_WEBRTC=y

#
# Load Multiple Wake Words
#
CONFIG_SR_WN_WN9_HILEXIN=y

CONFIG_SR_MN_CN_NONE=y
# CONFIG_SR_MN_CN_MULTINET2_SINGLE_RECOGNITION is not set
CONFIG_SR_MN_EN_NONE=y
# end of ESP Speech Recognition

#
# GMF AI Audio
#
CONFIG_GMF_AI_AUDIO_INIT_AEC=y
CONFIG_GMF_AI_AUDIO_INIT_AFE=y

CONFIG_GMF_AI_AUDIO_AFE_MODEL_PARTITION="model"
CONFIG_GMF_AI_AUDIO_AFE_VAD_ENABLE=y
CONFIG_GMF_AI_AUDIO_VAD_MODE=3
CONFIG_GMF_AI_AUDIO_WAKEUP_ENABLE=y
# end of GMF AI Audio

CONFIG_AUDIO_BOARD="LYRAT_MINI_V1"
```

## products/speaker/common_components/espressif__gmf_ai_audio/examples/wwe/sdkconfig.defaults.esp32c5
```kconfig
#
# Partition Table
#
CONFIG_PARTITION_TABLE_CUSTOM=y
CONFIG_PARTITION_TABLE_CUSTOM_FILENAME="partitions.csv"
CONFIG_PARTITION_TABLE_FILENAME="partitions.csv"
CONFIG_PARTITION_TABLE_OFFSET=0x8000
CONFIG_PARTITION_TABLE_MD5=y
# end of Partition Table

#
# ESP Speech Recognition
#
CONFIG_AFE_INTERFACE_V1=y
CONFIG_SR_NSN_WEBRTC=y
CONFIG_SR_VADN_WEBRTC=y

#
# Load Multiple Wake Words
#
CONFIG_SR_WN_WN9S_HILEXIN=y
# CONFIG_SR_WN_WN9S_HIESP is not set
# CONFIG_SR_WN_WN9S_NIHAOXIAOZHI is not set
# CONFIG_SR_WN_WN9S_HIJASON is not set
# end of Load Multiple Wake Words

CONFIG_SR_MN_CN_NONE=y
CONFIG_SR_MN_EN_NONE=y
# end of ESP Speech Recognition

CONFIG_GMF_AI_AUDIO_INIT_WN=y
CONFIG_GMF_AI_AUDIO_WN_CH_ALLOCATION="MR"

CONFIG_ESP_CONSOLE_USB_SERIAL_JTAG=y
```
